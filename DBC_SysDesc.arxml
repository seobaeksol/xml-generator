[part 3 of 4: package /DBC_SysDesc/Pkg_ISignal]
AUTOSAR XML (schema 4-2-2)
package /DBC_SysDesc/Pkg_ISignal
  1529 x i signal:
    TransInputShaftSpeed_ETC1_TCU_PCAN: init-value=0, length=16, base-type=uint16, system-signal=TransInputShaftSpeed_ETC1_TCU_PCAN  # Rotational velocity of the primary shaft transferring power into the transmission.Rotational velocity of the primary shaft transferring power into the transmission. When a torque converter is present, it isRotational velocity of the primary shaft transferring power into the transmission."
    ProgressiveShiftDisable_ETC1_TCU_PCAN: init-value=0, length=2, base-type=uint8, system-signal=ProgressiveShiftDisable_ETC1_TCU_PCAN  # Command signal used to indicate that progressive shifting by the engine should be disallowed.Command signal used to indicate that progressive shifting by the engine should be disallowed.Command signal used to indicate that progressive shifting by the engine should be disallowed."
    EngMomentaryOverspeedEnable_ETC1_TCU_PCAN: init-value=0, length=2, base-type=uint8, system-signal=EngMomentaryOverspeedEnable_ETC1_TCU_PCAN  # Command signal used to indicate that the engine speed may be boosted up to the maximum engine overspeed value to"
    PercentClutchSlip_ETC1_TCU_PCAN: init-value=0, length=8, base-type=uint8, system-signal=PercentClutchSlip_ETC1_TCU_PCAN  # Parameter which represents the ratio of input shaft speed to current engine speed (in percent).Parameter which represents the ratio of input shaft speed to current engine speed (in percent).Parameter which represents the ratio of input shaft speed to current engine speed (in percent)."
    TransOutputShaftSpeed_ETC1_TCU_PCAN: init-value=0, length=16, base-type=uint16, system-signal=TransOutputShaftSpeed_ETC1_TCU_PCAN  # Calculated speed of the transmission output shaft.Calculated speed of the transmission output shaft.Calculated speed of the transmission output shaft."
    TransShiftInProcess_ETC1_TCU_PCAN: init-value=0, length=2, base-type=uint8, system-signal=TransShiftInProcess_ETC1_TCU_PCAN  # Indicates that the transmission is in process of shifting from the current gear to the selected gear.Indicates that the transmission is in process of shifting from the current gear to the selected gear. This state is generallyIndicates that the transmission is in process of shifting from the current gear to the selected gear."
    TransDrivelineEngaged_ETC1_TCU_PCAN: init-value=0, length=2, base-type=uint8, system-signal=TransDrivelineEngaged_ETC1_TCU_PCAN  # Driveline engaged indicates the transmission controlled portion of the driveline is engaged sufficiently to allow a transfer"
    SrcAddrssOfCntrllngDvcFrTrnsCtrl_ETC1_TCU_PCAN: init-value=0, length=8, base-type=uint8, system-signal=SrcAddrssOfCntrllngDvcFrTrnsCtrl_ETC1_TCU_PCAN  # The source address of the SAE J1939 device currently controlling the transmission. Its value may be the source address"
    MomentaryEngMaxPowerEnable_ETC1_TCU_PCAN: init-value=0, length=2, base-type=uint8, system-signal=MomentaryEngMaxPowerEnable_ETC1_TCU_PCAN  # Momentarily Requesting highest torque map from the engine control"
    TrnsTrqCnvrtrLckpTrnstnInProcess_ETC1_TCU_PCAN: init-value=0, length=2, base-type=uint8, system-signal=TrnsTrqCnvrtrLckpTrnstnInProcess_ETC1_TCU_PCAN  # State signal indicating whether or not the transmission torque converter lock up clutch is transitioning between being"
    TrnsTorqueConverterLockupEngaged_ETC1_TCU_PCAN: init-value=0, length=2, base-type=uint8, system-signal=TrnsTorqueConverterLockupEngaged_ETC1_TCU_PCAN  # State signal which indicates whether the torque converter lockup is engaged."
    TM_ShiftInhibitIndicator_ETC7_TCU_PCAN: init-value=0, length=2, base-type=uint8, system-signal=TM_ShiftInhibitIndicator_ETC7_TCU_PCAN  # Transmission Shift Inhibit Indicator"
    NeutralCoast_EATON_ETC7_TCU_PCAN: init-value=0, length=2, base-type=uint8, system-signal=NeutralCoast_EATON_ETC7_TCU_PCAN  # Transmission Controlled Neutral Coast(TCNC)"
    Prevision_ETC7_TCU_PCAN: init-value=0, length=2, base-type=uint8, system-signal=Prevision_ETC7_TCU_PCAN
    RockingFree_ETC7_TCU_PCAN: init-value=0, length=2, base-type=uint8, system-signal=RockingFree_ETC7_TCU_PCAN
    DriveOnIdleSpeed_ETC7_TCU_PCAN: init-value=0, length=2, base-type=uint8, system-signal=DriveOnIdleSpeed_ETC7_TCU_PCAN
    OffRoad_Traxon_Eco_roll_Astronic_ETC7_TCU_PCAN: init-value=0, length=2, base-type=uint8, system-signal=OffRoad_Traxon_Eco_roll_Astronic_ETC7_TCU_PCAN
    EcoRoll_Traxon_ETC7_TCU_PCAN: init-value=0, length=2, base-type=uint8, system-signal=EcoRoll_Traxon_ETC7_TCU_PCAN  # ZF_ECO_ROLL_STATUS"
    TransEngCrankEnable_ETC7_TCU_PCAN: init-value=0, length=2, base-type=uint8, system-signal=TransEngCrankEnable_ETC7_TCU_PCAN  # State signal from the transmission indicating if the transmissions status is such that engine cranking is allowed (i.State signal from the transmission indicating if the transmissions status is such that engine cranking is allowed (i.e. at aState signal from the transmission indicating if the transmissions status is such that engine cranking is allowed (i."
    TransReadyForBrakeRelease_ETC7_TCU_PCAN: init-value=0, length=2, base-type=uint8, system-signal=TransReadyForBrakeRelease_ETC7_TCU_PCAN  # This parameter indicates that enough torque / motive force is available at the transmission output shaft to release all the"
    TransRequestedGearFeedback_ETC7_TCU_PCAN: init-value=0, length=8, base-type=uint8, system-signal=TransRequestedGearFeedback_ETC7_TCU_PCAN  # Feedback of the SPN 525 Transmission Requested Gear input as received from the shift selector, ABS or engine via"
    RetarderSelectionNonEng_ERC1_ER_ECU_PCAN: init-value=0, length=8, base-type=uint8, system-signal=RetarderSelectionNonEng_ERC1_ER_ECU_PCAN
    ActlMxAvlblRtarderPercentTorque_ERC1_ER_ECU_PCAN: init-value=0, length=8, base-type=uint8, system-signal=ActlMxAvlblRtarderPercentTorque_ERC1_ER_ECU_PCAN  # This is the maximum amount of torque that the retarder can immediately deliver."
    DrvrsDmandRetarderPercentTorque_ERC1_ER_ECU_PCAN: init-value=0, length=8, base-type=uint8, system-signal=DrvrsDmandRetarderPercentTorque_ERC1_ER_ECU_PCAN
    SrcAddrssOfCtrllngDvcFrRtrdrCtrl_ERC1_ER_ECU_PCAN: init-value=0, length=8, base-type=uint8, system-signal=SrcAddrssOfCtrllngDvcFrRtrdrCtrl_ERC1_ER_ECU_PCAN  # The source address of the SAE J1939 device currently controlling the retarder."
    RetarderRqingBrakeLight_ERC1_ER_ECU_PCAN: init-value=0, length=2, base-type=uint8, system-signal=RetarderRqingBrakeLight_ERC1_ER_ECU_PCAN
    EngCoolantLoadIncrease_ERC1_ER_ECU_PCAN: init-value=0, length=2, base-type=uint8, system-signal=EngCoolantLoadIncrease_ERC1_ER_ECU_PCAN  # Status of an event, external to the engine, that may increase the nominal temperature of the engine coolant liquid."
    IntendedRetarderPercentTorque_ERC1_ER_ECU_PCAN: init-value=0, length=8, base-type=uint8, system-signal=IntendedRetarderPercentTorque_ERC1_ER_ECU_PCAN  # Braking torque of retarder that the retarder is currently trying to achieve."
    ActualRetarderPercentTorque_ER_ERC1_ER_ECU_PCAN: init-value=0, length=8, base-type=uint8, system-signal=ActualRetarderPercentTorque_ER_ERC1_ER_ECU_PCAN  # Actual braking torque of the retarder as a percent of retarder configuration reference torque SPN 556."
    RetarderEnableShiftAssistSwitch_ERC1_ER_ECU_PCAN: init-value=0, length=2, base-type=uint8, system-signal=RetarderEnableShiftAssistSwitch_ERC1_ER_ECU_PCAN  # Switch signal which indicates whether the operator wishes the retarder to be enabled for transmission shift assist."
    RetarderEnableBrakeAssistSwitch_ERC1_ER_ECU_PCAN: init-value=0, length=2, base-type=uint8, system-signal=RetarderEnableBrakeAssistSwitch_ERC1_ER_ECU_PCAN  # Switch signal which indicates whether the operator wishes the retarder to be enabled for vehicle braking assist."
    RetarderTorqueMode_ERC1_ER_ECU_PCAN: init-value=0, length=4, base-type=uint8, system-signal=RetarderTorqueMode_ERC1_ER_ECU_PCAN  # State signal which indicates which retarder torque mode is currently generating, limiting, or controlling the torque."
    RetarderSelectionNonEng_ERC1_DR_ITR_PCAN: init-value=0, length=8, base-type=uint8, system-signal=RetarderSelectionNonEng_ERC1_DR_ITR_PCAN
    ActlMxAvlblRtarderPercentTorque_ERC1_DR_ITR_PCAN: init-value=0, length=8, base-type=uint8, system-signal=ActlMxAvlblRtarderPercentTorque_ERC1_DR_ITR_PCAN  # This is the maximum amount of torque that the retarder can immediately deliver."
    DrvrsDmandRetarderPercentTorque_ERC1_DR_ITR_PCAN: init-value=0, length=8, base-type=uint8, system-signal=DrvrsDmandRetarderPercentTorque_ERC1_DR_ITR_PCAN
    SrcAddrssOfCtrllngDvcFrRtrdrCtrl_ERC1_DR_ITR_PCAN: init-value=0, length=8, base-type=uint8, system-signal=SrcAddrssOfCtrllngDvcFrRtrdrCtrl_ERC1_DR_ITR_PCAN  # The source address of the SAE J1939 device currently controlling the retarder."
    RetarderRqingBrakeLight_ERC1_DR_ITR_PCAN: init-value=0, length=2, base-type=uint8, system-signal=RetarderRqingBrakeLight_ERC1_DR_ITR_PCAN
    EngCoolantLoadIncrease_ERC1_DR_ITR_PCAN: init-value=0, length=2, base-type=uint8, system-signal=EngCoolantLoadIncrease_ERC1_DR_ITR_PCAN  # Status of an event, external to the engine, that may increase the nominal temperature of the engine coolant liquid."
    IntendedRetarderPercentTorque_ERC1_DR_ITR_PCAN: init-value=0, length=8, base-type=uint8, system-signal=IntendedRetarderPercentTorque_ERC1_DR_ITR_PCAN  # Braking torque of retarder that the retarder is currently trying to achieve."
    ActualRetarderPercentTorque_DR_ERC1_DR_ITR_PCAN: init-value=0, length=8, base-type=uint8, system-signal=ActualRetarderPercentTorque_DR_ERC1_DR_ITR_PCAN  # Actual braking torque of the retarder as a percent of retarder configuration reference torque SPN 556."
    RetarderEnableShiftAssistSwitch_ERC1_DR_ITR_PCAN: init-value=0, length=2, base-type=uint8, system-signal=RetarderEnableShiftAssistSwitch_ERC1_DR_ITR_PCAN  # Switch signal which indicates whether the operator wishes the retarder to be enabled for transmission shift assist."
    RetarderEnableBrakeAssistSwitch_ERC1_DR_ITR_PCAN: init-value=0, length=2, base-type=uint8, system-signal=RetarderEnableBrakeAssistSwitch_ERC1_DR_ITR_PCAN  # Switch signal which indicates whether the operator wishes the retarder to be enabled for vehicle braking assist."
    RetarderTorqueMode_ERC1_DR_ITR_PCAN: init-value=0, length=4, base-type=uint8, system-signal=RetarderTorqueMode_ERC1_DR_ITR_PCAN  # State signal which indicates which retarder torque mode is currently generating, limiting, or controlling the torque."
    REQUEST_PGN_IVECO_RQST_I_IC_PCAN: init-value=0, length=24, base-type=uint32, system-signal=REQUEST_PGN_IVECO_RQST_I_IC_PCAN
    TachographVehicleSpeed_TCO1_IC_PCAN: init-value=0, length=16, base-type=uint16, system-signal=TachographVehicleSpeed_TCO1_IC_PCAN  # Speed of the vehicle registered by the tachograph."
    TachographOutputShaftSpeed_TCO1_IC_PCAN: init-value=0, length=16, base-type=uint16, system-signal=TachographOutputShaftSpeed_TCO1_IC_PCAN  # Calculated speed of the transmission output shaft."
    TransReadyForBrakeRelease_ETC7_BCM_CMD_PCAN: init-value=0, length=2, base-type=uint8, system-signal=TransReadyForBrakeRelease_ETC7_BCM_CMD_PCAN  # This parameter indicates that enough torque / motive force is available at the transmission output shaft to release all the"
    EngDemandPercentTorque_EEC1_ECU_PCAN: init-value=0, length=8, base-type=uint8, system-signal=EngDemandPercentTorque_EEC1_ECU_PCAN
    EngStarterMode_EEC1_ECU_PCAN: init-value=0, length=4, base-type=uint8, system-signal=EngStarterMode_EEC1_ECU_PCAN  # There are several phases in a starting action and different reasons why a start cannot take place."
    SrcAddrssOfCtrllngDvcForEngCtrl_EEC1_ECU_PCAN: init-value=0, length=8, base-type=uint8, system-signal=SrcAddrssOfCtrllngDvcForEngCtrl_EEC1_ECU_PCAN  # The source address of the SAE J1939 device currently controlling the engine."
    EngSpeed_EEC1_ECU_PCAN: init-value=0, length=16, base-type=uint16, system-signal=EngSpeed_EEC1_ECU_PCAN  # Actual engine speed which is calculated over a minimum crankshaft angle of 720 degrees divided by the number of cylinders."
    ActualEngPercentTorque_EEC1_ECU_PCAN: init-value=0, length=8, base-type=uint8, system-signal=ActualEngPercentTorque_EEC1_ECU_PCAN  # The calculated output torque of the engine."
    DriversDemandEngPercentTorque_EEC1_ECU_PCAN: init-value=0, length=8, base-type=uint8, system-signal=DriversDemandEngPercentTorque_EEC1_ECU_PCAN  # The requested torque output of the engine by the driver."
    EngTorqueMode_EEC1_ECU_PCAN: init-value=0, length=4, base-type=uint8, system-signal=EngTorqueMode_EEC1_ECU_PCAN  # State signal which indicates which engine torque mode is currently generating, limiting, or controlling the torque."
    ActualEnginePercentTorqueHiRes_EEC1_ECU_PCAN: init-value=0, length=4, base-type=uint8, system-signal=ActualEnginePercentTorqueHiRes_EEC1_ECU_PCAN  # This parameter displays an additional torque in percent of the reference engine torque."
    REQUEST_PGN_DOOSAN_RQST_D_IC_PCAN: init-value=0, length=24, base-type=uint32, system-signal=REQUEST_PGN_DOOSAN_RQST_D_IC_PCAN
    ParkingBrakeRedWarningSignal_Brakes_RTM_PCAN: init-value=0, length=2, base-type=uint8, system-signal=ParkingBrakeRedWarningSignal_Brakes_RTM_PCAN  # This parameter commands the Parking Brake red optical warning signal."
    ParkBrakeReleaseInhibitStatus_Brakes_RTM_PCAN: init-value=0, length=2, base-type=uint8, system-signal=ParkBrakeReleaseInhibitStatus_Brakes_RTM_PCAN  # This parameter provides reports on the status of the Park Brake Release Inhibit function."
    ParkingBrakeActuator_Brakes_RTM_PCAN: init-value=0, length=2, base-type=uint8, system-signal=ParkingBrakeActuator_Brakes_RTM_PCAN  # Signal which indicates the current state of the actuator(s) that control the parking brake (see also SPN 70)."
    BrakeSecondPress_Brakes_RTM_PCAN: init-value=0, length=8, base-type=uint8, system-signal=BrakeSecondPress_Brakes_RTM_PCAN  # Gage pressure of air in the secondary, or service side, of the air brake system."
    BrakePrimaryPress_Brakes_RTM_PCAN: init-value=0, length=8, base-type=uint8, system-signal=BrakePrimaryPress_Brakes_RTM_PCAN  # Gage pressure of air in the primary, or supply side, of the air brake system."
    BrakeAppPress_Brakes_RTM_PCAN: init-value=0, length=8, base-type=uint8, system-signal=BrakeAppPress_Brakes_RTM_PCAN
    AirCompressorStatus_AIR1_IC_PCAN: init-value=0, length=2, base-type=uint8, system-signal=AirCompressorStatus_AIR1_IC_PCAN  # Indicates whether the air compressor is actively compressing air."
    AirSuspensionSupplyPress_AIR1_IC_PCAN: init-value=0, length=8, base-type=uint8, system-signal=AirSuspensionSupplyPress_AIR1_IC_PCAN  # The pneumatic pressure in the circuit for the electronically controlled air suspension system."
    AuxEquipmentSupplyPress_AIR1_IC_PCAN: init-value=0, length=8, base-type=uint8, system-signal=AuxEquipmentSupplyPress_AIR1_IC_PCAN  # The pneumatic pressure in the auxiliary circuit."
    ServiceBrkAirPressCrk2_AIR2_FRT_AIR1_IC_PCAN: init-value=0, length=8, base-type=uint8, system-signal=ServiceBrkAirPressCrk2_AIR2_FRT_AIR1_IC_PCAN  # The pneumatic pressure in the service brake circuit or reservoir #2."
    ServiceBrkAirPressCrk1_AIR1_RR_AIR1_IC_PCAN: init-value=0, length=8, base-type=uint8, system-signal=ServiceBrkAirPressCrk1_AIR1_RR_AIR1_IC_PCAN  # The pneumatic pressure in the service brake circuit or reservoir #1."
    ParkingAnd_OrTrailerAirPress_AIR1_IC_PCAN: init-value=0, length=8, base-type=uint8, system-signal=ParkingAnd_OrTrailerAirPress_AIR1_IC_PCAN  # The pneumatic pressure in the circuit or reservoir for the parking brake and/or the trailer supply."
    PneumaticSupplyPress_AIR1_IC_PCAN: init-value=0, length=8, base-type=uint8, system-signal=PneumaticSupplyPress_AIR1_IC_PCAN  # The pneumatic pressure in the main reservoir, sometimes referred to as the wet tank."
    RoadSurfaceTemp_AMB_ECU_PCAN: init-value=0, length=16, base-type=uint16, system-signal=RoadSurfaceTemp_AMB_ECU_PCAN  # Indicated temperature of road surface over which vehicle is operating."
    EngAirInletTemp_AMB_ECU_PCAN: init-value=0, length=8, base-type=uint8, system-signal=EngAirInletTemp_AMB_ECU_PCAN  # Temperature of air entering vehicle air induction system."
    AmbientAirTemp_AMB_ECU_PCAN: init-value=0, length=16, base-type=uint16, system-signal=AmbientAirTemp_AMB_ECU_PCAN  # Temperature of air surrounding vehicle."
    CabInteriorTemp_AMB_ECU_PCAN: init-value=0, length=16, base-type=uint16, system-signal=CabInteriorTemp_AMB_ECU_PCAN  # Temperature of air inside the part of the vehicle that encloses the driver and vehicle operating controls."
    BarometricPress_AMB_ECU_PCAN: init-value=0, length=8, base-type=uint8, system-signal=BarometricPress_AMB_ECU_PCAN  # Absolute air pressure of the atmosphere."
    PredictiveCCSetSpeedOffsetStatus_CCVS3_ECU_PCAN: init-value=0, length=2, base-type=uint8, system-signal=PredictiveCCSetSpeedOffsetStatus_CCVS3_ECU_PCAN
    CruiseControlSpeed_CCVS3_ECU_PCAN: init-value=0, length=16, base-type=uint16, system-signal=CruiseControlSpeed_CCVS3_ECU_PCAN
    SAofCtrlDeviceforDisablingCC_CCVS3_ECU_PCAN: init-value=0, length=8, base-type=uint8, system-signal=SAofCtrlDeviceforDisablingCC_CCVS3_ECU_PCAN
    CCSetSPEED_CCVS3_ECU_PCAN: init-value=0, length=16, base-type=uint16, system-signal=CCSetSPEED_CCVS3_ECU_PCAN
    CCdriverCancellationStatus_CCVS3_ECU_PCAN: init-value=0, length=2, base-type=uint8, system-signal=CCdriverCancellationStatus_CCVS3_ECU_PCAN
    AEBSReadinessState_CCVS3_ECU_PCAN: init-value=0, length=2, base-type=uint8, system-signal=AEBSReadinessState_CCVS3_ECU_PCAN
    SAOfCtrlDeviceForPausingCC_CCVS3_ECU_PCAN: init-value=0, length=8, base-type=uint8, system-signal=SAOfCtrlDeviceForPausingCC_CCVS3_ECU_PCAN
    ACC_Readiness_Status_CCVS3_ECU_PCAN: init-value=0, length=2, base-type=uint8, system-signal=ACC_Readiness_Status_CCVS3_ECU_PCAN
    CruiseCtrlSysCmdState_CCVS3_ECU_PCAN: init-value=0, length=3, base-type=uint8, system-signal=CruiseCtrlSysCmdState_CCVS3_ECU_PCAN
    EngShutdownOverrideSwitch_TxCCVS_ECU_PCAN: init-value=0, length=2, base-type=uint8, system-signal=EngShutdownOverrideSwitch_TxCCVS_ECU_PCAN  # Switch signal which indicates the position of the engine shutdown override switch. This switch function allows theSwitch signal which indicates the position of the engine shutdown override switch."
    EngTestModeSwitch_TxCCVS_ECU_PCAN: init-value=0, length=2, base-type=uint8, system-signal=EngTestModeSwitch_TxCCVS_ECU_PCAN  # Switch signal which indicates the position of the engine test mode switch.Switch signal which indicates the position of the engine test mode switch."
    EngIdleDecrementSwitch_TxCCVS_ECU_PCAN: init-value=0, length=2, base-type=uint8, system-signal=EngIdleDecrementSwitch_TxCCVS_ECU_PCAN  # Switch signal which indicates the position of the idle decrement switch.Switch signal which indicates the position of the idle decrement switch."
    EngIdleIncrementSwitch_TxCCVS_ECU_PCAN: init-value=0, length=2, base-type=uint8, system-signal=EngIdleIncrementSwitch_TxCCVS_ECU_PCAN  # Switch signal which indicates the position of the idle increment switch.Switch signal which indicates the position of the idle increment switch."
    CruiseCtrlStates_TxCCVS_ECU_PCAN: init-value=0, length=3, base-type=uint8, system-signal=CruiseCtrlStates_TxCCVS_ECU_PCAN  # This parameter is used to indicate the current state, or mode, of operation by the cruise control device. This is a statusThis parameter is used to indicate the current state, or mode, of operation by the cruise control device."
    PTOGovernorState_TxCCVS_ECU_PCAN: init-value=0, length=5, base-type=uint8, system-signal=PTOGovernorState_TxCCVS_ECU_PCAN  # This parameter is used to indicate the current state or mode of operation by the power takeoff (PTO) governor. In lieu of"
    CruiseCtrlSetSpeed_TxCCVS_ECU_PCAN: init-value=0, length=8, base-type=uint8, system-signal=CruiseCtrlSetSpeed_TxCCVS_ECU_PCAN  # Value of set (chosen) velocity of velocity control system.Value of set (chosen) velocity of velocity control system."
    CruiseCtrlAccelerateSwitch_TxCCVS_ECU_PCAN: init-value=0, length=2, base-type=uint8, system-signal=CruiseCtrlAccelerateSwitch_TxCCVS_ECU_PCAN  # Switch signal of the cruise control activator which indicates that the activator is in the position accelerate.Switch signal of the cruise control activator which indicates that the activator is in the position accelerate."
    CruiseCtrlResumeSwitch_TxCCVS_ECU_PCAN: init-value=0, length=2, base-type=uint8, system-signal=CruiseCtrlResumeSwitch_TxCCVS_ECU_PCAN  # Switch signal of the cruise control activator which indicates that the activator is in the position resume.Switch signal of the cruise control activator which indicates that the activator is in the position resume."
    CruiseCtrlCoastSwitch_TxCCVS_ECU_PCAN: init-value=0, length=2, base-type=uint8, system-signal=CruiseCtrlCoastSwitch_TxCCVS_ECU_PCAN  # Switch signal of the cruise control activator which indicates that the activator is in the position coast (decelerate).Switch signal of the cruise control activator which indicates that the activator is in the position coast (decelerate)."
    CruiseCtrlSetSwitch_TxCCVS_ECU_PCAN: init-value=0, length=2, base-type=uint8, system-signal=CruiseCtrlSetSwitch_TxCCVS_ECU_PCAN  # Switch signal of the cruise control activator which indicates that the activator is in the position set.Switch signal of the cruise control activator which indicates that the activator is in the position set."
    ClutchSwitch_TxCCVS_ECU_PCAN: init-value=0, length=2, base-type=uint8, system-signal=ClutchSwitch_TxCCVS_ECU_PCAN  # Switch signal which indicates that the clutch pedal is being pressed. It is necessary for a safe drivetrain behavior that theSwitch signal which indicates that the clutch pedal is being pressed."
    BrakeSwitch_TxCCVS_ECU_PCAN: init-value=0, length=2, base-type=uint8, system-signal=BrakeSwitch_TxCCVS_ECU_PCAN  # Switch signal which indicates that the driver operated brake foot pedal is being pressed. This brake foot pedal isSwitch signal which indicates that the driver operated brake foot pedal is being pressed."
    CruiseCtrlEnableSwitch_TxCCVS_ECU_PCAN: init-value=0, length=2, base-type=uint8, system-signal=CruiseCtrlEnableSwitch_TxCCVS_ECU_PCAN  # Switch signal which indicates that it is possible to manage the cruise control function.Switch signal which indicates that it is possible to manage the cruise control function."
    CruiseCtrlActive_TxCCVS_ECU_PCAN: init-value=0, length=2, base-type=uint8, system-signal=CruiseCtrlActive_TxCCVS_ECU_PCAN  # Cruise control is switched on. It is not ensured that the engine is controlled by cruise control, as in the case of a largeCruise control is switched on."
    WheelBasedVehicleSpeed_TxCCVS_ECU_PCAN: init-value=0, length=16, base-type=uint16, system-signal=WheelBasedVehicleSpeed_TxCCVS_ECU_PCAN  # Speed of the vehicle as calculated from wheel or tailshaft speed.Speed of the vehicle as calculated from wheel or tailshaft speed."
    ParkBrakeReleaseInhibitRq_TxCCVS_ECU_PCAN: init-value=0, length=2, base-type=uint8, system-signal=ParkBrakeReleaseInhibitRq_TxCCVS_ECU_PCAN  # Park Brake Release Inhibit Request signals the desire that an applied park brake remain applied and limit the ability of the"
    CruiseCtrlPauseSwitch_TxCCVS_ECU_PCAN: init-value=0, length=2, base-type=uint8, system-signal=CruiseCtrlPauseSwitch_TxCCVS_ECU_PCAN  # Switch signal which indicates the position of the Cruise Control Pause Switch used on Remote Cruise ControlSwitch signal which indicates the position of the Cruise Control Pause Switch used on Remote Cruise Control applications."
    ParkingBrakeSwitch_TxCCVS_ECU_PCAN: init-value=0, length=2, base-type=uint8, system-signal=ParkingBrakeSwitch_TxCCVS_ECU_PCAN  # Switch signal which indicates when the parking brake is set. In general the switch actuated by the operator's park brakeSwitch signal which indicates when the parking brake is set."
    TwoSpeedAxleSwitch_TxCCVS_ECU_PCAN: init-value=0, length=2, base-type=uint8, system-signal=TwoSpeedAxleSwitch_TxCCVS_ECU_PCAN  # Switch signal which indicates the current axle range.Switch signal which indicates the current axle range."
    NominalFrictionPercentTorque_EEC3_ECU_PCAN: init-value=0, length=8, base-type=uint8, system-signal=NominalFrictionPercentTorque_EEC3_ECU_PCAN  # The calculated torque that indicates the amount of torque required by the basic engine itself added by the loss torque of"
    Aftertreatment2ExhaustDewPoint_EEC3_ECU_PCAN: init-value=0, length=2, base-type=uint8, system-signal=Aftertreatment2ExhaustDewPoint_EEC3_ECU_PCAN  # Indicates that the temperature on the exhaust side of the aftertreatment has exceeded the dew point, as estimated by the"
    Aftertreatment2IntakeDewPoint_EEC3_ECU_PCAN: init-value=0, length=2, base-type=uint8, system-signal=Aftertreatment2IntakeDewPoint_EEC3_ECU_PCAN  # Indicates that the temperature on the intake side of the aftertreatment system has exceeded the dew point, as estimated"
    Aftertreatment1ExhaustDewPoint_EEC3_ECU_PCAN: init-value=0, length=2, base-type=uint8, system-signal=Aftertreatment1ExhaustDewPoint_EEC3_ECU_PCAN  # Indicates that the temperature on the exhaust side of the aftertreatment has exceeded the dew point, as estimated by the"
    Aftertreatment1IntakeDewPoint_EEC3_ECU_PCAN: init-value=0, length=2, base-type=uint8, system-signal=Aftertreatment1IntakeDewPoint_EEC3_ECU_PCAN  # Indicates that the temperature on the intake side of the aftertreatment system has exceeded the dew point, as estimated"
    Aftrtreatment1ExhaustGasMassFlow_EEC3_ECU_PCAN: init-value=0, length=16, base-type=uint16, system-signal=Aftrtreatment1ExhaustGasMassFlow_EEC3_ECU_PCAN  # Measured/calculated exhaust gas mass upstream of the aftertreatment system in exhaust bank 1 and 2."
    EstEngPrsiticLossesPercentTorque_EEC3_ECU_PCAN: init-value=125, length=8, base-type=uint8, system-signal=EstEngPrsiticLossesPercentTorque_EEC3_ECU_PCAN  # The calculated torque that indicates the estimated amount of torque loss due to engine parasitics, such as cooling fan, air"
    EngnsDsrdOprtngSpdAsymmtryAdjstm_EEC3_ECU_PCAN: init-value=0, length=8, base-type=uint8, system-signal=EngnsDsrdOprtngSpdAsymmtryAdjstm_EEC3_ECU_PCAN  # This byte is utilized in transmission gear selection routines and indicates the engine's preference of lower versus higher"
    EnginesDesiredOperatingSpeed_EEC3_ECU_PCAN: init-value=0, length=16, base-type=uint16, system-signal=EnginesDesiredOperatingSpeed_EEC3_ECU_PCAN  # An indication by the engine of the optimal operating speed of the engine for the current existing conditions. These"
    SupportVariableRateTSC1Message_EC1_ECU_PCAN: init-value=0, length=8, base-type=uint8, system-signal=SupportVariableRateTSC1Message_EC1_ECU_PCAN  # This parameter indicates which TSC1 transmission rates are supported by the engine ECU in addition to the required"
    EngDefaultTorqueLimit_EC1_ECU_PCAN: init-value=0, length=16, base-type=uint16, system-signal=EngDefaultTorqueLimit_EC1_ECU_PCAN  # Companion parameter to Transmission Torque Limit (SPN 1845).Companion parameter to Transmission Torque Limit (SPN 1845). This echo parameter provides confirmation to theCompanion parameter to Transmission Torque Limit (SPN 1845)."
    EngMomentOfInertia_EC1_ECU_PCAN: init-value=0, length=16, base-type=uint16, system-signal=EngMomentOfInertia_EC1_ECU_PCAN  # Moment of inertia for the engine, including items driven full-time by the engine such as fuel, oil and cooling pumps.Moment of inertia for the engine, including items driven full-time by the engine such as fuel, oil and cooling pumps. TheMoment of inertia for the engine, including items driven full-time by the engine such as fuel, oil and cooling pumps."
    EngReferenceTorque_EC1_ECU_PCAN: init-value=0, length=16, base-type=uint16, system-signal=EngReferenceTorque_EC1_ECU_PCAN  # This parameter is the 100% reference value for all defined indicated engine torque parameters.This parameter is the 100% reference value for all defined indicated engine torque parameters. It is only defined onceThis parameter is the 100% reference value for all defined indicated engine torque parameters."
    EngSpeedAtHighIdlePoint6_EC1_ECU_PCAN: init-value=0, length=16, base-type=uint16, system-signal=EngSpeedAtHighIdlePoint6_EC1_ECU_PCAN  # Engine speed of high idle (point 6) of the engine torque map (see PGN 65251 and supporting document).Engine speed of high idle (point 6) of the engine torque map (see PGN 65251 and supporting document). In engineEngine speed of high idle (point 6) of the engine torque map (see PGN 65251 and supporting document)."
    EngPercentTorqueAtPoint5_EC1_ECU_PCAN: init-value=125, length=8, base-type=uint8, system-signal=EngPercentTorqueAtPoint5_EC1_ECU_PCAN  # The torque limit that indicates the available engine torque which can be provided by the engine at point 3, 4, and 5 of the"
    EngSpeedAtPoint5_EC1_ECU_PCAN: init-value=0, length=16, base-type=uint16, system-signal=EngSpeedAtPoint5_EC1_ECU_PCAN  # Engine speed of point 3, 4, and 5 of the engine torque map (see PGN 65251 and supporting document).Engine speed of point 3, 4, and 5 of the engine torque map (see PGN 65251 and supporting document). It isEngine speed of point 3, 4, and 5 of the engine torque map (see PGN 65251 and supporting document)."
    EngPercentTorqueAtPoint4_EC1_ECU_PCAN: init-value=125, length=8, base-type=uint8, system-signal=EngPercentTorqueAtPoint4_EC1_ECU_PCAN  # The torque limit that indicates the available engine torque which can be provided by the engine at point 3, 4, and 5 of the"
    EngSpeedAtPoint4_EC1_ECU_PCAN: init-value=0, length=16, base-type=uint16, system-signal=EngSpeedAtPoint4_EC1_ECU_PCAN  # Engine speed of point 3, 4, and 5 of the engine torque map (see PGN 65251 and supporting document).Engine speed of point 3, 4, and 5 of the engine torque map (see PGN 65251 and supporting document). It isEngine speed of point 3, 4, and 5 of the engine torque map (see PGN 65251 and supporting document)."
    EngPercentTorqueAtPoint3_EC1_ECU_PCAN: init-value=125, length=8, base-type=uint8, system-signal=EngPercentTorqueAtPoint3_EC1_ECU_PCAN  # The torque limit that indicates the available engine torque which can be provided by the engine at point 3, 4, and 5 of the"
    EngSpeedAtPoint3_EC1_ECU_PCAN: init-value=0, length=16, base-type=uint16, system-signal=EngSpeedAtPoint3_EC1_ECU_PCAN  # Engine speed of point 3, 4, and 5 of the engine torque map (see PGN 65251 and supporting document).Engine speed of point 3, 4, and 5 of the engine torque map (see PGN 65251 and supporting document). It isEngine speed of point 3, 4, and 5 of the engine torque map (see PGN 65251 and supporting document)."
    EngPercentTorqueAtPoint2_EC1_ECU_PCAN: init-value=125, length=8, base-type=uint8, system-signal=EngPercentTorqueAtPoint2_EC1_ECU_PCAN  # The torque limit that indicates the available engine torque which can be provided by the engine at point 2 of the engine"
    EngSpeedAtPoint2_EC1_ECU_PCAN: init-value=0, length=16, base-type=uint16, system-signal=EngSpeedAtPoint2_EC1_ECU_PCAN  # Engine speed of point 2 of the engine torque map (see PGN 65251 and supporting document).Engine speed of point 2 of the engine torque map (see PGN 65251 and supporting document). In engine configurationEngine speed of point 2 of the engine torque map (see PGN 65251 and supporting document)."
    EngPercentTorqueAtIdlePoint1_EC1_ECU_PCAN: init-value=125, length=8, base-type=uint8, system-signal=EngPercentTorqueAtIdlePoint1_EC1_ECU_PCAN  # The torque limit that indicates the available engine torque which can be provided by the engine at idle speed.The torque limit that indicates the available engine torque which can be provided by the engine at idle speed. ThisThe torque limit that indicates the available engine torque which can be provided by the engine at idle speed."
    EngSpeedAtIdlePoint1_EC1_ECU_PCAN: init-value=0, length=16, base-type=uint16, system-signal=EngSpeedAtIdlePoint1_EC1_ECU_PCAN  # Stationary low idle speed of engine which includes influences due to engine temperature (after power up) and other"
    SupportTSC1CtrlPurposeGroup4_EC1_ECU_PCAN: init-value=0, length=8, base-type=uint8, system-signal=SupportTSC1CtrlPurposeGroup4_EC1_ECU_PCAN  # This parameter indicates which TSC1 control purposes are supported in group 4 of 4. One bit is used to convey the"
    SupportTSC1CtrlPurposeGroup3_EC1_ECU_PCAN: init-value=0, length=8, base-type=uint8, system-signal=SupportTSC1CtrlPurposeGroup3_EC1_ECU_PCAN  # This parameter indicates which TSC1 control purposes are supported in group 3 of 4. One bit is used to convey the"
    SupportTSC1CtrlPurposeGroup2_EC1_ECU_PCAN: init-value=0, length=8, base-type=uint8, system-signal=SupportTSC1CtrlPurposeGroup2_EC1_ECU_PCAN  # This parameter indicates which TSC1 control purposes are supported in group 2 of 4. One bit is used to convey the"
    SupportTSC1CtrlPurposeGroup1_EC1_ECU_PCAN: init-value=0, length=8, base-type=uint8, system-signal=SupportTSC1CtrlPurposeGroup1_EC1_ECU_PCAN  # This parameter indicates which TSC1 control purposes are supported in group 1 of 4. One bit is used to convey the"
    EngExRngRqstdSpdCtrlRngUpprLimit_EC1_ECU_PCAN: init-value=0, length=16, base-type=uint16, system-signal=EngExRngRqstdSpdCtrlRngUpprLimit_EC1_ECU_PCAN  # The maximum engine speed regardless of load that the engine will allow when operating in a speed control/limit mode,"
    EngRqstdTrqueCtrlRangeUpperLimit_EC1_ECU_PCAN: init-value=125, length=8, base-type=uint8, system-signal=EngRqstdTrqueCtrlRangeUpperLimit_EC1_ECU_PCAN  # The maximum engine torque that the engine will allow when operating in a torque control/limit mode."
    EngRqstdTrqueCtrlRangeLowerLimit_EC1_ECU_PCAN: init-value=125, length=8, base-type=uint8, system-signal=EngRqstdTrqueCtrlRangeLowerLimit_EC1_ECU_PCAN  # The minimum engine torque that the engine will allow when operating in a torque control/limit mode."
    EngRqstdSpeedCtrlRangeUpperLimit_EC1_ECU_PCAN: init-value=0, length=8, base-type=uint8, system-signal=EngRqstdSpeedCtrlRangeUpperLimit_EC1_ECU_PCAN  # The maximum engine speed regardless of load that the engine will allow when operating in a speed control/limit mode,"
    EngRqstdSpeedCtrlRangeLowerLimit_EC1_ECU_PCAN: init-value=0, length=8, base-type=uint8, system-signal=EngRqstdSpeedCtrlRangeLowerLimit_EC1_ECU_PCAN  # The minimum engine speed that the engine will allow when operating in a speed control/limit mode."
    EngMaxMomentaryOverrideTimeLimit_EC1_ECU_PCAN: init-value=0, length=8, base-type=uint8, system-signal=EngMaxMomentaryOverrideTimeLimit_EC1_ECU_PCAN  # The maximum time limit allowed to override the engine's high idle speed."
    EngMxMmentaryOverrideSpeedPoint7_EC1_ECU_PCAN: init-value=0, length=16, base-type=uint16, system-signal=EngMxMmentaryOverrideSpeedPoint7_EC1_ECU_PCAN  # The maximum engine speed above high idle allowed by the engine control during a momentary high idle override. This"
    EngGain_EC1_ECU_PCAN: init-value=0, length=16, base-type=uint16, system-signal=EngGain_EC1_ECU_PCAN  # The endspeed governor is defined as a linear line with the following equations (Capital letters mean physical values, small"
    AccelPedalPos2_EEC2_ECU_PCAN: init-value=0, length=8, base-type=uint8, system-signal=AccelPedalPos2_EEC2_ECU_PCAN  # The ratio of actual position of the second analog engine speed/torque request input device (such as an accelerator pedal"
    EngPercentLoadAtCurrentSpeed_EEC2_ECU_PCAN: init-value=0, length=8, base-type=uint8, system-signal=EngPercentLoadAtCurrentSpeed_EEC2_ECU_PCAN  # The ratio of actual engine percent torque (indicated) to maximum indicated torque available at the current engine speed,"
    AccelPedal2LowIdleSwitch_EEC2_ECU_PCAN: init-value=0, length=2, base-type=uint8, system-signal=AccelPedal2LowIdleSwitch_EEC2_ECU_PCAN  # Switch signal which indicates the state of the accelerator pedal 2 low idle switch.Switch signal which indicates the state of the accelerator pedal 2 low idle switch. The low idle switch is defined in SAESwitch signal which indicates the state of the accelerator pedal 2 low idle switch."
    RoadSpeedLimitStatus_EEC2_ECU_PCAN: init-value=0, length=2, base-type=uint8, system-signal=RoadSpeedLimitStatus_EEC2_ECU_PCAN  # Status (active or not active) of the system used to limit maximum vehicle velocity.Status (active or not active) of the system used to limit maximum vehicle velocity.Status (active or not active) of the system used to limit maximum vehicle velocity."
    AccelPedalKickdownSwitch_EEC2_ECU_PCAN: init-value=0, length=2, base-type=uint8, system-signal=AccelPedalKickdownSwitch_EEC2_ECU_PCAN  # Switch signal which indicates whether the accelerator pedal kickdown switch is opened or closed.Switch signal which indicates whether the accelerator pedal kickdown switch is opened or closed. The kickdown switch isSwitch signal which indicates whether the accelerator pedal kickdown switch is opened or closed."
    AccelPedal1LowIdleSwitch_EEC2_ECU_PCAN: init-value=0, length=2, base-type=uint8, system-signal=AccelPedal1LowIdleSwitch_EEC2_ECU_PCAN  # Switch signal which indicates the state of the accelerator pedal 1 low idle switch.Switch signal which indicates the state of the accelerator pedal 1 low idle switch. The low idle switch is defined in SAESwitch signal which indicates the state of the accelerator pedal 1 low idle switch."
    RemoteAccelPedalPos_EEC2_ECU_PCAN: init-value=0, length=8, base-type=uint8, system-signal=RemoteAccelPedalPos_EEC2_ECU_PCAN  # The ratio of actual position of the remote analog engine speed/torque request input device (such as an accelerator pedal"
    AccelPedalPos1_EEC2_ECU_PCAN: init-value=0, length=8, base-type=uint8, system-signal=AccelPedalPos1_EEC2_ECU_PCAN  # The ratio of actual position of the analog engine speed/torque request input device (such as an accelerator pedal or"
    EstPumpingPercentTorque_EEC2_ECU_PCAN: init-value=0, length=8, base-type=uint8, system-signal=EstPumpingPercentTorque_EEC2_ECU_PCAN  # The calculated torque that indicates the estimated amount of torque loss due to the engine air handling system. The value"
    ActlMaxAvailableEngPercentTorque_EEC2_ECU_PCAN: init-value=0, length=8, base-type=uint8, system-signal=ActlMaxAvailableEngPercentTorque_EEC2_ECU_PCAN  # This is the maximum amount of torque that the engine can immediately deliver as a percentage of the reference engine"
    SCRThermalManagementActive_EEC2_ECU_PCAN: init-value=0, length=2, base-type=uint8, system-signal=SCRThermalManagementActive_EEC2_ECU_PCAN  # Indicates that the exhaust temperatures have been elevated for regeneration of the SCR aftertreatment system or in"
    DPFThermalManagementActive_EEC2_ECU_PCAN: init-value=0, length=2, base-type=uint8, system-signal=DPFThermalManagementActive_EEC2_ECU_PCAN  # Indicates that the exhaust temperatures have been elevated for regeneration of the diesel particulate filter aftertreatment"
    MmntaryEngMaxPowerEnableFeedback_EEC2_ECU_PCAN: init-value=0, length=2, base-type=uint8, system-signal=MmntaryEngMaxPowerEnableFeedback_EEC2_ECU_PCAN  # Momentarily requesting Engine Maximum Power Enable - feature support feedback"
    VhcleAccelerationRateLimitStatus_EEC2_ECU_PCAN: init-value=0, length=2, base-type=uint8, system-signal=VhcleAccelerationRateLimitStatus_EEC2_ECU_PCAN  # Status (active or not active) of the system used to limit maximum forward vehicle acceleration."
    TransCurrentRange_EATON_ETC2_TCU_PCAN: init-value=0, length=16, base-type=uint16, system-signal=TransCurrentRange_EATON_ETC2_TCU_PCAN  # Range currently being commanded by the transmission control system."
    TransRqedRange_ETC2_TCU_PCAN: init-value=0, length=16, base-type=uint16, system-signal=TransRqedRange_ETC2_TCU_PCAN  # Range selected by the operator."
    TransCurrentGear_ETC2_TCU_PCAN: init-value=0, length=8, base-type=uint8, system-signal=TransCurrentGear_ETC2_TCU_PCAN
    TransActualGearRatio_ETC2_TCU_PCAN: init-value=0, length=16, base-type=uint16, system-signal=TransActualGearRatio_ETC2_TCU_PCAN  # Actual ratio of input shaft speed to output shaft speed."
    TransSelectedGear_ETC2_TCU_PCAN: init-value=0, length=8, base-type=uint8, system-signal=TransSelectedGear_ETC2_TCU_PCAN
    HghRslutionTotalVehicleDistance_VDHR_IC_PCAN: init-value=0, length=32, base-type=uint32, system-signal=HghRslutionTotalVehicleDistance_VDHR_IC_PCAN  # Accumulated distance traveled by the vehicle during its operation."
    IC_Door_Open_Status_IC2BC_IC_PCAN: init-value=0, length=2, base-type=uint8, system-signal=IC_Door_Open_Status_IC2BC_IC_PCAN
    IC_OBD_Lamp_Status_IC2BC_IC_PCAN: init-value=0, length=2, base-type=uint8, system-signal=IC_OBD_Lamp_Status_IC2BC_IC_PCAN
    ADASSoundLevelSetting_IC2SP1_IC_PCAN: init-value=0, length=3, base-type=uint8, system-signal=ADASSoundLevelSetting_IC2SP1_IC_PCAN  # ADASSoundLevelSetting"
    ADASSoundTypeSetting_IC2SP1_IC_PCAN: init-value=0, length=3, base-type=uint8, system-signal=ADASSoundTypeSetting_IC2SP1_IC_PCAN  # ADASSoundTypeSetting"
    IC2SP2_SeatBeltLampStatus_IC2SP2_IC_PCAN: init-value=0, length=2, base-type=uint8, system-signal=IC2SP2_SeatBeltLampStatus_IC2SP2_IC_PCAN
    REQUEST_PGN_EBC4_RQST_EBC4_IC_PCAN: init-value=0, length=24, base-type=uint32, system-signal=REQUEST_PGN_EBC4_RQST_EBC4_IC_PCAN
    SM2BC_DoorLockUnlockRequest_SM2BC_SMK_PCAN: init-value=0, length=2, base-type=uint8, system-signal=SM2BC_DoorLockUnlockRequest_SM2BC_SMK_PCAN
    SM2BC_WindowUpDownRequest_SM2BC_SMK_PCAN: init-value=0, length=2, base-type=uint8, system-signal=SM2BC_WindowUpDownRequest_SM2BC_SMK_PCAN
    SM2BC_HazardBuzzerRequest_SM2BC_SMK_PCAN: init-value=0, length=4, base-type=uint8, system-signal=SM2BC_HazardBuzzerRequest_SM2BC_SMK_PCAN
    EngIdleDecrementSwitch_CCVS1_BCM_CMD_PCAN: init-value=0, length=2, base-type=uint8, system-signal=EngIdleDecrementSwitch_CCVS1_BCM_CMD_PCAN
    EngIdleIncrementSwitch_CCVS1_BCM_CMD_PCAN: init-value=0, length=2, base-type=uint8, system-signal=EngIdleIncrementSwitch_CCVS1_BCM_CMD_PCAN
    CruiseCtrlResumeSwitch_CCVS1_BCM_CMD_PCAN: init-value=0, length=2, base-type=uint8, system-signal=CruiseCtrlResumeSwitch_CCVS1_BCM_CMD_PCAN
    CruiseCtrlSetSwitch_CCVS1_BCM_CMD_PCAN: init-value=0, length=2, base-type=uint8, system-signal=CruiseCtrlSetSwitch_CCVS1_BCM_CMD_PCAN
    ClutchSwitch_CCVS1_BCM_CMD_PCAN: init-value=0, length=2, base-type=uint8, system-signal=ClutchSwitch_CCVS1_BCM_CMD_PCAN
    BrakeSwitch_CCVS1_BCM_CMD_PCAN: init-value=0, length=2, base-type=uint8, system-signal=BrakeSwitch_CCVS1_BCM_CMD_PCAN
    CruiseCtrlEnableSwitch_CCVS1_BCM_CMD_PCAN: init-value=0, length=2, base-type=uint8, system-signal=CruiseCtrlEnableSwitch_CCVS1_BCM_CMD_PCAN
    ParkingBrakeSwitch_CCVS1_BCM_CMD_PCAN: init-value=0, length=2, base-type=uint8, system-signal=ParkingBrakeSwitch_CCVS1_BCM_CMD_PCAN
    OprtrsDesiredDelayedLampOffTime_OEL_IC_PCAN: init-value=0, length=16, base-type=uint16, system-signal=OprtrsDesiredDelayedLampOffTime_OEL_IC_PCAN  # A 16 bit parameter to be associated with Delayed Off position (1000 binary) of the Main Light Switch."
    OperatorsDesiredBacklight_OEL_IC_PCAN: init-value=0, length=8, base-type=uint8, system-signal=OperatorsDesiredBacklight_OEL_IC_PCAN  # A 8 bit parameter to indicate the level of back lighting the operator has selected for displays."
    HighLowBeamSwitch_OEL_IC_PCAN: init-value=0, length=2, base-type=uint8, system-signal=HighLowBeamSwitch_OEL_IC_PCAN  # A 2 bit parameter to indicate the selected position of the operator's high/low beam select switch."
    HazardLightSwitch_OEL_IC_PCAN: init-value=0, length=2, base-type=uint8, system-signal=HazardLightSwitch_OEL_IC_PCAN  # A 2 bit parameter to indicate the selected position of the operator's hazard light switch."
    TurnSignalSwitch_OEL_IC_PCAN: init-value=0, length=4, base-type=uint8, system-signal=TurnSignalSwitch_OEL_IC_PCAN  # A 4 bit parameter to indicate the selected position of the operator's turn signal switch."
    MainLightSwitch_OEL_IC_PCAN: init-value=0, length=4, base-type=uint8, system-signal=MainLightSwitch_OEL_IC_PCAN  # A 4 bit parameter to indicate the selected position of the operator's main light switch."
    WorkLightSwitch_OEL_IC_PCAN: init-value=0, length=4, base-type=uint8, system-signal=WorkLightSwitch_OEL_IC_PCAN  # A 4 bit parameter to indicate the selected position of the operator's work light switch."
    CruiseCtrlPauseSwitch_CCVS1_SA2_RTM_PCAN: init-value=0, length=2, base-type=uint8, system-signal=CruiseCtrlPauseSwitch_CCVS1_SA2_RTM_PCAN  # Switch signal which indicates the position of the Cruise Control Pause Switch used on Remote Cruise Control applications."
    PTOState_CCVS1_SA2_RTM_PCAN: init-value=0, length=5, base-type=uint8, system-signal=PTOState_CCVS1_SA2_RTM_PCAN  # This parameter is used to indicate the current state or mode of operation by the power takeoff (PTO) device."
    EngIdleDecrementSwitch_CCVS1_SA2_RTM_PCAN: init-value=0, length=2, base-type=uint8, system-signal=EngIdleDecrementSwitch_CCVS1_SA2_RTM_PCAN  # Switch signal which indicates the position of the idle decrement switch."
    EngIdleIncrementSwitch_CCVS1_SA2_RTM_PCAN: init-value=0, length=2, base-type=uint8, system-signal=EngIdleIncrementSwitch_CCVS1_SA2_RTM_PCAN  # Switch signal which indicates the position of the idle increment switch."
    CruiseCtrlResumeSwitch_CCVS1_SA2_RTM_PCAN: init-value=0, length=2, base-type=uint8, system-signal=CruiseCtrlResumeSwitch_CCVS1_SA2_RTM_PCAN  # Switch signal of the cruise control activator which indicates that the activator is in the position resume."
    CruiseCtrlSetSwitch_CCVS1_SA2_RTM_PCAN: init-value=0, length=2, base-type=uint8, system-signal=CruiseCtrlSetSwitch_CCVS1_SA2_RTM_PCAN  # Switch signal of the cruise control activator which indicates that the activator is in the position set."
    ClutchSwitch_CCVS1_SA2_RTM_PCAN: init-value=0, length=2, base-type=uint8, system-signal=ClutchSwitch_CCVS1_SA2_RTM_PCAN  # Switch signal which indicates that the clutch pedal is being pressed."
    BrakeSwitch_CCVS1_SA2_RTM_PCAN: init-value=0, length=2, base-type=uint8, system-signal=BrakeSwitch_CCVS1_SA2_RTM_PCAN  # Switch signal which indicates that the driver operated brake foot pedal is being pressed."
    CruiseCtrlEnableSwitch_CCVS1_SA2_RTM_PCAN: init-value=0, length=2, base-type=uint8, system-signal=CruiseCtrlEnableSwitch_CCVS1_SA2_RTM_PCAN  # Switch signal which indicates that it is possible to manage the cruise control function."
    ParkingBrakeSwitch_CCVS1_SA2_RTM_PCAN: init-value=0, length=2, base-type=uint8, system-signal=ParkingBrakeSwitch_CCVS1_SA2_RTM_PCAN  # Switch signal which indicates when the parking brake is set."
    ProhibitAirSuspensionCtrl_ASC2_A_BCM_CMD_PCAN: init-value=0, length=2, base-type=uint8, system-signal=ProhibitAirSuspensionCtrl_ASC2_A_BCM_CMD_PCAN  # This parameter contains an external request to prohibit all air suspension control."
    KneelingCmdRearAxle_ASC2_A_BCM_CMD_PCAN: init-value=0, length=2, base-type=uint8, system-signal=KneelingCmdRearAxle_ASC2_A_BCM_CMD_PCAN  # Command signal to activate the kneeling functionality at the rear axle of the vehicle."
    KneelingCmdFrontAxle_ASC2_A_BCM_CMD_PCAN: init-value=0, length=2, base-type=uint8, system-signal=KneelingCmdFrontAxle_ASC2_A_BCM_CMD_PCAN
    DamperStiffnessRqLift_TagAxle_ASC2_A_BCM_CMD_PCAN: init-value=0, length=8, base-type=uint8, system-signal=DamperStiffnessRqLift_TagAxle_ASC2_A_BCM_CMD_PCAN
    DamperStiffnessRqRearAxle_ASC2_A_BCM_CMD_PCAN: init-value=0, length=8, base-type=uint8, system-signal=DamperStiffnessRqRearAxle_ASC2_A_BCM_CMD_PCAN  # Demand value for the shock absorber control at the rear axle."
    DamperStiffnessRqFrontAxle_ASC2_A_BCM_CMD_PCAN: init-value=0, length=8, base-type=uint8, system-signal=DamperStiffnessRqFrontAxle_ASC2_A_BCM_CMD_PCAN  # Demand value for the shock absorber control at the front axle."
    LevelCtrlModeRq_ASC2_A_BCM_CMD_PCAN: init-value=0, length=4, base-type=uint8, system-signal=LevelCtrlModeRq_ASC2_A_BCM_CMD_PCAN
    NominalLevelRqRearAxle_ASC2_A_BCM_CMD_PCAN: init-value=0, length=4, base-type=uint8, system-signal=NominalLevelRqRearAxle_ASC2_A_BCM_CMD_PCAN  # Command signal to activate a level of the rear axle programmed and/or memorised in the ECU."
    NominalLevelRqFrontAxle_ASC2_A_BCM_CMD_PCAN: init-value=0, length=4, base-type=uint8, system-signal=NominalLevelRqFrontAxle_ASC2_A_BCM_CMD_PCAN
    KneelingCtrlModeRq_ASC2_A_BCM_CMD_PCAN: init-value=0, length=2, base-type=uint8, system-signal=KneelingCtrlModeRq_ASC2_A_BCM_CMD_PCAN
    KneelingRqRightSide_ASC2_A_BCM_CMD_PCAN: init-value=0, length=2, base-type=uint8, system-signal=KneelingRqRightSide_ASC2_A_BCM_CMD_PCAN
    KneelingRqLeftSide_ASC2_A_BCM_CMD_PCAN: init-value=0, length=2, base-type=uint8, system-signal=KneelingRqLeftSide_ASC2_A_BCM_CMD_PCAN
    AutomaticTractionHelp_ASC2_A_BCM_CMD_PCAN: init-value=0, length=2, base-type=uint8, system-signal=AutomaticTractionHelp_ASC2_A_BCM_CMD_PCAN
    LiftAxle2PosCmd_ASC2_A_BCM_CMD_PCAN: init-value=0, length=2, base-type=uint8, system-signal=LiftAxle2PosCmd_ASC2_A_BCM_CMD_PCAN  # Signal to command the position / load condition of lift / tag axle #2."
    LiftAxle1PosCmd_ASC2_A_BCM_CMD_PCAN: init-value=0, length=2, base-type=uint8, system-signal=LiftAxle1PosCmd_ASC2_A_BCM_CMD_PCAN  # Signal to command the position/load condition of lift/tag axle #1."
    Transmission_Neutral_Switch_BC2CC_BCM_CMD_PCAN: init-value=0, length=2, base-type=uint8, system-signal=Transmission_Neutral_Switch_BC2CC_BCM_CMD_PCAN  # BC2CC_MESSAGE"
    Pintle_Hook_Off_Road_Switch_BC2CC_BCM_CMD_PCAN: init-value=0, length=2, base-type=uint8, system-signal=Pintle_Hook_Off_Road_Switch_BC2CC_BCM_CMD_PCAN  # BC2CC_MESSAGE Pintle Hook_CARGO Off Road Switch_DUMP"
    Range_Interlock_Switch_BC2CC_BCM_CMD_PCAN: init-value=0, length=2, base-type=uint8, system-signal=Range_Interlock_Switch_BC2CC_BCM_CMD_PCAN  # BC2CC_MESSAGE"
    Gate_Interlock_Switch_BC2CC_BCM_CMD_PCAN: init-value=0, length=2, base-type=uint8, system-signal=Gate_Interlock_Switch_BC2CC_BCM_CMD_PCAN  # BC2CC_MESSAGE"
    Range_PilotSwitch_BC2CC_BCM_CMD_PCAN: init-value=0, length=2, base-type=uint8, system-signal=Range_PilotSwitch_BC2CC_BCM_CMD_PCAN  # BC2CC_MESSAGE"
    Split_PilotSwitch_BC2CC_BCM_CMD_PCAN: init-value=0, length=2, base-type=uint8, system-signal=Split_PilotSwitch_BC2CC_BCM_CMD_PCAN  # BC2CC_MESSAGE"
    ReverseCastSwitch_BC2CC_BCM_CMD_PCAN: init-value=0, length=2, base-type=uint8, system-signal=ReverseCastSwitch_BC2CC_BCM_CMD_PCAN  # BC2CC_MESSAGE"
    LiftAxleSwitch_BC2CC_BCM_CMD_PCAN: init-value=0, length=2, base-type=uint8, system-signal=LiftAxleSwitch_BC2CC_BCM_CMD_PCAN  # BC2CC_MESSAGE"
    PTOSwitch_BC2CC_BCM_CMD_PCAN: init-value=0, length=2, base-type=uint8, system-signal=PTOSwitch_BC2CC_BCM_CMD_PCAN  # BC2CC_MESSAGE"
    RemoteThrottleEngageSwitch_BC2CC_BCM_CMD_PCAN: init-value=0, length=2, base-type=uint8, system-signal=RemoteThrottleEngageSwitch_BC2CC_BCM_CMD_PCAN  # BC2CC_MESSAGE"
    TireSensorIDprogrmmedStatus_TPM_TPMS_CCAN: init-value=0, length=2, base-type=uint8, system-signal=TireSensorIDprogrmmedStatus_TPM_TPMS_CCAN  # TireSensorIDprogrmmedStatus"
    TireOverTemperatureStatus_TPM_TPMS_CCAN: init-value=0, length=2, base-type=uint8, system-signal=TireOverTemperatureStatus_TPM_TPMS_CCAN  # TireOverTemperatureStatus"
    TirePressureStatus_TPM_TPMS_CCAN: init-value=0, length=4, base-type=uint8, system-signal=TirePressureStatus_TPM_TPMS_CCAN  # TirePressureStatus"
    TireReferencePressure_TPM_TPMS_CCAN: init-value=0, length=10, base-type=uint16, system-signal=TireReferencePressure_TPM_TPMS_CCAN  # TireReferencePressure"
    WheelUnitBatteryStatus_TPM_TPMS_CCAN: init-value=0, length=4, base-type=uint8, system-signal=WheelUnitBatteryStatus_TPM_TPMS_CCAN  # WheelUnitBatteryStatus"
    TirePressure_TPM_TPMS_CCAN: init-value=0, length=10, base-type=uint16, system-signal=TirePressure_TPM_TPMS_CCAN  # TirePressure"
    TireTemperature_TPM_TPMS_CCAN: init-value=40, length=8, base-type=uint8, system-signal=TireTemperature_TPM_TPMS_CCAN  # TireTemperature"
    TireWheelIdentification_TPM_TPMS_CCAN: init-value=0, length=8, base-type=uint8, system-signal=TireWheelIdentification_TPM_TPMS_CCAN  # TireWheelIdentification"
    DTC5_DM1_TPMS_CCAN: init-value=0, length=32, base-type=uint32, system-signal=DTC5_DM1_TPMS_CCAN  # Diagnostic Trouble Code"
    DTC4_DM1_TPMS_CCAN: init-value=0, length=32, base-type=uint32, system-signal=DTC4_DM1_TPMS_CCAN  # Diagnostic Trouble Code"
    DTC3_DM1_TPMS_CCAN: init-value=0, length=32, base-type=uint32, system-signal=DTC3_DM1_TPMS_CCAN  # Diagnostic Trouble Code"
    DTC2_DM1_TPMS_CCAN: init-value=0, length=32, base-type=uint32, system-signal=DTC2_DM1_TPMS_CCAN  # Diagnostic Trouble Code"
    DTC1_DM1_TPMS_CCAN: init-value=0, length=32, base-type=uint32, system-signal=DTC1_DM1_TPMS_CCAN  # Diagnostic Trouble Code"
    FlashRedStopLamp_DM1_TPMS_CCAN: init-value=0, length=2, base-type=uint8, system-signal=FlashRedStopLamp_DM1_TPMS_CCAN  # This parameter provides the capability to flash the RSL (SPN 3039)."
    FlashProtectLamp_DM1_TPMS_CCAN: init-value=0, length=2, base-type=uint8, system-signal=FlashProtectLamp_DM1_TPMS_CCAN  # This parameter provides the capability to flash the engine protect lamp (SPN 3041)."
    FlashMalfuncIndicatorLamp_DM1_TPMS_CCAN: init-value=0, length=2, base-type=uint8, system-signal=FlashMalfuncIndicatorLamp_DM1_TPMS_CCAN  # This parameter provides the capability to flash the MIL (SPN 3038)."
    FlashAmberWarningLamp_DM1_TPMS_CCAN: init-value=0, length=2, base-type=uint8, system-signal=FlashAmberWarningLamp_DM1_TPMS_CCAN  # This parameter provides the capability to flash the AWL (SPN 3040). "
    MalfunctionIndicatorLampStatus_DM1_TPMS_CCAN: init-value=0, length=2, base-type=uint8, system-signal=MalfunctionIndicatorLampStatus_DM1_TPMS_CCAN  # A lamp used to relay only emissions-related trouble code information."
    AmberWarningLampStatus_DM1_TPMS_CCAN: init-value=0, length=2, base-type=uint8, system-signal=AmberWarningLampStatus_DM1_TPMS_CCAN  # This lamp is used to relay trouble code information that is reporting a problem with the vehicle system but the vehicle need not be immediately stopped."
    RedStopLampState_DM1_TPMS_CCAN: init-value=0, length=2, base-type=uint8, system-signal=RedStopLampState_DM1_TPMS_CCAN  # This lamp is uesed to relay trouble code information that is of a severe enought condition that it warrants stopping the vehicle."
    ProtectLampStatus_DM1_TPMS_CCAN: init-value=0, length=2, base-type=uint8, system-signal=ProtectLampStatus_DM1_TPMS_CCAN  # This lamp is used to relay trouble code informatio that is reporting a problem with a vehicle system that is most probably not electronic subsystem related."
    AirBagFireState_AC2TB_ACU_CCAN: init-value=0, length=2, base-type=uint8, system-signal=AirBagFireState_AC2TB_ACU_CCAN  # Air Bag Fire State 00b - Air Bag Fire Off 01b - Air Bag Fire On 10b - Error 11b - Not Available"
    DTC5_DM1_ACU_CCAN: init-value=0, length=32, base-type=uint32, system-signal=DTC5_DM1_ACU_CCAN  # Diagnostic Trouble Code"
    DTC4_DM1_ACU_CCAN: init-value=0, length=32, base-type=uint32, system-signal=DTC4_DM1_ACU_CCAN  # Diagnostic Trouble Code"
    DTC3_DM1_ACU_CCAN: init-value=0, length=32, base-type=uint32, system-signal=DTC3_DM1_ACU_CCAN  # Diagnostic Trouble Code"
    DTC2_DM1_ACU_CCAN: init-value=0, length=32, base-type=uint32, system-signal=DTC2_DM1_ACU_CCAN  # Diagnostic Trouble Code"
    DTC1_DM1_ACU_CCAN: init-value=0, length=32, base-type=uint32, system-signal=DTC1_DM1_ACU_CCAN  # Diagnostic Trouble Code"
    FlashRedStopLamp_DM1_ACU_CCAN: init-value=0, length=2, base-type=uint8, system-signal=FlashRedStopLamp_DM1_ACU_CCAN  # This parameter provides the capability to flash the RSL (SPN 3039)."
    FlashProtectLamp_DM1_ACU_CCAN: init-value=0, length=2, base-type=uint8, system-signal=FlashProtectLamp_DM1_ACU_CCAN  # This parameter provides the capability to flash the engine protect lamp (SPN 3041)."
    FlashMalfuncIndicatorLamp_DM1_ACU_CCAN: init-value=0, length=2, base-type=uint8, system-signal=FlashMalfuncIndicatorLamp_DM1_ACU_CCAN  # This parameter provides the capability to flash the MIL (SPN 3038)."
    FlashAmberWarningLamp_DM1_ACU_CCAN: init-value=0, length=2, base-type=uint8, system-signal=FlashAmberWarningLamp_DM1_ACU_CCAN  # This parameter provides the capability to flash the AWL (SPN 3040). "
    MalfunctionIndicatorLampStatus_DM1_ACU_CCAN: init-value=0, length=2, base-type=uint8, system-signal=MalfunctionIndicatorLampStatus_DM1_ACU_CCAN  # A lamp used to relay only emissions-related trouble code information."
    AmberWarningLampStatus_ENG_DM1_ACU_CCAN: init-value=0, length=2, base-type=uint8, system-signal=AmberWarningLampStatus_ENG_DM1_ACU_CCAN  # This lamp is used to relay trouble code information that is reporting a problem with the vehicle system but the vehicle need not be immediately stopped."
    RedStopLampState_DM1_ACU_CCAN: init-value=0, length=2, base-type=uint8, system-signal=RedStopLampState_DM1_ACU_CCAN  # This lamp is uesed to relay trouble code information that is of a severe enought condition that it warrants stopping the vehicle."
    ProtectLampStatus_DM1_ACU_CCAN: init-value=0, length=2, base-type=uint8, system-signal=ProtectLampStatus_DM1_ACU_CCAN  # This lamp is used to relay trouble code informatio that is reporting a problem with a vehicle system that is most probably not electronic subsystem related."
    TachographVehicleSpeed_TCO1_Tachograph_DTG_CAN_CLOCK_CCAN: init-value=0, length=16, base-type=uint16, system-signal=TachographVehicleSpeed_TCO1_Tachograph_DTG_CAN_CLOCK_CCAN  # Speed of the vehicle registered by the tachograph."
    TachographOutputShaftSpeed_TCO1_Tachograph_DTG_CAN_CLOCK_CCAN: init-value=0, length=16, base-type=uint16, system-signal=TachographOutputShaftSpeed_TCO1_Tachograph_DTG_CAN_CLOCK_CCAN  # Calculated speed of the transmission output shaft."
    DirectionIndicator_TCO1_Tachograph_DTG_CAN_CLOCK_CCAN: init-value=0, length=2, base-type=uint8, system-signal=DirectionIndicator_TCO1_Tachograph_DTG_CAN_CLOCK_CCAN  # Indicates the direction of the vehicle."
    TachographPerformance_TCO1_Tachograph_DTG_CAN_CLOCK_CCAN: init-value=0, length=2, base-type=uint8, system-signal=TachographPerformance_TCO1_Tachograph_DTG_CAN_CLOCK_CCAN
    HandlingInformation_TCO1_Tachograph_DTG_CAN_CLOCK_CCAN: init-value=0, length=2, base-type=uint8, system-signal=HandlingInformation_TCO1_Tachograph_DTG_CAN_CLOCK_CCAN  # Indicates that handling information is present."
    SystemEvent_TCO1_Tachograph_DTG_CAN_CLOCK_CCAN: init-value=0, length=2, base-type=uint8, system-signal=SystemEvent_TCO1_Tachograph_DTG_CAN_CLOCK_CCAN  # Indicates that a tachograph event has occurred."
    DriverCardDriver2_TCO1_Tachograph_DTG_CAN_CLOCK_CCAN: init-value=0, length=2, base-type=uint8, system-signal=DriverCardDriver2_TCO1_Tachograph_DTG_CAN_CLOCK_CCAN
    Driver2TimeRelatedStates_TCO1_Tachograph_DTG_CAN_CLOCK_CCAN: init-value=0, length=4, base-type=uint8, system-signal=Driver2TimeRelatedStates_TCO1_Tachograph_DTG_CAN_CLOCK_CCAN  # Indicates if the driver approaches or exceeds working time limits (or other limits)."
    Overspeed_TCO1_Tachograph_DTG_CAN_CLOCK_CCAN: init-value=0, length=2, base-type=uint8, system-signal=Overspeed_TCO1_Tachograph_DTG_CAN_CLOCK_CCAN  # Indicates whether the vehicle is exceeding the legal speed limit set in the tachograph."
    DriverCardDriver1_TCO1_Tachograph_DTG_CAN_CLOCK_CCAN: init-value=0, length=2, base-type=uint8, system-signal=DriverCardDriver1_TCO1_Tachograph_DTG_CAN_CLOCK_CCAN
    Driver1TimeRelatedStates_TCO1_Tachograph_DTG_CAN_CLOCK_CCAN: init-value=0, length=4, base-type=uint8, system-signal=Driver1TimeRelatedStates_TCO1_Tachograph_DTG_CAN_CLOCK_CCAN  # Indicates if the driver approaches or exceeds working time limits (or other limits)."
    DriveRecognize_TCO1_Tachograph_DTG_CAN_CLOCK_CCAN: init-value=0, length=2, base-type=uint8, system-signal=DriveRecognize_TCO1_Tachograph_DTG_CAN_CLOCK_CCAN  # Indicates whether motion of the vehicle is detected or not."
    Driver2WorkingState_TCO1_Tachograph_DTG_CAN_CLOCK_CCAN: init-value=0, length=3, base-type=uint8, system-signal=Driver2WorkingState_TCO1_Tachograph_DTG_CAN_CLOCK_CCAN  # State of work of the driver."
    Driver1WorkingState_TCO1_Tachograph_DTG_CAN_CLOCK_CCAN: init-value=0, length=3, base-type=uint8, system-signal=Driver1WorkingState_TCO1_Tachograph_DTG_CAN_CLOCK_CCAN  # State of work of the driver."
    LocalHourOffset_TD_DTG_CAN_CLOCK_CCAN: init-value=0, length=8, base-type=uint8, system-signal=LocalHourOffset_TD_DTG_CAN_CLOCK_CCAN
    LocalMinuteOffset_TD_DTG_CAN_CLOCK_CCAN: init-value=0, length=8, base-type=uint8, system-signal=LocalMinuteOffset_TD_DTG_CAN_CLOCK_CCAN  # Local offset in minutes from a reference time."
    Year_TD_DTG_CAN_CLOCK_CCAN: init-value=0, length=8, base-type=uint8, system-signal=Year_TD_DTG_CAN_CLOCK_CCAN  # Part of a parameter used to represent a calendar date."
    Day_TD_DTG_CAN_CLOCK_CCAN: init-value=0, length=8, base-type=uint8, system-signal=Day_TD_DTG_CAN_CLOCK_CCAN  # Part of a parameter used to represent a calendar date."
    Month_TD_DTG_CAN_CLOCK_CCAN: init-value=0, length=8, base-type=uint8, system-signal=Month_TD_DTG_CAN_CLOCK_CCAN  # Part of a parameter used to represent a calendar date."
    Hours_TD_DTG_CAN_CLOCK_CCAN: init-value=0, length=8, base-type=uint8, system-signal=Hours_TD_DTG_CAN_CLOCK_CCAN  # Part of a parameter used to represent time."
    Minutes_TD_DTG_CAN_CLOCK_CCAN: init-value=0, length=8, base-type=uint8, system-signal=Minutes_TD_DTG_CAN_CLOCK_CCAN  # Part of a parameter used to represent time."
    Seconds_TD_DTG_CAN_CLOCK_CCAN: init-value=0, length=8, base-type=uint8, system-signal=Seconds_TD_DTG_CAN_CLOCK_CCAN  # Part of a parameter used to represent time."
    Remote_Windows_Up_Down_Req_TB2SM_T_BOX_T_LINK_CCAN: init-value=0, length=2, base-type=uint8, system-signal=Remote_Windows_Up_Down_Req_TB2SM_T_BOX_T_LINK_CCAN  # 00b - Not Request 01b - Window Up Request 10b - Window Down Request 11b - Stop Request"
    Remote_SSB_IG_On_Off_Req_TB2SM_T_BOX_T_LINK_CCAN: init-value=0, length=2, base-type=uint8, system-signal=Remote_SSB_IG_On_Off_Req_TB2SM_T_BOX_T_LINK_CCAN  # Remote SSB IG ON Request without Engine Running 00b - Not Request 01b - SSB IG ON Request (IG ON 10ºÐ À¯Áö ÈÄ OFF·Î ÀüÈ¯.) 10b - SSB IG OFF Request 11b - Not Available"
    Remote_Hazard_Buzzer_Req_TB2SM_T_BOX_T_LINK_CCAN: init-value=0, length=4, base-type=uint8, system-signal=Remote_Hazard_Buzzer_Req_TB2SM_T_BOX_T_LINK_CCAN  # 0000b - Not Request 0001b - 1 time ON (500ms on, 500ms off) Request 0010b - 2 times ON (500ms on, 500ms) off Request 0011b - 2 times ON (500ms on, 1000ms) off Request 0100b - 30 times ON (500ms on, 500ms) off Request 0101b ~ 1111b - Not Available"
    Remote_Engine_Run_Stop_Req_TB2SM_T_BOX_T_LINK_CCAN: init-value=0, length=2, base-type=uint8, system-signal=Remote_Engine_Run_Stop_Req_TB2SM_T_BOX_T_LINK_CCAN  # Remote Engine Running / Stop Request 00b - Not Request 01b - Running Request 10b - Stop Request 11b - Not Available"
    Remote_Engine_Running_Time_Req_TB2SM_T_BOX_T_LINK_CCAN: init-value=0, length=8, base-type=uint8, system-signal=Remote_Engine_Running_Time_Req_TB2SM_T_BOX_T_LINK_CCAN  # same as data range ** 0x00(0)À¸·Î Àü¼ÛµÇ¸é ½Ã°£Á¦ÇÑ ¾øÀÌ °è¼Ó µ¿ÀÛ»óÅÂ À¯Áö ÇÒ°Í."
    Remote_Door_Lock_Unlock_Req_TB2SM_T_BOX_T_LINK_CCAN: init-value=0, length=2, base-type=uint8, system-signal=Remote_Door_Lock_Unlock_Req_TB2SM_T_BOX_T_LINK_CCAN
    Remote_Crypto_Code_TB2SM_T_BOX_T_LINK_CCAN: init-value=0, length=24, base-type=uint32, system-signal=Remote_Crypto_Code_TB2SM_T_BOX_T_LINK_CCAN  # 'VIN Crypto Code ** SMK EEPROM¿¡ ÀúÀåµÈ ºñ¹ÐÄÚµå¿Í ÀÏÄ¡ÇÒ °æ¿ì¿¡¸¸ TB2SM ·ÎÁ÷ ¼öÇà ÇÒ°Í."
    PssngrArbgDctivationSwitchStatus_BDS_ACU_CCAN: init-value=0, length=2, base-type=uint8, system-signal=PssngrArbgDctivationSwitchStatus_BDS_ACU_CCAN  # State of switch used to deactivate Passenger Airbag manually."
    Beltlock10Status_BDS_ACU_CCAN: init-value=0, length=2, base-type=uint8, system-signal=Beltlock10Status_BDS_ACU_CCAN  # State of switch used to determine if Beltlock 10 is buckled."
    Beltlock9Status_BDS_ACU_CCAN: init-value=0, length=2, base-type=uint8, system-signal=Beltlock9Status_BDS_ACU_CCAN  # State of switch used to determine if Beltlock 9 is buckled."
    Beltlock8Status_BDS_ACU_CCAN: init-value=0, length=2, base-type=uint8, system-signal=Beltlock8Status_BDS_ACU_CCAN  # State of switch used to determine if Beltlock 8 is buckled."
    Beltlock7Status_BDS_ACU_CCAN: init-value=0, length=2, base-type=uint8, system-signal=Beltlock7Status_BDS_ACU_CCAN  # State of switch used to determine if Beltlock 7 is buckled."
    Beltlock6Status_BDS_ACU_CCAN: init-value=0, length=2, base-type=uint8, system-signal=Beltlock6Status_BDS_ACU_CCAN  # State of switch used to determine if Beltlock 6 is buckled."
    Beltlock5Status_BDS_ACU_CCAN: init-value=0, length=2, base-type=uint8, system-signal=Beltlock5Status_BDS_ACU_CCAN  # State of switch used to determine if Beltlock 5 is buckled."
    Beltlock4Status_BDS_ACU_CCAN: init-value=0, length=2, base-type=uint8, system-signal=Beltlock4Status_BDS_ACU_CCAN  # State of switch used to determine if Beltlock 4 is buckled."
    Beltlock3Status_BDS_ACU_CCAN: init-value=0, length=2, base-type=uint8, system-signal=Beltlock3Status_BDS_ACU_CCAN  # State of switch used to determine if Beltlock 3 is buckled."
    PassengerBeltlockStatus_BDS_ACU_CCAN: init-value=0, length=2, base-type=uint8, system-signal=PassengerBeltlockStatus_BDS_ACU_CCAN  # State of switch used to determine if Passenger Beltlock is buckled."
    DriverBeltlockStatus_BDS_ACU_CCAN: init-value=0, length=2, base-type=uint8, system-signal=DriverBeltlockStatus_BDS_ACU_CCAN  # State of switch used to determine if Driver Beltlock is buckled."
    AirBagSystemSelfDiagnosisState_AC2IC_ACU_CCAN: init-value=0, length=2, base-type=uint8, system-signal=AirBagSystemSelfDiagnosisState_AC2IC_ACU_CCAN  # Air Bag System Self Diagnosis State 00b = unlocked (Lamp On) 01b = locked (Lamp Off) 10b = Error - Beltlock state cannot be determined 11b = not available"
    SoC_Percent_CACI5_HVAC_CCAN: init-value=0, length=16, base-type=uint16, system-signal=SoC_Percent_CACI5_HVAC_CCAN  # Battery SoC(State of Charge) Percent of IBS(Intelligent Battery Sensor)"
    Batt_Potential_State_CACI5_HVAC_CCAN: init-value=0, length=16, base-type=uint16, system-signal=Batt_Potential_State_CACI5_HVAC_CCAN  # The Measured Battery Voltage from Intelligent Battery Sensor"
    Batt_Current_State_CACI5_HVAC_CCAN: init-value=0, length=24, base-type=uint32, system-signal=Batt_Current_State_CACI5_HVAC_CCAN  # The Measured Battery Current State from Intelligent Battery Sensor"
    AmbientTempFATC_CACI6_HVAC_CCAN: init-value=0, length=16, base-type=uint16, system-signal=AmbientTempFATC_CACI6_HVAC_CCAN
    FATC_DisplayActive_CACI6_HVAC_CCAN: init-value=0, length=2, base-type=uint8, system-signal=FATC_DisplayActive_CACI6_HVAC_CCAN
    ElecCompOperatingReq_CACI6_HVAC_CCAN: init-value=0, length=2, base-type=uint8, system-signal=ElecCompOperatingReq_CACI6_HVAC_CCAN  # The Requested Switch Signal from FATC Controller to Elec Compressor"
    AirConMechCompState_CACI6_HVAC_CCAN: init-value=0, length=2, base-type=uint8, system-signal=AirConMechCompState_CACI6_HVAC_CCAN  # The Air Conditioner Mechanical Compressor On/Off State"
    ElecCompState_CACI6_HVAC_CCAN: init-value=0, length=2, base-type=uint8, system-signal=ElecCompState_CACI6_HVAC_CCAN  # The Actual Elec Compressor Operating State"
    FATC_ControllerState_CACI6_HVAC_CCAN: init-value=0, length=2, base-type=uint8, system-signal=FATC_ControllerState_CACI6_HVAC_CCAN  # The FATC Controller ON/OFF State "
    AirConditionerAutoState_CACI6_HVAC_CCAN: init-value=0, length=2, base-type=uint8, system-signal=AirConditionerAutoState_CACI6_HVAC_CCAN  # The Auto Mode and Manual Mode of FATC Controller"
    AirConditionerState_CACI6_HVAC_CCAN: init-value=0, length=2, base-type=uint8, system-signal=AirConditionerState_CACI6_HVAC_CCAN  # The Air Conditioner State of FATC Contoller "
    CabVentilation_CACI6_HVAC_CCAN: init-value=0, length=2, base-type=uint8, system-signal=CabVentilation_CACI6_HVAC_CCAN  # Indicates whether the cab is being ventilated or not."
    FATC_OutletModeState_CACI6_HVAC_CCAN: init-value=0, length=8, base-type=uint8, system-signal=FATC_OutletModeState_CACI6_HVAC_CCAN  # The FATC Controller Outlet Mode State"
    BlowerCurrentSpeed_CACI6_HVAC_CCAN: init-value=0, length=8, base-type=uint8, system-signal=BlowerCurrentSpeed_CACI6_HVAC_CCAN  # The HVAC Module Blower speed Step "
    FATCSetTemperature_CACI6_HVAC_CCAN: init-value=0, length=8, base-type=uint8, system-signal=FATCSetTemperature_CACI6_HVAC_CCAN  # The Set Temperature of FATC Controller by Driver Control"
    HighResolutionTripDistance_VDHR_Tachograph_DTG_CAN_CLOCK_CCAN: init-value=0, length=32, base-type=uint32, system-signal=HighResolutionTripDistance_VDHR_Tachograph_DTG_CAN_CLOCK_CCAN  # Distance traveled during all or part of a journey."
    HghRslutionTotalVehicleDistance_VDHR_Tachograph_DTG_CAN_CLOCK_CCAN: init-value=0, length=32, base-type=uint32, system-signal=HghRslutionTotalVehicleDistance_VDHR_Tachograph_DTG_CAN_CLOCK_CCAN  # Accumulated distance traveled by the vehicle during its operation."
    DTC5_DM1_EHPS_ECAN: init-value=0, length=32, base-type=uint32, system-signal=DTC5_DM1_EHPS_ECAN  # Diagnostic Trouble Code"
    DTC4_DM1_EHPS_ECAN: init-value=0, length=32, base-type=uint32, system-signal=DTC4_DM1_EHPS_ECAN  # Diagnostic Trouble Code"
    DTC3_DM1_EHPS_ECAN: init-value=0, length=32, base-type=uint32, system-signal=DTC3_DM1_EHPS_ECAN  # Diagnostic Trouble Code"
    DTC2_DM1_EHPS_ECAN: init-value=0, length=32, base-type=uint32, system-signal=DTC2_DM1_EHPS_ECAN  # Diagnostic Trouble Code"
    DTC1_DM1_EHPS_ECAN: init-value=0, length=32, base-type=uint32, system-signal=DTC1_DM1_EHPS_ECAN  # Diagnostic Trouble Code"
    FlashRedStopLamp_DM1_EHPS_ECAN: init-value=0, length=2, base-type=uint8, system-signal=FlashRedStopLamp_DM1_EHPS_ECAN  # This parameter provides the capability to flash the RSL (SPN 3039)."
    FlashProtectLamp_DM1_EHPS_ECAN: init-value=0, length=2, base-type=uint8, system-signal=FlashProtectLamp_DM1_EHPS_ECAN  # This parameter provides the capability to flash the engine protect lamp (SPN 3041)."
    FlashMalfuncIndicatorLamp_DM1_EHPS_ECAN: init-value=0, length=2, base-type=uint8, system-signal=FlashMalfuncIndicatorLamp_DM1_EHPS_ECAN  # This parameter provides the capability to flash the MIL (SPN 3038)."
    FlashAmberWarningLamp_DM1_EHPS_ECAN: init-value=0, length=2, base-type=uint8, system-signal=FlashAmberWarningLamp_DM1_EHPS_ECAN  # This parameter provides the capability to flash the AWL (SPN 3040). "
    MalfunctionIndicatorLampStatus_DM1_EHPS_ECAN: init-value=0, length=2, base-type=uint8, system-signal=MalfunctionIndicatorLampStatus_DM1_EHPS_ECAN  # A lamp used to relay only emissions-related trouble code information."
    AmberWarningLampStatus_DM1_EHPS_ECAN: init-value=0, length=2, base-type=uint8, system-signal=AmberWarningLampStatus_DM1_EHPS_ECAN  # This lamp is used to relay trouble code information that is reporting a problem with the vehicle system but the vehicle need not be immediately stopped."
    RedStopLampState_DM1_EHPS_ECAN: init-value=0, length=2, base-type=uint8, system-signal=RedStopLampState_DM1_EHPS_ECAN  # This lamp is uesed to relay trouble code information that is of a severe enought condition that it warrants stopping the vehicle."
    ProtectLampStatus_DM1_EHPS_ECAN: init-value=0, length=2, base-type=uint8, system-signal=ProtectLampStatus_DM1_EHPS_ECAN  # This lamp is used to relay trouble code informatio that is reporting a problem with a vehicle system that is most probably not electronic subsystem related."
    SteeringWheelVibrationMode_EPSO2_EHPS_ECAN: init-value=0, length=4, base-type=uint8, system-signal=SteeringWheelVibrationMode_EPSO2_EHPS_ECAN
    MotorTorque_EPSO2_EHPS_ECAN: init-value=32127, length=16, base-type=uint16, system-signal=MotorTorque_EPSO2_EHPS_ECAN
    DriverTorque_EPSO2_EHPS_ECAN: init-value=32127, length=16, base-type=uint16, system-signal=DriverTorque_EPSO2_EHPS_ECAN
    HandsOffProbability_EPSO2_EHPS_ECAN: init-value=0, length=8, base-type=uint8, system-signal=HandsOffProbability_EPSO2_EHPS_ECAN
    ExtControlMode_EPSO2_EHPS_ECAN: init-value=0, length=4, base-type=uint8, system-signal=ExtControlMode_EPSO2_EHPS_ECAN
    MC_EPSO2_EHPS_ECAN: init-value=0, length=4, base-type=uint8, system-signal=MC_EPSO2_EHPS_ECAN
    CRC_EPSO2_EHPS_ECAN: init-value=0, length=8, base-type=uint8, system-signal=CRC_EPSO2_EHPS_ECAN
    TransOilLevelRq_CM3_AWD_ECAN: init-value=0, length=2, base-type=uint8, system-signal=TransOilLevelRq_CM3_AWD_ECAN  # Conveys operator or vehicle system desire for a transmission oil level reading to be taken."
    FifthWheelReleaseCtrl_CM3_AWD_ECAN: init-value=0, length=2, base-type=uint8, system-signal=FifthWheelReleaseCtrl_CM3_AWD_ECAN  # Operator input used to release the fifth wheel."
    FfthWhlRlaseCtrlSecurityLockout_CM3_AWD_ECAN: init-value=0, length=2, base-type=uint8, system-signal=FfthWhlRlaseCtrlSecurityLockout_CM3_AWD_ECAN  # Operator's fifth wheel release control interlock."
    TransferCaseSelectorSwitch_CM3_AWD_ECAN: init-value=0, length=3, base-type=uint8, system-signal=TransferCaseSelectorSwitch_CM3_AWD_ECAN  # Operator_switch_to_select_the_condition_of_the_transfer_case."
    MessageChecksum_SAS1_SAS1_EHPS_ECAN: init-value=0, length=4, base-type=uint8, system-signal=MessageChecksum_SAS1_SAS1_EHPS_ECAN
    MessageCounter_SAS1_SAS1_EHPS_ECAN: init-value=0, length=4, base-type=uint8, system-signal=MessageCounter_SAS1_SAS1_EHPS_ECAN
    SteerAngleSensorCalibrated1_SAS1_EHPS_ECAN: init-value=0, length=2, base-type=uint8, system-signal=SteerAngleSensorCalibrated1_SAS1_EHPS_ECAN  # This signal indicates the calibration status of the steering angle sensor. 00  SAS not calibrated 01  SAS calibrated 10  Reserved 11  Not available"
    SteerAngleSensorActiveMode1_SAS1_EHPS_ECAN: init-value=0, length=2, base-type=uint8, system-signal=SteerAngleSensorActiveMode1_SAS1_EHPS_ECAN  # This signal indicates the operational mode of the steering angle sensor. 00  Programming mode active 01  Normal mode active 10  Reserved 11  Not available"
    SteerWheelAngleRange1_SAS1_EHPS_ECAN: init-value=32127, length=16, base-type=uint16, system-signal=SteerWheelAngleRange1_SAS1_EHPS_ECAN  # The signal indicates the range of the steering wheel angle the sensor element is capable to measure. The steering wheel angle signal ranges between the negative and the positive value of the steering wheel angle range. For example, a steering ..."
    SteerWheelAngleRangeCounterType1_SAS1_EHPS_ECAN: init-value=0, length=2, base-type=uint8, system-signal=SteerWheelAngleRangeCounterType1_SAS1_EHPS_ECAN  # The signal indicates whether the steering wheel angle sensor is capable of absolute measuring of the number of steering wheel angle ranges or not. Absolute measuring means that the steering wheel angle range counter signal indicates the real ..."
    SteerWheelAngleRangeCounter1_SAS1_EHPS_ECAN: init-value=0, length=6, base-type=uint8, system-signal=SteerWheelAngleRangeCounter1_SAS1_EHPS_ECAN  # The signal indicates the number of steering wheel angle range overflows if the operating range of steering wheel is greater than the measuring range of sensor element. Positive values indicate left turns (counterclockwise). If the steering wheel ..."
    SteerWheelAngle1_SAS1_EHPS_ECAN: init-value=32127, length=16, base-type=uint16, system-signal=SteerWheelAngle1_SAS1_EHPS_ECAN
    MessageChecksum_SAS2_SAS2_EHPS_ECAN: init-value=0, length=4, base-type=uint8, system-signal=MessageChecksum_SAS2_SAS2_EHPS_ECAN
    MessageCounter_SAS2_SAS2_EHPS_ECAN: init-value=0, length=4, base-type=uint8, system-signal=MessageCounter_SAS2_SAS2_EHPS_ECAN
    SteerAngleSensorCalibrated2_SAS2_EHPS_ECAN: init-value=0, length=2, base-type=uint8, system-signal=SteerAngleSensorCalibrated2_SAS2_EHPS_ECAN  # This signal indicates the calibration status of the steering angle sensor. 00  SAS not calibrated 01  SAS calibrated 10  Reserved 11  Not available"
    SteerAngleSensorActiveMode2_SAS2_EHPS_ECAN: init-value=0, length=2, base-type=uint8, system-signal=SteerAngleSensorActiveMode2_SAS2_EHPS_ECAN  # This signal indicates the operational mode of the steering angle sensor. 00  Programming mode active 01  Normal mode active 10  Reserved 11  Not available"
    SteerWheelAngleRange2_SAS2_EHPS_ECAN: init-value=32127, length=16, base-type=uint16, system-signal=SteerWheelAngleRange2_SAS2_EHPS_ECAN  # The signal indicates the range of the steering wheel angle the sensor element is capable to measure. The steering wheel angle signal ranges between the negative and the positive value of the steering wheel angle range. For example, a steering ..."
    SteerWheelAngleRangeCounterType2_SAS2_EHPS_ECAN: init-value=0, length=2, base-type=uint8, system-signal=SteerWheelAngleRangeCounterType2_SAS2_EHPS_ECAN  # The signal indicates whether the steering wheel angle sensor is capable of absolute measuring of the number of steering wheel angle ranges or not. Absolute measuring means that the steering wheel angle range counter signal indicates the real ..."
    SteerWheelAngleRangeCounter2_SAS2_EHPS_ECAN: init-value=0, length=6, base-type=uint8, system-signal=SteerWheelAngleRangeCounter2_SAS2_EHPS_ECAN  # The signal indicates the number of steering wheel angle range overflows if the operating range of steering wheel is greater than the measuring range of sensor element. Positive values indicate left turns (counterclockwise). If the steering wheel ..."
    SteerWheelAngle2_SAS2_EHPS_ECAN: init-value=32127, length=16, base-type=uint16, system-signal=SteerWheelAngle2_SAS2_EHPS_ECAN
    AmberWarningLampStatus_EPSO1_EHPS_ECAN: init-value=0, length=2, base-type=uint8, system-signal=AmberWarningLampStatus_EPSO1_EHPS_ECAN  # This lamp is used to relay trouble code information that is reporting a problem with the vehicle system but the vehicle need not be immediately stopped."
    RedStopLampState_EPSO1_EHPS_ECAN: init-value=0, length=2, base-type=uint8, system-signal=RedStopLampState_EPSO1_EHPS_ECAN  # This lamp is uesed to relay trouble code information that is of a severe enought condition that it warrants stopping the vehicle."
    ElectricalSteeringSupRedLv_EPSO1_EHPS_ECAN: init-value=0, length=8, base-type=uint8, system-signal=ElectricalSteeringSupRedLv_EPSO1_EHPS_ECAN  # Signal indicates the current level of torque reduction from electrical steering support."
    EmergencySteerStatus_EPSO1_EHPS_ECAN: init-value=0, length=4, base-type=uint8, system-signal=EmergencySteerStatus_EPSO1_EHPS_ECAN  # Signal indicated if the hydraulic system of the steering gear works or if electrical backup support is need in order to prevent dangerous situations."
    SteeringAngleSpeed_EPSO1_EHPS_ECAN: init-value=0, length=16, base-type=uint16, system-signal=SteeringAngleSpeed_EPSO1_EHPS_ECAN
    SysState_EPSO1_EHPS_ECAN: init-value=0, length=4, base-type=uint8, system-signal=SysState_EPSO1_EHPS_ECAN
    SteeringAngle_EPSO1_EHPS_ECAN: init-value=0, length=16, base-type=uint16, system-signal=SteeringAngle_EPSO1_EHPS_ECAN
    MC_EPSO1_EHPS_ECAN: init-value=0, length=4, base-type=uint8, system-signal=MC_EPSO1_EHPS_ECAN
    CRC_EPSO1_EHPS_ECAN: init-value=0, length=8, base-type=uint8, system-signal=CRC_EPSO1_EHPS_ECAN
    SolenoidValveType_ESS2IC_ESS_ECAN: init-value=0, length=2, base-type=uint8, system-signal=SolenoidValveType_ESS2IC_ESS_ECAN
    ESS_WarningBuzzereStatus_ESS2IC_ESS_ECAN: init-value=0, length=2, base-type=uint8, system-signal=ESS_WarningBuzzereStatus_ESS2IC_ESS_ECAN  # The Warning Buzzer Status of ESS"
    ESS_WarningLampStatus_ESS2IC_ESS_ECAN: init-value=0, length=2, base-type=uint8, system-signal=ESS_WarningLampStatus_ESS2IC_ESS_ECAN
    StartingStatus_ESS2IC_ESS_ECAN: init-value=0, length=2, base-type=uint8, system-signal=StartingStatus_ESS2IC_ESS_ECAN
    SolenoidValveStatus_ESS2IC_ESS_ECAN: init-value=0, length=2, base-type=uint8, system-signal=SolenoidValveStatus_ESS2IC_ESS_ECAN
    BLDC_MOTOR_Status_ESS2IC_ESS_ECAN: init-value=0, length=2, base-type=uint8, system-signal=BLDC_MOTOR_Status_ESS2IC_ESS_ECAN
    FlowIndicatorStatus_ESS2IC_ESS_ECAN: init-value=0, length=2, base-type=uint8, system-signal=FlowIndicatorStatus_ESS2IC_ESS_ECAN
    TransferCaseStatus_TCI_AWD_ECAN: init-value=0, length=3, base-type=uint8, system-signal=TransferCaseStatus_TCI_AWD_ECAN  # This_parameter_describes_the_feedback_from_the_transfer_case_controller ."
    OverallIntendedBrakeAcceleration_EBC5_CCM_LCAN: init-value=0, length=8, base-type=uint8, system-signal=OverallIntendedBrakeAcceleration_EBC5_CCM_LCAN
    DriverBrakeDemand_EBC5_CCM_LCAN: init-value=0, length=8, base-type=uint8, system-signal=DriverBrakeDemand_EBC5_CCM_LCAN
    XBRBrakeHoldMode_EBC5_CCM_LCAN: init-value=0, length=4, base-type=uint8, system-signal=XBRBrakeHoldMode_EBC5_CCM_LCAN
    RailroadMode_EBC5_CCM_LCAN: init-value=0, length=2, base-type=uint8, system-signal=RailroadMode_EBC5_CCM_LCAN
    EmergencyBrakingActive_EBC5_CCM_LCAN: init-value=0, length=2, base-type=uint8, system-signal=EmergencyBrakingActive_EBC5_CCM_LCAN
    BrakeTempWarning_EBC5_CCM_LCAN: init-value=0, length=2, base-type=uint8, system-signal=BrakeTempWarning_EBC5_CCM_LCAN  # This parameter indicates if the temperature in the service brakes exceeds a certain value.This parameter indicates if the temperature in the service brakes exceeds a certain value. It can be used for a warningThis parameter indicates if the temperature in the service brakes exceeds a certain value."
    XBRAccelerationLimit_EBC5_CCM_LCAN: init-value=125, length=8, base-type=uint8, system-signal=XBRAccelerationLimit_EBC5_CCM_LCAN  # The brake system may temporarily or generally limit the maximum brake performance available for external systems.The brake system may temporarily or generally limit the maximum brake performance available for external systems. AThe brake system may temporarily or generally limit the maximum brake performance available for external systems."
    XBRActiveCtrlMode_EBC5_CCM_LCAN: init-value=0, length=4, base-type=uint8, system-signal=XBRActiveCtrlMode_EBC5_CCM_LCAN  # This parameter indicates which XBR Control Mode is executed by the brake system.This parameter indicates which XBR Control Mode is executed by the brake system.This parameter indicates which XBR Control Mode is executed by the brake system."
    XBRSystemState_EBC5_CCM_LCAN: init-value=0, length=2, base-type=uint8, system-signal=XBRSystemState_EBC5_CCM_LCAN  # This parameter indicates which external brake control is allowed.This parameter indicates which external brake control is allowed.This parameter indicates which external brake control is allowed."
    FoundationBrakeUse_EBC5_CCM_LCAN: init-value=0, length=2, base-type=uint8, system-signal=FoundationBrakeUse_EBC5_CCM_LCAN  # This parameter indicates if the brake system presently uses the foundation brakes.This parameter indicates if the brake system presently uses the foundation brakes.This parameter indicates if the brake system presently uses the foundation brakes."
    HillHolderMode_EBC5_CCM_LCAN: init-value=0, length=3, base-type=uint8, system-signal=HillHolderMode_EBC5_CCM_LCAN  # Signal which indicates the current mode of the hill holder function.Signal which indicates the current mode of the hill holder function.Signal which indicates the current mode of the hill holder function."
    HaltBrakeMode_EBC5_CCM_LCAN: init-value=0, length=3, base-type=uint8, system-signal=HaltBrakeMode_EBC5_CCM_LCAN  # Signal which indicates the current mode of the halt brake function.Signal which indicates the current mode of the halt brake function.Signal which indicates the current mode of the halt brake function."
    PrkngBrakeActuatorFullyActivated_EBC5_CCM_LCAN: init-value=0, length=2, base-type=uint8, system-signal=PrkngBrakeActuatorFullyActivated_EBC5_CCM_LCAN  # Signal which indicates when the parking brake actuator is fully activated."
    KEY_IN_SW_OUTPUT_STATE_SMK1__SM2TB__SMK_LCAN: init-value=0, length=1, base-type=uint8, system-signal=KEY_IN_SW_OUTPUT_STATE_SMK1__SM2TB__SMK_LCAN
    IG2_OUTPUT_STATE_SMK1__SM2TB__SMK_LCAN: init-value=0, length=1, base-type=uint8, system-signal=IG2_OUTPUT_STATE_SMK1__SM2TB__SMK_LCAN
    IG1_OUTPUT_STATE_SMK1__SM2TB__SMK_LCAN: init-value=0, length=1, base-type=uint8, system-signal=IG1_OUTPUT_STATE_SMK1__SM2TB__SMK_LCAN
    START_OUTPUT_STATE_SMK1__SM2TB__SMK_LCAN: init-value=0, length=1, base-type=uint8, system-signal=START_OUTPUT_STATE_SMK1__SM2TB__SMK_LCAN
    ACC_OUTPUT_STATE_SMK1__SM2TB__SMK_LCAN: init-value=0, length=1, base-type=uint8, system-signal=ACC_OUTPUT_STATE_SMK1__SM2TB__SMK_LCAN
    Engine_Running_Stop_State_SMK1__SM2TB__SMK_LCAN: init-value=0, length=2, base-type=uint8, system-signal=Engine_Running_Stop_State_SMK1__SM2TB__SMK_LCAN  # Normal / Remote Engine Start Mode State 00b - Normal Engine Start Mode 01b - Remote Engine Start Mode 10b - Error 11b - Not Available"
    RemoteCryptoCertificationState_SMK1__SM2TB__SMK_LCAN: init-value=0, length=2, base-type=uint8, system-signal=RemoteCryptoCertificationState_SMK1__SM2TB__SMK_LCAN  # 00b - Crypto Code Invalid 01b - Crypto Code Valid 10b - Error 11b - Not Available"
    RKE_Arming_State_SMK1__SM2TB__SMK_LCAN: init-value=0, length=2, base-type=uint8, system-signal=RKE_Arming_State_SMK1__SM2TB__SMK_LCAN  # 00b - Disable arming mode 01b - Arming mode 10b - Re-arming standby mode 11b - Alarm mode"
    SSB_Key_State_SMK1__SM2TB__SMK_LCAN: init-value=0, length=3, base-type=uint8, system-signal=SSB_Key_State_SMK1__SM2TB__SMK_LCAN  # 000b-Offstatewithoutkey-in(WHITELEDOFF) 001b-Offstatewithkey-in(WHITELEDON) 010b-ACCstate(YELLOWLEDON) 011b-IGstatewithoutengine run(BLUELEDON) 100b-START(cranking)state(BLUELEDON) 101b-IGstatewithengine run(BLUELEDON) 110b-ERR 111b-NotAvailable"
    BrkLnngRmnngRearAxle3RightWheel_LWSV_CCM_LCAN: init-value=0, length=8, base-type=uint8, system-signal=BrkLnngRmnngRearAxle3RightWheel_LWSV_CCM_LCAN  # The percentage of brake lining which can still be measured for the right wheel on the rear axle #3."
    BrkLnngRmningRearAxle3LeftWheel_LWSV_CCM_LCAN: init-value=0, length=8, base-type=uint8, system-signal=BrkLnngRmningRearAxle3LeftWheel_LWSV_CCM_LCAN  # The percentage of brake lining which can still be measured for the left wheel on the rear axle #3."
    BrkLnngRmnngRearAxle2RightWheel_LWSV_CCM_LCAN: init-value=0, length=8, base-type=uint8, system-signal=BrkLnngRmnngRearAxle2RightWheel_LWSV_CCM_LCAN  # The percentage of brake lining which can still be measured for the right wheel on the rear axle #2."
    BrkLnngRmningRearAxle2LeftWheel_LWSV_CCM_LCAN: init-value=0, length=8, base-type=uint8, system-signal=BrkLnngRmningRearAxle2LeftWheel_LWSV_CCM_LCAN  # The percentage of brake lining which can still be measured for the left wheel on the rear axle #2."
    BrkLnngRmnngRearAxle1RightWheel_LWSV_CCM_LCAN: init-value=0, length=8, base-type=uint8, system-signal=BrkLnngRmnngRearAxle1RightWheel_LWSV_CCM_LCAN  # The percentage of brake lining which can still be measured for the right wheel on the rear axle #1."
    BrkLnngRmningRearAxle1LeftWheel_LWSV_CCM_LCAN: init-value=0, length=8, base-type=uint8, system-signal=BrkLnngRmningRearAxle1LeftWheel_LWSV_CCM_LCAN  # The percentage of brake lining which can still be measured for the left wheel on the rear axle #1."
    BrkLnngRmnngFrontAxleRightWheel_LWSV_CCM_LCAN: init-value=0, length=8, base-type=uint8, system-signal=BrkLnngRmnngFrontAxleRightWheel_LWSV_CCM_LCAN  # The percentage of brake lining which can still be measured for the right wheel on the front axle."
    BrkLnngRmningFrontAxleLeftWheel_LWSV_CCM_LCAN: init-value=0, length=8, base-type=uint8, system-signal=BrkLnngRmningFrontAxleLeftWheel_LWSV_CCM_LCAN  # The percentage of brake lining which can still be measured for the left wheel on the front axle."
    SrcAddrssOfCtrllngDvcFrBrkCntrl_EBC1_CCM_LCAN: init-value=0, length=8, base-type=uint8, system-signal=SrcAddrssOfCtrllngDvcFrBrkCntrl_EBC1_CCM_LCAN  # The source address of the SAE J1939 device currently controlling the brake system."
    BrakePedalPos_EBC1_CCM_LCAN: init-value=0, length=8, base-type=uint8, system-signal=BrakePedalPos_EBC1_CCM_LCAN  # Ratio of brake pedal position to maximum pedal position."
    TrctrMntdTrilerABSWarningSignal_EBC1_CCM_LCAN: init-value=0, length=2, base-type=uint8, system-signal=TrctrMntdTrilerABSWarningSignal_EBC1_CCM_LCAN  # This parameter commands the tractor-mounted trailer ABS optical warning signal."
    TrailerABSStatus_EBC1_CCM_LCAN: init-value=0, length=2, base-type=uint8, system-signal=TrailerABSStatus_EBC1_CCM_LCAN  # State signal which indicates that ABS in the trailer is actively controlling the brakes."
    HaltBrakeSwitch_EBC1_CCM_LCAN: init-value=0, length=2, base-type=uint8, system-signal=HaltBrakeSwitch_EBC1_CCM_LCAN  # Switch signal which indicates the position of the halt brake switch."
    ATC_ASRInformationSignal_EBC1_CCM_LCAN: init-value=0, length=2, base-type=uint8, system-signal=ATC_ASRInformationSignal_EBC1_CCM_LCAN  # This parameter commands the ATC/ASR driver information signal, for example a dash lamp."
    ABS_EBSAmberWarningSignal_EBC1_CCM_LCAN: init-value=0, length=2, base-type=uint8, system-signal=ABS_EBSAmberWarningSignal_EBC1_CCM_LCAN
    EBSRedWarningSignal_EBC1_CCM_LCAN: init-value=0, length=2, base-type=uint8, system-signal=EBSRedWarningSignal_EBC1_CCM_LCAN
    ABSFullyOperational_EBC1_CCM_LCAN: init-value=0, length=2, base-type=uint8, system-signal=ABSFullyOperational_EBC1_CCM_LCAN
    EngRetarderSelection_EBC1_CCM_LCAN: init-value=0, length=8, base-type=uint8, system-signal=EngRetarderSelection_EBC1_CCM_LCAN
    RemoteAccelEnableSwitch_EBC1_CCM_LCAN: init-value=0, length=2, base-type=uint8, system-signal=RemoteAccelEnableSwitch_EBC1_CCM_LCAN  # Switch signal which indicates that the remote accelerator has been enabled and controls the engine."
    EngAuxEngShutdownSwitch_EBC1_CCM_LCAN: init-value=0, length=2, base-type=uint8, system-signal=EngAuxEngShutdownSwitch_EBC1_CCM_LCAN  # Switch signal which requests that all engine fueling stop."
    EngDerateSwitch_EBC1_CCM_LCAN: init-value=0, length=2, base-type=uint8, system-signal=EngDerateSwitch_EBC1_CCM_LCAN  # Switch signal used to activate the torque limiting feature of the engine."
    AccelInterlockSwitch_EBC1_CCM_LCAN: init-value=0, length=2, base-type=uint8, system-signal=AccelInterlockSwitch_EBC1_CCM_LCAN  # Switch signal used to disable the accelerator and remote accelerator inputs, causing the engine to return to idle."
    TractionCtrlOverrideSwitch_EBC1_CCM_LCAN: init-value=0, length=2, base-type=uint8, system-signal=TractionCtrlOverrideSwitch_EBC1_CCM_LCAN  # Switch signal which indicates the position of the traction control override switch."
    ASRHillHolderSwitch_EBC1_CCM_LCAN: init-value=0, length=2, base-type=uint8, system-signal=ASRHillHolderSwitch_EBC1_CCM_LCAN  # Switch signal which indicates the position of the ASR hill holder switch."
    ASROffroadSwitch_EBC1_CCM_LCAN: init-value=0, length=2, base-type=uint8, system-signal=ASROffroadSwitch_EBC1_CCM_LCAN  # Switch signal which indicates the position of the ASR off-road switch."
    ABSOffroadSwitch_EBC1_CCM_LCAN: init-value=0, length=2, base-type=uint8, system-signal=ABSOffroadSwitch_EBC1_CCM_LCAN  # Switch signal which indicates the position of the ABS off-road switch."
    EBSBrakeSwitch_EBC1_CCM_LCAN: init-value=0, length=2, base-type=uint8, system-signal=EBSBrakeSwitch_EBC1_CCM_LCAN  # Switch signal which indicates that the brake pedal is being pressed."
    AntiLockBrakingActive_EBC1_CCM_LCAN: init-value=0, length=2, base-type=uint8, system-signal=AntiLockBrakingActive_EBC1_CCM_LCAN  # State signal which indicates that the ABS is active."
    ASRBrakeCtrlActive_EBC1_CCM_LCAN: init-value=0, length=2, base-type=uint8, system-signal=ASRBrakeCtrlActive_EBC1_CCM_LCAN  # State signal which indicates that ASR brake control is active."
    ASREngCtrlActive_EBC1_CCM_LCAN: init-value=0, length=2, base-type=uint8, system-signal=ASREngCtrlActive_EBC1_CCM_LCAN  # State signal which indicates that ASR engine control has been commanded to be active."
    TM_Pressure_Switch_CC2BC_CCM_LCAN: init-value=0, length=2, base-type=uint8, system-signal=TM_Pressure_Switch_CC2BC_CCM_LCAN  # CC2BC_ZF_TM_BLOCKING_SYSTEM"
    Parking_Switch_2_Bar_CC2BC_CCM_LCAN: init-value=0, length=2, base-type=uint8, system-signal=Parking_Switch_2_Bar_CC2BC_CCM_LCAN  # CC2BC"
    Gradual_Parking_Switch_6_Bar_CC2BC_CCM_LCAN: init-value=0, length=2, base-type=uint8, system-signal=Gradual_Parking_Switch_6_Bar_CC2BC_CCM_LCAN  # CC2BC"
    CAB_Lock_Switch_CC2BC_CCM_LCAN: init-value=0, length=2, base-type=uint8, system-signal=CAB_Lock_Switch_CC2BC_CCM_LCAN  # CC2BC"
    TM_Range_Switch_CC2BC_CCM_LCAN: init-value=0, length=2, base-type=uint8, system-signal=TM_Range_Switch_CC2BC_CCM_LCAN  # CC2BC"
    TM_Split_Switch_CC2IC_CCM_LCAN: init-value=0, length=2, base-type=uint8, system-signal=TM_Split_Switch_CC2IC_CCM_LCAN  # CC2BC"
    Park_Tank_LPS_5_Bar_CC2IC_CCM_LCAN: init-value=0, length=2, base-type=uint8, system-signal=Park_Tank_LPS_5_Bar_CC2IC_CCM_LCAN  # CC2IC"
    Air_Sus_AirPressure_AIR3_LIFT_CC2IC_CCM_LCAN: init-value=0, length=8, base-type=int8, system-signal=Air_Sus_AirPressure_AIR3_LIFT_CC2IC_CCM_LCAN  # CCM TO IC"
    Brake_Circuit1_Air_Pressure_RR_CC2IC_CCM_LCAN: init-value=0, length=8, base-type=int8, system-signal=Brake_Circuit1_Air_Pressure_RR_CC2IC_CCM_LCAN  # CCM TO IC"
    Brake_Circuit2_Air_Pressure_FRT_CC2IC_CCM_LCAN: init-value=0, length=8, base-type=int8, system-signal=Brake_Circuit2_Air_Pressure_FRT_CC2IC_CCM_LCAN  # CCM TO IC"
    Fuel_Level_CC2IC_CCM_LCAN: init-value=0, length=8, base-type=uint8, system-signal=Fuel_Level_CC2IC_CCM_LCAN  # FUEL LEVEL _ CCM TO IC"
    BrkLnngRmningRearAxle3RightWheel_EBC4_CCM_LCAN: init-value=0, length=8, base-type=uint8, system-signal=BrkLnngRmningRearAxle3RightWheel_EBC4_CCM_LCAN  # The percentage of brake lining which can still be measured for the right wheel on the rear axle #3. 100% represents new"
    BrkLnngRminingRearAxle3LeftWheel_EBC4_CCM_LCAN: init-value=0, length=8, base-type=uint8, system-signal=BrkLnngRminingRearAxle3LeftWheel_EBC4_CCM_LCAN  # The percentage of brake lining which can still be measured for the left wheel on the rear axle #3. 100% represents new"
    BrkLnngRmningRearAxle2RightWheel_EBC4_CCM_LCAN: init-value=0, length=8, base-type=uint8, system-signal=BrkLnngRmningRearAxle2RightWheel_EBC4_CCM_LCAN  # The percentage of brake lining which can still be measured for the right wheel on the rear axle #2. 100% represents new"
    BrkLnngRminingRearAxle2LeftWheel_EBC4_CCM_LCAN: init-value=0, length=8, base-type=uint8, system-signal=BrkLnngRminingRearAxle2LeftWheel_EBC4_CCM_LCAN  # The percentage of brake lining which can still be measured for the left wheel on the rear axle #2. 100% represents new"
    BrkLnngRmningRearAxle1RightWheel_EBC4_CCM_LCAN: init-value=0, length=8, base-type=uint8, system-signal=BrkLnngRmningRearAxle1RightWheel_EBC4_CCM_LCAN  # The percentage of brake lining which can still be measured for the right wheel on the rear axle #1. 100% represents new"
    BrkLnngRminingRearAxle1LeftWheel_EBC4_CCM_LCAN: init-value=0, length=8, base-type=uint8, system-signal=BrkLnngRminingRearAxle1LeftWheel_EBC4_CCM_LCAN  # The percentage of brake lining which can still be measured for the left wheel on the rear axle #1. 100% represents new"
    BrkLnngRmningFrontAxleRightWheel_EBC4_CCM_LCAN: init-value=0, length=8, base-type=uint8, system-signal=BrkLnngRmningFrontAxleRightWheel_EBC4_CCM_LCAN  # The percentage of brake lining which can still be measured for the right wheel on the front axle. 100% represents new"
    BrkLnngRminingFrontAxleLeftWheel_EBC4_CCM_LCAN: init-value=0, length=8, base-type=uint8, system-signal=BrkLnngRminingFrontAxleLeftWheel_EBC4_CCM_LCAN  # The percentage of brake lining which can still be measured for the left wheel on the front axle. 100% represents new"
    MessageChecksum_TSC1_TSC1_E_ABS_EBS_SCAN: init-value=0, length=4, base-type=uint8, system-signal=MessageChecksum_TSC1_TSC1_E_ABS_EBS_SCAN  # The message checksum is used to verify the signal path from the transmitting device to the receiving device."
    MessageCounter_TSC1_E_ABS_EBS_SCAN: init-value=0, length=4, base-type=uint8, system-signal=MessageCounter_TSC1_E_ABS_EBS_SCAN  # The message counter is used to detect situations where the transmitting ECU malfunction repeats the same frame all theThe message counter is used to detect situations where the transmitting ECU malfunction repeats the same frame all theThe message counter is used to detect situations where the transmitting ECU malfunction repeats the same frame all theThe message counter is used to detect situations where the transmitting ECU malfunction repeats the same frame all theThe message counter is used to detect s"
    ControlPurpose_TSC1_E_ABS_EBS_SCAN: init-value=0, length=5, base-type=uint8, system-signal=ControlPurpose_TSC1_E_ABS_EBS_SCAN  # State signal which indicates which control mode the sending device is using to generate the TSC1 command."
    TransmissionRate_TSC1_E_ABS_EBS_SCAN: init-value=0, length=3, base-type=uint8, system-signal=TransmissionRate_TSC1_E_ABS_EBS_SCAN  # This parameter indicates the transmission rate at which the sending device will transmit the TSC1 message."
    EngRequstedTorqueLimit_ABS_E_TSC1_E_ABS_EBS_SCAN: init-value=0, length=8, base-type=uint8, system-signal=EngRequstedTorqueLimit_ABS_E_TSC1_E_ABS_EBS_SCAN  # Parameter provided to the engine or retarder in the torque/speed control message for controlling or limiting the output torque."
    EngRqedSpeed_SpeedLimit_TSC1_E_ABS_EBS_SCAN: init-value=0, length=16, base-type=uint16, system-signal=EngRqedSpeed_SpeedLimit_TSC1_E_ABS_EBS_SCAN  # Parameter provided to the engine from external sources in the torque/speed control message."
    OverrideCtrlModePriority_TSC1_E_ABS_EBS_SCAN: init-value=0, length=2, base-type=uint8, system-signal=OverrideCtrlModePriority_TSC1_E_ABS_EBS_SCAN
    EngRqedSpeedCtrlConditions_TSC1_E_ABS_EBS_SCAN: init-value=0, length=2, base-type=uint8, system-signal=EngRqedSpeedCtrlConditions_TSC1_E_ABS_EBS_SCAN  # This mode tells the engine control system the governor characteristics that are desired during speed control."
    EngOverrideCtrlMode_TSC1_E_ABS_EBS_SCAN: init-value=0, length=2, base-type=uint8, system-signal=EngOverrideCtrlMode_TSC1_E_ABS_EBS_SCAN
    EngineRequestedTorqueHiRes_TSC1_E_ABS_EBS_SCAN: init-value=0, length=4, base-type=uint8, system-signal=EngineRequestedTorqueHiRes_TSC1_E_ABS_EBS_SCAN  # This parameter displays an additional torque in percent of the reference engine torque."
    MessageChecksum_TSC1_TSC1_DR_ABS_EBS_SCAN: init-value=0, length=4, base-type=uint8, system-signal=MessageChecksum_TSC1_TSC1_DR_ABS_EBS_SCAN  # The message checksum is used to verify the signal path from the transmitting device to the receiving device."
    MessageCounter_TSC1_DR_ABS_EBS_SCAN: init-value=0, length=4, base-type=uint8, system-signal=MessageCounter_TSC1_DR_ABS_EBS_SCAN  # The message counter is used to detect situations where the transmitting ECU malfunction repeats the same frame all theThe message counter is used to detect situations where the transmitting ECU malfunction repeats the same frame all theThe message counter is used to detect situations where the transmitting ECU malfunction repeats the same frame all theThe message counter is used to detect situations where the transmitting ECU malfunction repeats the same frame all theThe message counter is used to detect s"
    ControlPurpose_TSC1_DR_ABS_EBS_SCAN: init-value=0, length=5, base-type=uint8, system-signal=ControlPurpose_TSC1_DR_ABS_EBS_SCAN  # State signal which indicates which control mode the sending device is using to generate the TSC1 command."
    TransmissionRate_TSC1_DR_ABS_EBS_SCAN: init-value=0, length=3, base-type=uint8, system-signal=TransmissionRate_TSC1_DR_ABS_EBS_SCAN  # This parameter indicates the transmission rate at which the sending device will transmit the TSC1 message."
    EngRequstedTorqueLimit_ABS_DR_TSC1_DR_ABS_EBS_SCAN: init-value=0, length=8, base-type=uint8, system-signal=EngRequstedTorqueLimit_ABS_DR_TSC1_DR_ABS_EBS_SCAN  # Parameter provided to the engine or retarder in the torque/speed control message for controlling or limiting the output torque."
    EngRqedSpeed_SpeedLimit_TSC1_DR_ABS_EBS_SCAN: init-value=0, length=16, base-type=uint16, system-signal=EngRqedSpeed_SpeedLimit_TSC1_DR_ABS_EBS_SCAN  # Parameter provided to the engine from external sources in the torque/speed control message."
    OverrideCtrlModePriority_TSC1_DR_ABS_EBS_SCAN: init-value=0, length=2, base-type=uint8, system-signal=OverrideCtrlModePriority_TSC1_DR_ABS_EBS_SCAN
    EngRqedSpeedCtrlConditions_TSC1_DR_ABS_EBS_SCAN: init-value=0, length=2, base-type=uint8, system-signal=EngRqedSpeedCtrlConditions_TSC1_DR_ABS_EBS_SCAN  # This mode tells the engine control system the governor characteristics that are desired during speed control."
    EngOverrideCtrlMode_TSC1_DR_ABS_EBS_SCAN: init-value=0, length=2, base-type=uint8, system-signal=EngOverrideCtrlMode_TSC1_DR_ABS_EBS_SCAN
    EngineRequestedTorqueHiRes_TSC1_DR_ABS_EBS_SCAN: init-value=0, length=4, base-type=uint8, system-signal=EngineRequestedTorqueHiRes_TSC1_DR_ABS_EBS_SCAN  # This parameter displays an additional torque in percent of the reference engine torque."
    DTC5_DM1_ABS_EBS_SCAN: init-value=0, length=32, base-type=uint32, system-signal=DTC5_DM1_ABS_EBS_SCAN  # Diagnostic Trouble Code"
    DTC4_DM1_ABS_EBS_SCAN: init-value=0, length=32, base-type=uint32, system-signal=DTC4_DM1_ABS_EBS_SCAN  # Diagnostic Trouble Code"
    DTC3_DM1_ABS_EBS_SCAN: init-value=0, length=32, base-type=uint32, system-signal=DTC3_DM1_ABS_EBS_SCAN  # Diagnostic Trouble Code"
    DTC2_DM1_ABS_EBS_SCAN: init-value=0, length=32, base-type=uint32, system-signal=DTC2_DM1_ABS_EBS_SCAN  # Diagnostic Trouble Code"
    DTC1_DM1_ABS_EBS_SCAN: init-value=0, length=32, base-type=uint32, system-signal=DTC1_DM1_ABS_EBS_SCAN  # Diagnostic Trouble Code"
    FlashRedStopLamp_DM1_ABS_EBS_SCAN: init-value=0, length=2, base-type=uint8, system-signal=FlashRedStopLamp_DM1_ABS_EBS_SCAN  # This parameter provides the capability to flash the RSL (SPN 3039)."
    FlashProtectLamp_DM1_ABS_EBS_SCAN: init-value=0, length=2, base-type=uint8, system-signal=FlashProtectLamp_DM1_ABS_EBS_SCAN  # This parameter provides the capability to flash the engine protect lamp (SPN 3041)."
    FlashMalfuncIndicatorLamp_DM1_ABS_EBS_SCAN: init-value=0, length=2, base-type=uint8, system-signal=FlashMalfuncIndicatorLamp_DM1_ABS_EBS_SCAN  # This parameter provides the capability to flash the MIL (SPN 3038)."
    FlashAmberWarningLamp_DM1_ABS_EBS_SCAN: init-value=0, length=2, base-type=uint8, system-signal=FlashAmberWarningLamp_DM1_ABS_EBS_SCAN  # This parameter provides the capability to flash the AWL (SPN 3040). "
    MalfunctionIndicatorLampStatus_DM1_ABS_EBS_SCAN: init-value=0, length=2, base-type=uint8, system-signal=MalfunctionIndicatorLampStatus_DM1_ABS_EBS_SCAN  # A lamp used to relay only emissions-related trouble code information."
    AmberWarningLampStatus_ABS_EBS_DM1_ABS_EBS_SCAN: init-value=0, length=2, base-type=uint8, system-signal=AmberWarningLampStatus_ABS_EBS_DM1_ABS_EBS_SCAN  # This lamp is used to relay trouble code information that is reporting a problem with the vehicle system but the vehicle need not be immediately stopped."
    RedStopLampState_DM1_ABS_EBS_SCAN: init-value=0, length=2, base-type=uint8, system-signal=RedStopLampState_DM1_ABS_EBS_SCAN  # This lamp is uesed to relay trouble code information that is of a severe enought condition that it warrants stopping the vehicle."
    ProtectLampStatus_DM1_ABS_EBS_SCAN: init-value=0, length=2, base-type=uint8, system-signal=ProtectLampStatus_DM1_ABS_EBS_SCAN  # This lamp is used to relay trouble code informatio that is reporting a problem with a vehicle system that is most probably not electronic subsystem related."
    MessageChecksum_TSC1_TSC1_DrvR_ACC_ACC_SCAN: init-value=0, length=4, base-type=uint8, system-signal=MessageChecksum_TSC1_TSC1_DrvR_ACC_ACC_SCAN  # The message checksum is used to verify the signal path from the transmitting device to the receiving device."
    MessageCounter_TSC1_DrvR_ACC_ACC_SCAN: init-value=0, length=4, base-type=uint8, system-signal=MessageCounter_TSC1_DrvR_ACC_ACC_SCAN  # The message counter is used to detect situations where the transmitting ECU malfunction repeats the same frame all theThe message counter is used to detect situations where the transmitting ECU malfunction repeats the same frame all theThe message counter is used to detect situations where the transmitting ECU malfunction repeats the same frame all theThe message counter is used to detect situations where the transmitting ECU malfunction repeats the same frame all theThe message counter is used to detect s"
    ControlPurpose_TSC1_DrvR_ACC_ACC_SCAN: init-value=0, length=5, base-type=uint8, system-signal=ControlPurpose_TSC1_DrvR_ACC_ACC_SCAN  # State signal which indicates which control mode the sending device is using to generate the TSC1 command."
    TransmissionRate_TSC1_DrvR_ACC_ACC_SCAN: init-value=0, length=3, base-type=uint8, system-signal=TransmissionRate_TSC1_DrvR_ACC_ACC_SCAN  # This parameter indicates the transmission rate at which the sending device will transmit the TSC1 message."
    EngRequstedTorqueLimit_ACC_DR_TSC1_DrvR_ACC_ACC_SCAN: init-value=0, length=8, base-type=uint8, system-signal=EngRequstedTorqueLimit_ACC_DR_TSC1_DrvR_ACC_ACC_SCAN  # Parameter provided to the engine or retarder in the torque/speed control message for controlling or limiting the output torque."
    EngRqedSpeed_SpeedLimit_TSC1_DrvR_ACC_ACC_SCAN: init-value=0, length=16, base-type=uint16, system-signal=EngRqedSpeed_SpeedLimit_TSC1_DrvR_ACC_ACC_SCAN  # Parameter provided to the engine from external sources in the torque/speed control message."
    OverrideCtrlModePriority_TSC1_DrvR_ACC_ACC_SCAN: init-value=0, length=2, base-type=uint8, system-signal=OverrideCtrlModePriority_TSC1_DrvR_ACC_ACC_SCAN
    EngRqedSpeedCtrlConditions_TSC1_DrvR_ACC_ACC_SCAN: init-value=0, length=2, base-type=uint8, system-signal=EngRqedSpeedCtrlConditions_TSC1_DrvR_ACC_ACC_SCAN  # This mode tells the engine control system the governor characteristics that are desired during speed control."
    EngOverrideCtrlMode_TSC1_DrvR_ACC_ACC_SCAN: init-value=0, length=2, base-type=uint8, system-signal=EngOverrideCtrlMode_TSC1_DrvR_ACC_ACC_SCAN
    EngineRequestedTorqueHiRes_TSC1_DrvR_ACC_ACC_SCAN: init-value=0, length=4, base-type=uint8, system-signal=EngineRequestedTorqueHiRes_TSC1_DrvR_ACC_ACC_SCAN  # This parameter displays an additional torque in percent of the reference engine torque."
    DTC5_DM1_ACC_ACC_SCAN: init-value=0, length=32, base-type=uint32, system-signal=DTC5_DM1_ACC_ACC_SCAN  # Diagnostic Trouble Code"
    DTC4_DM1_ACC_ACC_SCAN: init-value=0, length=32, base-type=uint32, system-signal=DTC4_DM1_ACC_ACC_SCAN  # Diagnostic Trouble Code"
    DTC3_DM1_ACC_ACC_SCAN: init-value=0, length=32, base-type=uint32, system-signal=DTC3_DM1_ACC_ACC_SCAN  # Diagnostic Trouble Code"
    DTC2_DM1_ACC_ACC_SCAN: init-value=0, length=32, base-type=uint32, system-signal=DTC2_DM1_ACC_ACC_SCAN  # Diagnostic Trouble Code"
    DTC1_DM1_ACC_ACC_SCAN: init-value=0, length=32, base-type=uint32, system-signal=DTC1_DM1_ACC_ACC_SCAN  # Diagnostic Trouble Code"
    FlashRedStopLamp_DM1_ACC_ACC_SCAN: init-value=0, length=2, base-type=uint8, system-signal=FlashRedStopLamp_DM1_ACC_ACC_SCAN  # This parameter provides the capability to flash the RSL (SPN 3039)."
    FlashProtectLamp_DM1_ACC_ACC_SCAN: init-value=0, length=2, base-type=uint8, system-signal=FlashProtectLamp_DM1_ACC_ACC_SCAN  # This parameter provides the capability to flash the engine protect lamp (SPN 3041)."
    FlashMalfuncIndicatorLamp_DM1_ACC_ACC_SCAN: init-value=0, length=2, base-type=uint8, system-signal=FlashMalfuncIndicatorLamp_DM1_ACC_ACC_SCAN  # This parameter provides the capability to flash the MIL (SPN 3038)."
    FlashAmberWarningLamp_DM1_ACC_ACC_SCAN: init-value=0, length=2, base-type=uint8, system-signal=FlashAmberWarningLamp_DM1_ACC_ACC_SCAN  # This parameter provides the capability to flash the AWL (SPN 3040). "
    MalfunctionIndicatorLampStatus_DM1_ACC_ACC_SCAN: init-value=0, length=2, base-type=uint8, system-signal=MalfunctionIndicatorLampStatus_DM1_ACC_ACC_SCAN  # A lamp used to relay only emissions-related trouble code information."
    AmberWarningLampStatus_ACC_DM1_ACC_ACC_SCAN: init-value=0, length=2, base-type=uint8, system-signal=AmberWarningLampStatus_ACC_DM1_ACC_ACC_SCAN  # This lamp is used to relay trouble code information that is reporting a problem with the vehicle system but the vehicle need not be immediately stopped."
    RedStopLampState_DM1_ACC_ACC_SCAN: init-value=0, length=2, base-type=uint8, system-signal=RedStopLampState_DM1_ACC_ACC_SCAN  # This lamp is uesed to relay trouble code information that is of a severe enought condition that it warrants stopping the vehicle."
    ProtectLampStatus_DM1_ACC_ACC_SCAN: init-value=0, length=2, base-type=uint8, system-signal=ProtectLampStatus_DM1_ACC_ACC_SCAN  # This lamp is used to relay trouble code informatio that is reporting a problem with a vehicle system that is most probably not electronic subsystem related."
    DTC5_DM1_ECAS_SCAN: init-value=0, length=32, base-type=uint32, system-signal=DTC5_DM1_ECAS_SCAN  # Diagnostic Trouble Code"
    DTC4_DM1_ECAS_SCAN: init-value=0, length=32, base-type=uint32, system-signal=DTC4_DM1_ECAS_SCAN  # Diagnostic Trouble Code"
    DTC3_DM1_ECAS_SCAN: init-value=0, length=32, base-type=uint32, system-signal=DTC3_DM1_ECAS_SCAN  # Diagnostic Trouble Code"
    DTC2_DM1_ECAS_SCAN: init-value=0, length=32, base-type=uint32, system-signal=DTC2_DM1_ECAS_SCAN  # Diagnostic Trouble Code"
    DTC1_DM1_ECAS_SCAN: init-value=0, length=32, base-type=uint32, system-signal=DTC1_DM1_ECAS_SCAN  # Diagnostic Trouble Code"
    FlashRedStopLamp_DM1_ECAS_SCAN: init-value=0, length=2, base-type=uint8, system-signal=FlashRedStopLamp_DM1_ECAS_SCAN  # This parameter provides the capability to flash the RSL (SPN 3039)."
    FlashProtectLamp_DM1_ECAS_SCAN: init-value=0, length=2, base-type=uint8, system-signal=FlashProtectLamp_DM1_ECAS_SCAN  # This parameter provides the capability to flash the engine protect lamp (SPN 3041)."
    FlashMalfuncIndicatorLamp_DM1_ECAS_SCAN: init-value=0, length=2, base-type=uint8, system-signal=FlashMalfuncIndicatorLamp_DM1_ECAS_SCAN  # This parameter provides the capability to flash the MIL (SPN 3038)."
    FlashAmberWarningLamp_DM1_ECAS_SCAN: init-value=0, length=2, base-type=uint8, system-signal=FlashAmberWarningLamp_DM1_ECAS_SCAN  # This parameter provides the capability to flash the AWL (SPN 3040). "
    MalfunctionIndicatorLampStatus_DM1_ECAS_SCAN: init-value=0, length=2, base-type=uint8, system-signal=MalfunctionIndicatorLampStatus_DM1_ECAS_SCAN  # A lamp used to relay only emissions-related trouble code information."
    AmberWarningLampStatus_DM1_ECAS_SCAN: init-value=0, length=2, base-type=uint8, system-signal=AmberWarningLampStatus_DM1_ECAS_SCAN  # This lamp is used to relay trouble code information that is reporting a problem with the vehicle system but the vehicle need not be immediately stopped."
    RedStopLampState_DM1_ECAS_SCAN: init-value=0, length=2, base-type=uint8, system-signal=RedStopLampState_DM1_ECAS_SCAN  # This lamp is uesed to relay trouble code information that is of a severe enought condition that it warrants stopping the vehicle."
    ProtectLampStatus_DM1_ECAS_SCAN: init-value=0, length=2, base-type=uint8, system-signal=ProtectLampStatus_DM1_ECAS_SCAN  # This lamp is used to relay trouble code informatio that is reporting a problem with a vehicle system that is most probably not electronic subsystem related."
    CargoWeight_VW_ALCS_ECAS_SCAN: init-value=0, length=16, base-type=uint16, system-signal=CargoWeight_VW_ALCS_ECAS_SCAN  # The mass of freight carried."
    TrailerWeight_VW_ALCS_ECAS_SCAN: init-value=0, length=16, base-type=uint16, system-signal=TrailerWeight_VW_ALCS_ECAS_SCAN  # Total mass of freight-carrying vehicle designed to be pulled by truck, including the weight of the contents."
    AxleWeight_VW_ALCS_ECAS_SCAN: init-value=0, length=16, base-type=uint16, system-signal=AxleWeight_VW_ALCS_ECAS_SCAN  # Total mass imposed by the tires on the road surface at the specified axle."
    AxleLocation_VW_ALCS_ECAS_SCAN: init-value=0, length=8, base-type=uint8, system-signal=AxleLocation_VW_ALCS_ECAS_SCAN  # To identify to which of several similar devices (such as tires or fuel tanks) the information applies."
    SspensionCtrlRefusalInformation_ASC1_A_ECAS_ECAS_SCAN: init-value=0, length=4, base-type=uint8, system-signal=SspensionCtrlRefusalInformation_ASC1_A_ECAS_ECAS_SCAN  # Signal which indicates that the air suspension control cannot perform a request due to the operating conditions."
    SuspensionRemoteCtrl2_ASC1_A_ECAS_ECAS_SCAN: init-value=0, length=2, base-type=uint8, system-signal=SuspensionRemoteCtrl2_ASC1_A_ECAS_ECAS_SCAN  # Signal which indicates that the suspension system is controlled by remote control #2."
    SuspensionRemoteCtrl1_ASC1_A_ECAS_ECAS_SCAN: init-value=0, length=2, base-type=uint8, system-signal=SuspensionRemoteCtrl1_ASC1_A_ECAS_ECAS_SCAN  # Signal which indicates that the suspension system is controlled by remote control #1."
    RearAxleInBumperRange_ASC1_A_ECAS_ECAS_SCAN: init-value=0, length=2, base-type=uint8, system-signal=RearAxleInBumperRange_ASC1_A_ECAS_ECAS_SCAN  # Signal which indicates that the vehicle height at the rear axle (SPNs 1723 and 1724) is within the bumper range."
    FrontAxleInBumperRange_ASC1_A_ECAS_ECAS_SCAN: init-value=0, length=2, base-type=uint8, system-signal=FrontAxleInBumperRange_ASC1_A_ECAS_ECAS_SCAN  # Signal which indicates that the vehicle height at the front axle (SPNs 1721 and 1722) is within the bumper range."
    DoorRelease_ASC1_A_ECAS_ECAS_SCAN: init-value=0, length=2, base-type=uint8, system-signal=DoorRelease_ASC1_A_ECAS_ECAS_SCAN  # Signal which indicates that the doors may be opened."
    VehicleMotionInhibit_ASC1_A_ECAS_ECAS_SCAN: init-value=0, length=2, base-type=uint8, system-signal=VehicleMotionInhibit_ASC1_A_ECAS_ECAS_SCAN  # Signal which indicates whether vehicle motion is inhibited."
    SecurityDevice_ASC1_A_ECAS_ECAS_SCAN: init-value=0, length=2, base-type=uint8, system-signal=SecurityDevice_ASC1_A_ECAS_ECAS_SCAN  # The signal which indicates the status of the security device."
    LevelCtrlMode_ASC1_A_ECAS_ECAS_SCAN: init-value=0, length=4, base-type=uint8, system-signal=LevelCtrlMode_ASC1_A_ECAS_ECAS_SCAN
    KneelingInformation_ASC1_A_ECAS_ECAS_SCAN: init-value=0, length=4, base-type=uint8, system-signal=KneelingInformation_ASC1_A_ECAS_ECAS_SCAN
    LiftingCtrlModeRearAxle_ASC1_A_ECAS_ECAS_SCAN: init-value=0, length=2, base-type=uint8, system-signal=LiftingCtrlModeRearAxle_ASC1_A_ECAS_ECAS_SCAN
    LiftingCtrlModeFrontAxle_ASC1_A_ECAS_ECAS_SCAN: init-value=0, length=2, base-type=uint8, system-signal=LiftingCtrlModeFrontAxle_ASC1_A_ECAS_ECAS_SCAN
    LoweringCtrlModeRearAxle_ASC1_A_ECAS_ECAS_SCAN: init-value=0, length=2, base-type=uint8, system-signal=LoweringCtrlModeRearAxle_ASC1_A_ECAS_ECAS_SCAN
    LoweringCtrlModeFrontAxle_ASC1_A_ECAS_ECAS_SCAN: init-value=0, length=2, base-type=uint8, system-signal=LoweringCtrlModeFrontAxle_ASC1_A_ECAS_ECAS_SCAN
    AboveNominalLevelRearAxle_ASC1_A_ECAS_ECAS_SCAN: init-value=0, length=2, base-type=uint8, system-signal=AboveNominalLevelRearAxle_ASC1_A_ECAS_ECAS_SCAN  # Signal which indicates whether the actual height of the rear axle is above the nominal (desired) level of the rear axle."
    AboveNominalLevelFrontAxle_ASC1_A_ECAS_ECAS_SCAN: init-value=0, length=2, base-type=uint8, system-signal=AboveNominalLevelFrontAxle_ASC1_A_ECAS_ECAS_SCAN  # Signal which indicates whether the actual height of the front axle is above the nominal (desired) level of the front axle."
    BelowNominalLevelRearAxle_ASC1_A_ECAS_ECAS_SCAN: init-value=0, length=2, base-type=uint8, system-signal=BelowNominalLevelRearAxle_ASC1_A_ECAS_ECAS_SCAN  # Signal which indicates whether the actual height of the rear axle is below the nominal (desired) level for the rear axle."
    BelowNominalLevelFrontAxle_ASC1_A_ECAS_ECAS_SCAN: init-value=0, length=2, base-type=uint8, system-signal=BelowNominalLevelFrontAxle_ASC1_A_ECAS_ECAS_SCAN  # Signal which indicates whether the actual height of the front axle is below the nominal (desired) level for the front axle."
    NominalLevelRearAxle_ASC1_A_ECAS_ECAS_SCAN: init-value=0, length=4, base-type=uint8, system-signal=NominalLevelRearAxle_ASC1_A_ECAS_ECAS_SCAN  # Signal which indicates the nominal (desired) height of the rear axle to be controlled by the suspension system."
    NominalLevelFrontAxle_ASC1_A_ECAS_ECAS_SCAN: init-value=0, length=4, base-type=uint8, system-signal=NominalLevelFrontAxle_ASC1_A_ECAS_ECAS_SCAN  # Signal which indicates the nominal (desired) height of the front axle to be controlled by the suspension system."
    LiftAxle2Pos_ASC1_A_ECAS_ECAS_SCAN: init-value=0, length=2, base-type=uint8, system-signal=LiftAxle2Pos_ASC1_A_ECAS_ECAS_SCAN  # Signal which indicates the position / load condition of lift axle / tag axle #2."
    LiftAxle1Pos_ASC1_A_ECAS_ECAS_SCAN: init-value=0, length=2, base-type=uint8, system-signal=LiftAxle1Pos_ASC1_A_ECAS_ECAS_SCAN  # Signal which indicates the position / load condition of lift axle / tag axle #1."
    DTC5_DM1_DSM_SCAN: init-value=0, length=32, base-type=uint32, system-signal=DTC5_DM1_DSM_SCAN  # Diagnostic Trouble Code"
    DTC4_DM1_DSM_SCAN: init-value=0, length=32, base-type=uint32, system-signal=DTC4_DM1_DSM_SCAN  # Diagnostic Trouble Code"
    DTC3_DM1_DSM_SCAN: init-value=0, length=32, base-type=uint32, system-signal=DTC3_DM1_DSM_SCAN  # Diagnostic Trouble Code"
    DTC2_DM1_DSM_SCAN: init-value=0, length=32, base-type=uint32, system-signal=DTC2_DM1_DSM_SCAN  # Diagnostic Trouble Code"
    DTC1_DM1_DSM_SCAN: init-value=0, length=32, base-type=uint32, system-signal=DTC1_DM1_DSM_SCAN  # Diagnostic Trouble Code"
    FlashRedStopLamp_DM1_DSM_SCAN: init-value=0, length=2, base-type=uint8, system-signal=FlashRedStopLamp_DM1_DSM_SCAN  # This parameter provides the capability to flash the RSL (SPN 3039)."
    FlashProtectLamp_DM1_DSM_SCAN: init-value=0, length=2, base-type=uint8, system-signal=FlashProtectLamp_DM1_DSM_SCAN  # This parameter provides the capability to flash the engine protect lamp (SPN 3041)."
    FlashMalfuncIndicatorLamp_DM1_DSM_SCAN: init-value=0, length=2, base-type=uint8, system-signal=FlashMalfuncIndicatorLamp_DM1_DSM_SCAN  # This parameter provides the capability to flash the MIL (SPN 3038)."
    FlashAmberWarningLamp_DM1_DSM_SCAN: init-value=0, length=2, base-type=uint8, system-signal=FlashAmberWarningLamp_DM1_DSM_SCAN  # This parameter provides the capability to flash the AWL (SPN 3040). "
    MalfunctionIndicatorLampStatus_DM1_DSM_SCAN: init-value=0, length=2, base-type=uint8, system-signal=MalfunctionIndicatorLampStatus_DM1_DSM_SCAN  # A lamp used to relay only emissions-related trouble code information."
    AmberWarningLampStatus_DSM_DM1_DSM_SCAN: init-value=0, length=2, base-type=uint8, system-signal=AmberWarningLampStatus_DSM_DM1_DSM_SCAN  # This lamp is used to relay trouble code information that is reporting a problem with the vehicle system but the vehicle need not be immediately stopped."
    RedStopLampState_DM1_DSM_SCAN: init-value=0, length=2, base-type=uint8, system-signal=RedStopLampState_DM1_DSM_SCAN  # This lamp is uesed to relay trouble code information that is of a severe enought condition that it warrants stopping the vehicle."
    ProtectLampStatus_DM1_DSM_SCAN: init-value=0, length=2, base-type=uint8, system-signal=ProtectLampStatus_DM1_DSM_SCAN  # This lamp is used to relay trouble code informatio that is reporting a problem with a vehicle system that is most probably not electronic subsystem related."
    SWRC2AVN_VOLUME_UP_SWRC2AVN_SWRC_SCAN: init-value=0, length=2, base-type=uint8, system-signal=SWRC2AVN_VOLUME_UP_SWRC2AVN_SWRC_SCAN
    SWRC2AVN_VOLUME_DOWN_SWRC2AVN_SWRC_SCAN: init-value=0, length=2, base-type=uint8, system-signal=SWRC2AVN_VOLUME_DOWN_SWRC2AVN_SWRC_SCAN
    SWRC2AVN_SEEK_UP_SWRC2AVN_SWRC_SCAN: init-value=0, length=2, base-type=uint8, system-signal=SWRC2AVN_SEEK_UP_SWRC2AVN_SWRC_SCAN
    SWRC2AVN_SEEK_DOWN_SWRC2AVN_SWRC_SCAN: init-value=0, length=2, base-type=uint8, system-signal=SWRC2AVN_SEEK_DOWN_SWRC2AVN_SWRC_SCAN
    SWRC2AVN_PHONE_VOICE_RECOGNITION_SWRC2AVN_SWRC_SCAN: init-value=0, length=2, base-type=uint8, system-signal=SWRC2AVN_PHONE_VOICE_RECOGNITION_SWRC2AVN_SWRC_SCAN
    SWRC2AVN_MODE_SWRC2AVN_SWRC_SCAN: init-value=0, length=2, base-type=uint8, system-signal=SWRC2AVN_MODE_SWRC2AVN_SWRC_SCAN
    SWRC2AVN_MENU_TURN_LEFT_RIGHT_SWRC2AVN_SWRC_SCAN: init-value=0, length=2, base-type=uint8, system-signal=SWRC2AVN_MENU_TURN_LEFT_RIGHT_SWRC2AVN_SWRC_SCAN
    SWRC2AVN_AVN_MUTE_POWER_SWRC2AVN_SWRC_SCAN: init-value=0, length=2, base-type=uint8, system-signal=SWRC2AVN_AVN_MUTE_POWER_SWRC2AVN_SWRC_SCAN
    DTC5_DM1_PAS_SCAN: init-value=0, length=32, base-type=uint32, system-signal=DTC5_DM1_PAS_SCAN  # Diagnostic Trouble Code"
    DTC4_DM1_PAS_SCAN: init-value=0, length=32, base-type=uint32, system-signal=DTC4_DM1_PAS_SCAN  # Diagnostic Trouble Code"
    DTC3_DM1_PAS_SCAN: init-value=0, length=32, base-type=uint32, system-signal=DTC3_DM1_PAS_SCAN  # Diagnostic Trouble Code"
    DTC2_DM1_PAS_SCAN: init-value=0, length=32, base-type=uint32, system-signal=DTC2_DM1_PAS_SCAN  # Diagnostic Trouble Code"
    DTC1_DM1_PAS_SCAN: init-value=0, length=32, base-type=uint32, system-signal=DTC1_DM1_PAS_SCAN  # Diagnostic Trouble Code"
    FlashRedStopLamp_DM1_PAS_SCAN: init-value=0, length=2, base-type=uint8, system-signal=FlashRedStopLamp_DM1_PAS_SCAN  # This parameter provides the capability to flash the RSL (SPN 3039)."
    FlashProtectLamp_DM1_PAS_SCAN: init-value=0, length=2, base-type=uint8, system-signal=FlashProtectLamp_DM1_PAS_SCAN  # This parameter provides the capability to flash the engine protect lamp (SPN 3041)."
    FlashMalfuncIndicatorLamp_DM1_PAS_SCAN: init-value=0, length=2, base-type=uint8, system-signal=FlashMalfuncIndicatorLamp_DM1_PAS_SCAN  # This parameter provides the capability to flash the MIL (SPN 3038)."
    FlashAmberWarningLamp_DM1_PAS_SCAN: init-value=0, length=2, base-type=uint8, system-signal=FlashAmberWarningLamp_DM1_PAS_SCAN  # This parameter provides the capability to flash the AWL (SPN 3040). "
    MalfunctionIndicatorLampStatus_DM1_PAS_SCAN: init-value=0, length=2, base-type=uint8, system-signal=MalfunctionIndicatorLampStatus_DM1_PAS_SCAN  # A lamp used to relay only emissions-related trouble code information."
    AmberWarningLampStatus_LDW_DM1_PAS_SCAN: init-value=0, length=2, base-type=uint8, system-signal=AmberWarningLampStatus_LDW_DM1_PAS_SCAN  # This lamp is used to relay trouble code information that is reporting a problem with the vehicle system but the vehicle need not be immediately stopped."
    RedStopLampState_DM1_PAS_SCAN: init-value=0, length=2, base-type=uint8, system-signal=RedStopLampState_DM1_PAS_SCAN  # This lamp is uesed to relay trouble code information that is of a severe enought condition that it warrants stopping the vehicle."
    ProtectLampStatus_DM1_PAS_SCAN: init-value=0, length=2, base-type=uint8, system-signal=ProtectLampStatus_DM1_PAS_SCAN  # This lamp is used to relay trouble code informatio that is reporting a problem with a vehicle system that is most probably not electronic subsystem related."
    DTC5_DM01_AEBS_AEB_SCAN: init-value=0, length=32, base-type=uint32, system-signal=DTC5_DM01_AEBS_AEB_SCAN  # Diagnostic Trouble Code"
    DTC4_DM01_AEBS_AEB_SCAN: init-value=0, length=32, base-type=uint32, system-signal=DTC4_DM01_AEBS_AEB_SCAN  # Diagnostic Trouble Code"
    DTC3_DM01_AEBS_AEB_SCAN: init-value=0, length=32, base-type=uint32, system-signal=DTC3_DM01_AEBS_AEB_SCAN  # Diagnostic Trouble Code"
    DTC2_DM01_AEBS_AEB_SCAN: init-value=0, length=32, base-type=uint32, system-signal=DTC2_DM01_AEBS_AEB_SCAN  # Diagnostic Trouble Code"
    DTC1_DM01_AEBS_AEB_SCAN: init-value=0, length=32, base-type=uint32, system-signal=DTC1_DM01_AEBS_AEB_SCAN  # Diagnostic Trouble Code"
    FlashRedStopLamp_DM01_AEBS_AEB_SCAN: init-value=0, length=2, base-type=uint8, system-signal=FlashRedStopLamp_DM01_AEBS_AEB_SCAN  # This parameter provides the capability to flash the RSL (SPN 3039)."
    FlashProtectLamp_DM01_AEBS_AEB_SCAN: init-value=0, length=2, base-type=uint8, system-signal=FlashProtectLamp_DM01_AEBS_AEB_SCAN  # This parameter provides the capability to flash the engine protect lamp (SPN 3041)."
    FlashMalfuncIndicatorLamp_DM01_AEBS_AEB_SCAN: init-value=0, length=2, base-type=uint8, system-signal=FlashMalfuncIndicatorLamp_DM01_AEBS_AEB_SCAN  # This parameter provides the capability to flash the MIL (SPN 3038)."
    FlashAmberWarningLamp_DM01_AEBS_AEB_SCAN: init-value=0, length=2, base-type=uint8, system-signal=FlashAmberWarningLamp_DM01_AEBS_AEB_SCAN  # This parameter provides the capability to flash the AWL (SPN 3040). "
    MalfunctionIndicatorLampStatus_DM01_AEBS_AEB_SCAN: init-value=0, length=2, base-type=uint8, system-signal=MalfunctionIndicatorLampStatus_DM01_AEBS_AEB_SCAN  # A lamp used to relay only emissions-related trouble code information."
    AmberWarningLampStatus_AEB_DM01_AEBS_AEB_SCAN: init-value=0, length=2, base-type=uint8, system-signal=AmberWarningLampStatus_AEB_DM01_AEBS_AEB_SCAN  # This lamp is used to relay trouble code information that is reporting a problem with the vehicle system but the vehicle need not be immediately stopped."
    RedStopLampState_DM01_AEBS_AEB_SCAN: init-value=0, length=2, base-type=uint8, system-signal=RedStopLampState_DM01_AEBS_AEB_SCAN  # This lamp is uesed to relay trouble code information that is of a severe enought condition that it warrants stopping the vehicle."
    ProtectLampStatus_DM01_AEBS_AEB_SCAN: init-value=0, length=2, base-type=uint8, system-signal=ProtectLampStatus_DM01_AEBS_AEB_SCAN  # This lamp is used to relay trouble code informatio that is reporting a problem with a vehicle system that is most probably not electronic subsystem related."
    DTC5_DM1_LDW_FCW_SCAN: init-value=0, length=32, base-type=uint32, system-signal=DTC5_DM1_LDW_FCW_SCAN  # Diagnostic Trouble Code"
    DTC4_DM1_LDW_FCW_SCAN: init-value=0, length=32, base-type=uint32, system-signal=DTC4_DM1_LDW_FCW_SCAN  # Diagnostic Trouble Code"
    DTC3_DM1_LDW_FCW_SCAN: init-value=0, length=32, base-type=uint32, system-signal=DTC3_DM1_LDW_FCW_SCAN  # Diagnostic Trouble Code"
    DTC2_DM1_LDW_FCW_SCAN: init-value=0, length=32, base-type=uint32, system-signal=DTC2_DM1_LDW_FCW_SCAN  # Diagnostic Trouble Code"
    DTC1_DM1_LDW_FCW_SCAN: init-value=0, length=32, base-type=uint32, system-signal=DTC1_DM1_LDW_FCW_SCAN  # Diagnostic Trouble Code"
    FlashRedStopLamp_DM1_LDW_FCW_SCAN: init-value=0, length=2, base-type=uint8, system-signal=FlashRedStopLamp_DM1_LDW_FCW_SCAN  # This parameter provides the capability to flash the RSL (SPN 3039)."
    FlashProtectLamp_DM1_LDW_FCW_SCAN: init-value=0, length=2, base-type=uint8, system-signal=FlashProtectLamp_DM1_LDW_FCW_SCAN  # This parameter provides the capability to flash the engine protect lamp (SPN 3041)."
    FlashMalfuncIndicatorLamp_DM1_LDW_FCW_SCAN: init-value=0, length=2, base-type=uint8, system-signal=FlashMalfuncIndicatorLamp_DM1_LDW_FCW_SCAN  # This parameter provides the capability to flash the MIL (SPN 3038)."
    FlashAmberWarningLamp_DM1_LDW_FCW_SCAN: init-value=0, length=2, base-type=uint8, system-signal=FlashAmberWarningLamp_DM1_LDW_FCW_SCAN  # This parameter provides the capability to flash the AWL (SPN 3040). "
    MalfunctionIndicatorLampStatus_DM1_LDW_FCW_SCAN: init-value=0, length=2, base-type=uint8, system-signal=MalfunctionIndicatorLampStatus_DM1_LDW_FCW_SCAN  # A lamp used to relay only emissions-related trouble code information."
    AmberWarningLampStatus_LDW_DM1_LDW_FCW_SCAN: init-value=0, length=2, base-type=uint8, system-signal=AmberWarningLampStatus_LDW_DM1_LDW_FCW_SCAN  # This lamp is used to relay trouble code information that is reporting a problem with the vehicle system but the vehicle need not be immediately stopped."
    RedStopLampState_DM1_LDW_FCW_SCAN: init-value=0, length=2, base-type=uint8, system-signal=RedStopLampState_DM1_LDW_FCW_SCAN  # This lamp is uesed to relay trouble code information that is of a severe enought condition that it warrants stopping the vehicle."
    ProtectLampStatus_DM1_LDW_FCW_SCAN: init-value=0, length=2, base-type=uint8, system-signal=ProtectLampStatus_DM1_LDW_FCW_SCAN  # This lamp is used to relay trouble code informatio that is reporting a problem with a vehicle system that is most probably not electronic subsystem related."
    MessageChecksum_TSC1_TSC1_EXR_ABS_EBS_SCAN: init-value=0, length=4, base-type=uint8, system-signal=MessageChecksum_TSC1_TSC1_EXR_ABS_EBS_SCAN  # The message checksum is used to verify the signal path from the transmitting device to the receiving device."
    MessageCounter_TSC1_EXR_ABS_EBS_SCAN: init-value=0, length=4, base-type=uint8, system-signal=MessageCounter_TSC1_EXR_ABS_EBS_SCAN  # The message counter is used to detect situations where the transmitting ECU malfunction repeats the same frame all theThe message counter is used to detect situations where the transmitting ECU malfunction repeats the same frame all theThe message counter is used to detect situations where the transmitting ECU malfunction repeats the same frame all theThe message counter is used to detect situations where the transmitting ECU malfunction repeats the same frame all theThe message counter is used to detect s"
    ControlPurpose_TSC1_EXR_ABS_EBS_SCAN: init-value=0, length=5, base-type=uint8, system-signal=ControlPurpose_TSC1_EXR_ABS_EBS_SCAN  # State signal which indicates which control mode the sending device is using to generate the TSC1 command."
    TransmissionRate_TSC1_EXR_ABS_EBS_SCAN: init-value=0, length=3, base-type=uint8, system-signal=TransmissionRate_TSC1_EXR_ABS_EBS_SCAN  # This parameter indicates the transmission rate at which the sending device will transmit the TSC1 message."
    EngRequstedTorqueLimit_ABS_EXR_TSC1_EXR_ABS_EBS_SCAN: init-value=0, length=8, base-type=uint8, system-signal=EngRequstedTorqueLimit_ABS_EXR_TSC1_EXR_ABS_EBS_SCAN  # Parameter provided to the engine or retarder in the torque/speed control message for controlling or limiting the output torque."
    EngRqedSpeed_SpeedLimit_TSC1_EXR_ABS_EBS_SCAN: init-value=0, length=16, base-type=uint16, system-signal=EngRqedSpeed_SpeedLimit_TSC1_EXR_ABS_EBS_SCAN  # Parameter provided to the engine from external sources in the torque/speed control message."
    OverrideCtrlModePriority_TSC1_EXR_ABS_EBS_SCAN: init-value=0, length=2, base-type=uint8, system-signal=OverrideCtrlModePriority_TSC1_EXR_ABS_EBS_SCAN
    EngRqedSpeedCtrlConditions_TSC1_EXR_ABS_EBS_SCAN: init-value=0, length=2, base-type=uint8, system-signal=EngRqedSpeedCtrlConditions_TSC1_EXR_ABS_EBS_SCAN  # This mode tells the engine control system the governor characteristics that are desired during speed control."
    EngOverrideCtrlMode_TSC1_EXR_ABS_EBS_SCAN: init-value=0, length=2, base-type=uint8, system-signal=EngOverrideCtrlMode_TSC1_EXR_ABS_EBS_SCAN
    EngineRequestedTorqueHiRes_TSC1_EXR_ABS_EBS_SCAN: init-value=0, length=4, base-type=uint8, system-signal=EngineRequestedTorqueHiRes_TSC1_EXR_ABS_EBS_SCAN  # This parameter displays an additional torque in percent of the reference engine torque."
    SPN1481_SAOfCtrllngDvcFrBrkCntrl_EBC1_ABS_EBS_SCAN: init-value=0, length=8, base-type=uint8, system-signal=SPN1481_SAOfCtrllngDvcFrBrkCntrl_EBC1_ABS_EBS_SCAN  # The source address of the SAE J1939 device currently controlling the brake system."
    SPN521_BrakePedalPos_EBC1_ABS_EBS_SCAN: init-value=0, length=8, base-type=uint8, system-signal=SPN521_BrakePedalPos_EBC1_ABS_EBS_SCAN  # Ratio of brake pedal position to maximum pedal position."
    SPN1792_TrilerABSWarningSignal_EBC1_ABS_EBS_SCAN: init-value=0, length=2, base-type=uint8, system-signal=SPN1792_TrilerABSWarningSignal_EBC1_ABS_EBS_SCAN  # This parameter commands the tractor-mounted trailer ABS optical warning signal."
    SPN1836_TrailerABSStatus_EBC1_ABS_EBS_SCAN: init-value=0, length=2, base-type=uint8, system-signal=SPN1836_TrailerABSStatus_EBC1_ABS_EBS_SCAN  # State signal which indicates that ABS in the trailer is actively controlling the brakes."
    SPN1911_HaltBrakeSwitch_EBC1_ABS_EBS_SCAN: init-value=0, length=2, base-type=uint8, system-signal=SPN1911_HaltBrakeSwitch_EBC1_ABS_EBS_SCAN  # Switch signal which indicates the position of the halt brake switch."
    SPN1793_ATC_ASRInformationSignal_EBC1_ABS_EBS_SCAN: init-value=0, length=2, base-type=uint8, system-signal=SPN1793_ATC_ASRInformationSignal_EBC1_ABS_EBS_SCAN  # This parameter commands the ATC/ASR driver information signal, for example a dash lamp."
    SPN1438_ABSEBSAmberWarningSignal_EBC1_ABS_EBS_SCAN: init-value=0, length=2, base-type=uint8, system-signal=SPN1438_ABSEBSAmberWarningSignal_EBC1_ABS_EBS_SCAN
    SPN1439_EBSRedWarningSignal_EBC1_ABS_EBS_SCAN: init-value=0, length=2, base-type=uint8, system-signal=SPN1439_EBSRedWarningSignal_EBC1_ABS_EBS_SCAN
    SPN1243_ABSFullyOperational_EBC1_ABS_EBS_SCAN: init-value=0, length=2, base-type=uint8, system-signal=SPN1243_ABSFullyOperational_EBC1_ABS_EBS_SCAN
    SPN973_EngRetarderSelection_EBC1_ABS_EBS_SCAN: init-value=0, length=8, base-type=uint8, system-signal=SPN973_EngRetarderSelection_EBC1_ABS_EBS_SCAN
    SPN969_RemoteAccelEnableSwitch_EBC1_ABS_EBS_SCAN: init-value=0, length=2, base-type=uint8, system-signal=SPN969_RemoteAccelEnableSwitch_EBC1_ABS_EBS_SCAN  # Switch signal which indicates that the remote accelerator has been enabled and controls the engine."
    SPN970_EngAuxEngShutdownSwitch_EBC1_ABS_EBS_SCAN: init-value=0, length=2, base-type=uint8, system-signal=SPN970_EngAuxEngShutdownSwitch_EBC1_ABS_EBS_SCAN  # Switch signal which requests that all engine fueling stop."
    SPN971_EngDerateSwitch_EBC1_ABS_EBS_SCAN: init-value=0, length=2, base-type=uint8, system-signal=SPN971_EngDerateSwitch_EBC1_ABS_EBS_SCAN  # Switch signal used to activate the torque limiting feature of the engine."
    SPN972_AccelInterlockSwitch_EBC1_ABS_EBS_SCAN: init-value=0, length=2, base-type=uint8, system-signal=SPN972_AccelInterlockSwitch_EBC1_ABS_EBS_SCAN  # Switch signal used to disable the accelerator and remote accelerator inputs, causing the engine to return to idle."
    SPN1238TractionCtrlOverrideSW_EBC1_ABS_EBS_SCAN: init-value=0, length=2, base-type=uint8, system-signal=SPN1238TractionCtrlOverrideSW_EBC1_ABS_EBS_SCAN  # Switch signal which indicates the position of the traction control override switch."
    SPN577_ASRHillHolderSwitch_EBC1_ABS_EBS_SCAN: init-value=0, length=2, base-type=uint8, system-signal=SPN577_ASRHillHolderSwitch_EBC1_ABS_EBS_SCAN  # Switch signal which indicates the position of the ASR hill holder switch."
    SPN576_ASROffroadSwitch_EBC1_ABS_EBS_SCAN: init-value=0, length=2, base-type=uint8, system-signal=SPN576_ASROffroadSwitch_EBC1_ABS_EBS_SCAN  # Switch signal which indicates the position of the ASR off-road switch."
    SPN575_ABSOffroadSwitch_EBC1_ABS_EBS_SCAN: init-value=0, length=2, base-type=uint8, system-signal=SPN575_ABSOffroadSwitch_EBC1_ABS_EBS_SCAN  # Switch signal which indicates the position of the ABS off-road switch."
    SPN1121_EBSBrakeSwitch_EBC1_ABS_EBS_SCAN: init-value=0, length=2, base-type=uint8, system-signal=SPN1121_EBSBrakeSwitch_EBC1_ABS_EBS_SCAN  # Switch signal which indicates that the brake pedal is being pressed."
    SPN563_AntiLockBrakingActive_EBC1_ABS_EBS_SCAN: init-value=0, length=2, base-type=uint8, system-signal=SPN563_AntiLockBrakingActive_EBC1_ABS_EBS_SCAN  # State signal which indicates that the ABS is active."
    SPN562_ASRBrakeCtrlActive_EBC1_ABS_EBS_SCAN: init-value=0, length=2, base-type=uint8, system-signal=SPN562_ASRBrakeCtrlActive_EBC1_ABS_EBS_SCAN  # State signal which indicates that ASR brake control is active."
    SPN561_ASREngCtrlActive_EBC1_ABS_EBS_SCAN: init-value=0, length=2, base-type=uint8, system-signal=SPN561_ASREngCtrlActive_EBC1_ABS_EBS_SCAN  # State signal which indicates that ASR engine control has been commanded to be active."
    RelativeSpeedRearAxle2LeftWheel_EBC2_ABS_EBS_SCAN: init-value=0, length=8, base-type=uint8, system-signal=RelativeSpeedRearAxle2LeftWheel_EBC2_ABS_EBS_SCAN  # The speed of the rear axle #2, left wheel relative to the front axle speed, SPN 904.The speed of the rear axle #2, left wheel relative to the front axle speed, SPN 904.The speed of the rear axle #2, left wheel relative to the front axle speed, SPN 904."
    RelativeSpeedRearAxle1LeftWheel_EBC2_ABS_EBS_SCAN: init-value=0, length=8, base-type=uint8, system-signal=RelativeSpeedRearAxle1LeftWheel_EBC2_ABS_EBS_SCAN  # The speed of the rear axle #1, left wheel relative to the front axle speed, SPN 904.The speed of the rear axle #1, left wheel relative to the front axle speed, SPN 904.The speed of the rear axle #1, left wheel relative to the front axle speed, SPN 904."
    RelativeSpeedFrontAxleLeftWheel_EBC2_ABS_EBS_SCAN: init-value=0, length=8, base-type=uint8, system-signal=RelativeSpeedFrontAxleLeftWheel_EBC2_ABS_EBS_SCAN  # The speed of the front axle, left wheel relative to the front axle speed, SPN 904.The speed of the front axle, left wheel relative to the front axle speed, SPN 904.The speed of the front axle, left wheel relative to the front axle speed, SPN 904."
    FrontAxleSpeed_EBC2_ABS_EBS_SCAN: init-value=0, length=16, base-type=uint16, system-signal=FrontAxleSpeed_EBC2_ABS_EBS_SCAN  # The average speed of the two front wheels.The average speed of the two front wheels.The average speed of the two front wheels."
    RelativeSpeedRearAxle2RightWheel_EBC2_ABS_EBS_SCAN: init-value=0, length=8, base-type=uint8, system-signal=RelativeSpeedRearAxle2RightWheel_EBC2_ABS_EBS_SCAN  # The speed of the rear axle #2, right wheel relative to the front axle speed, SPN 904."
    RelativeSpeedRearAxle1RightWheel_EBC2_ABS_EBS_SCAN: init-value=0, length=8, base-type=uint8, system-signal=RelativeSpeedRearAxle1RightWheel_EBC2_ABS_EBS_SCAN  # The speed of the rear axle #1, right wheel relative to the front axle speed, SPN 904."
    RelativeSpeedFrontAxleRightWheel_EBC2_ABS_EBS_SCAN: init-value=0, length=8, base-type=uint8, system-signal=RelativeSpeedFrontAxleRightWheel_EBC2_ABS_EBS_SCAN  # The speed of the front axle, right wheel relative to the front axle speed, SPN 904."
    MessageChecksum_TSC1_TSC1_ER_ABS_EBS_SCAN: init-value=0, length=4, base-type=uint8, system-signal=MessageChecksum_TSC1_TSC1_ER_ABS_EBS_SCAN  # The message checksum is used to verify the signal path from the transmitting device to the receiving device."
    MessageCounter_TSC1_ER_ABS_EBS_SCAN: init-value=0, length=4, base-type=uint8, system-signal=MessageCounter_TSC1_ER_ABS_EBS_SCAN  # The message counter is used to detect situations where the transmitting ECU malfunction repeats the same frame all theThe message counter is used to detect situations where the transmitting ECU malfunction repeats the same frame all theThe message counter is used to detect situations where the transmitting ECU malfunction repeats the same frame all theThe message counter is used to detect situations where the transmitting ECU malfunction repeats the same frame all theThe message counter is used to detect s"
    ControlPurpose_TSC1_ER_ABS_EBS_SCAN: init-value=0, length=5, base-type=uint8, system-signal=ControlPurpose_TSC1_ER_ABS_EBS_SCAN  # State signal which indicates which control mode the sending device is using to generate the TSC1 command."
    TransmissionRate_TSC1_ER_ABS_EBS_SCAN: init-value=0, length=3, base-type=uint8, system-signal=TransmissionRate_TSC1_ER_ABS_EBS_SCAN  # This parameter indicates the transmission rate at which the sending device will transmit the TSC1 message."
    EngRequstedTorqueLimit_ABS_ER_TSC1_ER_ABS_EBS_SCAN: init-value=0, length=8, base-type=uint8, system-signal=EngRequstedTorqueLimit_ABS_ER_TSC1_ER_ABS_EBS_SCAN  # Parameter provided to the engine or retarder in the torque/speed control message for controlling or limiting the output torque."
    EngRqedSpeed_SpeedLimit_TSC1_ER_ABS_EBS_SCAN: init-value=0, length=16, base-type=uint16, system-signal=EngRqedSpeed_SpeedLimit_TSC1_ER_ABS_EBS_SCAN  # Parameter provided to the engine from external sources in the torque/speed control message."
    OverrideCtrlModePriority_TSC1_ER_ABS_EBS_SCAN: init-value=0, length=2, base-type=uint8, system-signal=OverrideCtrlModePriority_TSC1_ER_ABS_EBS_SCAN
    EngRqedSpeedCtrlConditions_TSC1_ER_ABS_EBS_SCAN: init-value=0, length=2, base-type=uint8, system-signal=EngRqedSpeedCtrlConditions_TSC1_ER_ABS_EBS_SCAN  # This mode tells the engine control system the governor characteristics that are desired during speed control."
    EngOverrideCtrlMode_TSC1_ER_ABS_EBS_SCAN: init-value=0, length=2, base-type=uint8, system-signal=EngOverrideCtrlMode_TSC1_ER_ABS_EBS_SCAN
    EngineRequestedTorqueHiRes_TSC1_ER_ABS_EBS_SCAN: init-value=0, length=4, base-type=uint8, system-signal=EngineRequestedTorqueHiRes_TSC1_ER_ABS_EBS_SCAN  # This parameter displays an additional torque in percent of the reference engine torque."
    YCBrakeCtrlActive_VDC1_ABS_EBS_SCAN: init-value=0, length=2, base-type=uint8, system-signal=YCBrakeCtrlActive_VDC1_ABS_EBS_SCAN  # State signal which indicates that Yaw Control (YC) has activated brake control."
    YCEngCtrlActive_VDC1_ABS_EBS_SCAN: init-value=0, length=2, base-type=uint8, system-signal=YCEngCtrlActive_VDC1_ABS_EBS_SCAN  # State Signal which indicates that the Yaw Control (YC) has commanded engine control to be active."
    ROPBrakeCtrlActive_VDC1_ABS_EBS_SCAN: init-value=0, length=2, base-type=uint8, system-signal=ROPBrakeCtrlActive_VDC1_ABS_EBS_SCAN  # State signal which indicates that Roll over Prevention (ROP) has activated brake control."
    ROPEngCtrlActive_VDC1_ABS_EBS_SCAN: init-value=0, length=2, base-type=uint8, system-signal=ROPEngCtrlActive_VDC1_ABS_EBS_SCAN  # State Signal which indicates that the Roll Over Prevention (ROP) has commanded engine control to be active."
    VDCBrakeLightRq_VDC1_ABS_EBS_SCAN: init-value=0, length=2, base-type=uint8, system-signal=VDCBrakeLightRq_VDC1_ABS_EBS_SCAN
    VDCFullyOperational_VDC1_ABS_EBS_SCAN: init-value=0, length=2, base-type=uint8, system-signal=VDCFullyOperational_VDC1_ABS_EBS_SCAN  # Signal that indicates whether VDC is fully operational or whether its functionality is reduced by a permanent or temporary (e."
    VDCInformationSignal_VDC1_ABS_EBS_SCAN: init-value=0, length=2, base-type=uint8, system-signal=VDCInformationSignal_VDC1_ABS_EBS_SCAN  # This parameter commands the VDC information signal, for example a dash lamp."
    ForwardCollisionWarning_ACC1_ACC_ACC_SCAN: init-value=0, length=2, base-type=uint8, system-signal=ForwardCollisionWarning_ACC1_ACC_ACC_SCAN  # This parameter indicates if a collision is imminent and strong driver reaction either by braking hard or by an avoidance maneuver are imperative to prevent a collisionThis parameter indicates if a collision is imminent and strong driver reaction either by braking hard or by an avoidanceThis parameter indicates if a collision is imminent and strong driver reaction either by braking hard or by an avoidance maneuver are imperative to prevent a collision"
    ACCDistanceAlertSignal_ACC1_ACC_ACC_SCAN: init-value=0, length=2, base-type=uint8, system-signal=ACCDistanceAlertSignal_ACC1_ACC_ACC_SCAN  # Signal to indicate to the operator that the ACC system is not able to maintain the distance to the target.Signal to indicate to the operator that the ACC system is not able to maintain the distance to the target. Example: TargetSignal to indicate to the operator that the ACC system is not able to maintain the distance to the target."
    ACCSystemShutoffWarning_ACC1_ACC_ACC_SCAN: init-value=0, length=2, base-type=uint8, system-signal=ACCSystemShutoffWarning_ACC1_ACC_ACC_SCAN  # Signal to warn the driver of system deactivation due to non-driver actions.Signal to warn the driver of system deactivation due to non-driver actions. Example: Attempting to control vehicle speedSignal to warn the driver of system deactivation due to non-driver actions."
    ACCTargetDetected_ACC1_ACC_ACC_SCAN: init-value=0, length=2, base-type=uint8, system-signal=ACCTargetDetected_ACC1_ACC_ACC_SCAN  # Signal to indicate to the driver that the ACC system has detected a target.Signal to indicate to the driver that the ACC system has detected a target.Signal to indicate to the driver that the ACC system has detected a target."
    RoadCurvature_ACC1_ACC_ACC_SCAN: init-value=0, length=16, base-type=uint16, system-signal=RoadCurvature_ACC1_ACC_ACC_SCAN  # Estimated value of the current road curvature for use by the adaptive cruise control system.Estimated value of the current road curvature for use by the adaptive cruise control system. Positive values are used forEstimated value of the current road curvature for use by the adaptive cruise control system."
    AdptveCruiseCtrlSetDistanceMode_ACC1_ACC_ACC_SCAN: init-value=0, length=3, base-type=uint8, system-signal=AdptveCruiseCtrlSetDistanceMode_ACC1_ACC_ACC_SCAN  # Selected distance mode for adaptive cruise control.Selected distance mode for adaptive cruise control."
    AdaptiveCruiseCtrlMode_ACC1_ACC_ACC_SCAN: init-value=0, length=3, base-type=uint8, system-signal=AdaptiveCruiseCtrlMode_ACC1_ACC_ACC_SCAN  # This parameter is used to indicate the current state, or mode, of operation by the Adaptive Cruise Control (ACC) device.This parameter is used to indicate the current state, or mode, of operation by the Adaptive Cruise Control (ACC) device.This parameter is used to indicate the current state, or mode, of operation by the Adaptive Cruise Control (ACC) device."
    AdaptiveCruiseCtrlSetSpeed_ACC1_ACC_ACC_SCAN: init-value=0, length=8, base-type=uint8, system-signal=AdaptiveCruiseCtrlSetSpeed_ACC1_ACC_ACC_SCAN  # Value of the desired (chosen) velocity of the adaptive cruise control system. Operating Range : 0 to 120km/hValue of the desired (chosen) velocity of the adaptive cruise control system.Value of the desired (chosen) velocity of the adaptive cruise control system. Operating Range : 0 to 120km/h"
    DistanceToForwardVehicle_ACC1_ACC_ACC_SCAN: init-value=0, length=8, base-type=uint8, system-signal=DistanceToForwardVehicle_ACC1_ACC_ACC_SCAN  # Distance to the preceding vehicle situated within 250 m in the same lane and moving in the same direction.Distance to the preceding vehicle situated within 250 m in the same lane and moving in the same direction.Distance to the preceding vehicle situated within 250 m in the same lane and moving in the same direction."
    SpeedOfForwardVehicle_ACC1_ACC_ACC_SCAN: init-value=0, length=8, base-type=uint8, system-signal=SpeedOfForwardVehicle_ACC1_ACC_ACC_SCAN  # Absolute velocity of the preceding vehicle situated within 250 m in the same lane and moving in the same direction.Absolute velocity of the preceding vehicle situated within 250 m in the same lane and moving in the same direction.Absolute velocity of the preceding vehicle situated within 250 m in the same lane and moving in the same direction."
    ACC_UsageDemand_ACC2_SMD_SMD_SCAN: init-value=0, length=2, base-type=uint8, system-signal=ACC_UsageDemand_ACC2_SMD_SMD_SCAN
    RqedACCDistanceMode_ACC2_SMD_SMD_SCAN: init-value=0, length=3, base-type=uint8, system-signal=RqedACCDistanceMode_ACC2_SMD_SMD_SCAN
    ACC_UsageDemand_ACC2_SWRC_SWRC_SCAN: init-value=0, length=2, base-type=uint8, system-signal=ACC_UsageDemand_ACC2_SWRC_SWRC_SCAN  # This parameter indicates the drivers demand to activate or deactivate ACC keeping distance control."
    RqedACCDistanceMode_ACC2_SWRC_SWRC_SCAN: init-value=0, length=3, base-type=uint8, system-signal=RqedACCDistanceMode_ACC2_SWRC_SWRC_SCAN  # The Requested Distance Control Mode to the ACC system from the operators interface."
    DriverState_GUI_DSM1_DSM_SCAN: init-value=0, length=2, base-type=uint8, system-signal=DriverState_GUI_DSM1_DSM_SCAN
    WarningSoundActivation_DSM1_DSM_SCAN: init-value=0, length=2, base-type=uint8, system-signal=WarningSoundActivation_DSM1_DSM_SCAN
    DriverState_DSM1_DSM_SCAN: init-value=0, length=2, base-type=uint8, system-signal=DriverState_DSM1_DSM_SCAN
    DsmActivation_DSM1_DSM_SCAN: init-value=0, length=2, base-type=uint8, system-signal=DsmActivation_DSM1_DSM_SCAN
    SWRC2IC_TRIP_SWRC2IC_SWRC_SCAN: init-value=0, length=2, base-type=uint8, system-signal=SWRC2IC_TRIP_SWRC2IC_SWRC_SCAN
    SWRC2IC_MENU_ENTER_SWRC2IC_SWRC_SCAN: init-value=0, length=2, base-type=uint8, system-signal=SWRC2IC_MENU_ENTER_SWRC2IC_SWRC_SCAN
    SWRC2IC_MENU_UP_DOWN_SWRC2IC_SWRC_SCAN: init-value=0, length=2, base-type=uint8, system-signal=SWRC2IC_MENU_UP_DOWN_SWRC2IC_SWRC_SCAN
    SWRC2IC_ESC_ESCAPE_VER_CHECK_SWRC2IC_SWRC_SCAN: init-value=0, length=2, base-type=uint8, system-signal=SWRC2IC_ESC_ESCAPE_VER_CHECK_SWRC2IC_SWRC_SCAN
    SWRC2IC_MENU_SWRC2IC_SWRC_SCAN: init-value=0, length=2, base-type=uint8, system-signal=SWRC2IC_MENU_SWRC2IC_SWRC_SCAN
    SelfDiagnosisState_CWI1_PAS_SCAN: init-value=0, length=2, base-type=uint8, system-signal=SelfDiagnosisState_CWI1_PAS_SCAN  # SelfDiagnosisState"
    PASOffSwitchState_CWI1_PAS_SCAN: init-value=0, length=2, base-type=uint8, system-signal=PASOffSwitchState_CWI1_PAS_SCAN  # PASOffSwitchState"
    RearDetectionZone_RH_Side_CWI1_PAS_SCAN: init-value=0, length=2, base-type=uint8, system-signal=RearDetectionZone_RH_Side_CWI1_PAS_SCAN  # RearDetectionZone_RH_Side"
    RearDetectionZone_RH_Center_CWI1_PAS_SCAN: init-value=0, length=2, base-type=uint8, system-signal=RearDetectionZone_RH_Center_CWI1_PAS_SCAN  # RearDetectionZone_RH_Center"
    RearDetectionZone_LH_Center_CWI1_PAS_SCAN: init-value=0, length=2, base-type=uint8, system-signal=RearDetectionZone_LH_Center_CWI1_PAS_SCAN  # RearDetectionZone_LH_Center"
    RearDetectionZone_LH_Side_CWI1_PAS_SCAN: init-value=0, length=2, base-type=uint8, system-signal=RearDetectionZone_LH_Side_CWI1_PAS_SCAN  # RearDetectionZone_LH_Side"
    RearDetectionDistance_RS_CWI2_PAS_SCAN: init-value=0, length=16, base-type=uint16, system-signal=RearDetectionDistance_RS_CWI2_PAS_SCAN  # RearDetectionDistance_RS"
    RearDetectionDistance_RC_CWI2_PAS_SCAN: init-value=0, length=16, base-type=uint16, system-signal=RearDetectionDistance_RC_CWI2_PAS_SCAN  # RearDetectionDistance_RC"
    RearDetectionDistance_LC_CWI2_PAS_SCAN: init-value=0, length=16, base-type=uint16, system-signal=RearDetectionDistance_LC_CWI2_PAS_SCAN  # RearDetectionDistance_LC"
    RearDetectionDistance_LS_CWI2_PAS_SCAN: init-value=0, length=16, base-type=uint16, system-signal=RearDetectionDistance_LS_CWI2_PAS_SCAN  # RearDetectionDistance_LS"
    TimeToCollisionRelevantObject_AEBS1_AEBS_AEB_SCAN: init-value=0, length=8, base-type=uint8, system-signal=TimeToCollisionRelevantObject_AEBS1_AEBS_AEB_SCAN  # The time to collision is the duration after which the predicted travelling paths of host vehicle and relevant object lead to a distance of 0m between both."
    BendOffProbOfRelevantObject_AEBS1_AEBS_AEB_SCAN: init-value=0, length=3, base-type=uint8, system-signal=BendOffProbOfRelevantObject_AEBS1_AEBS_AEB_SCAN  # Probabilty if monitored relevant object might start a turning maneuver, which could clear the travelling path of the host vehicle."
    RelevantObjectDetectedForAEBS_AEBS1_AEBS_AEB_SCAN: init-value=0, length=3, base-type=uint8, system-signal=RelevantObjectDetectedForAEBS_AEBS1_AEBS_AEB_SCAN  # Indication if the advanced emergency braking system (AEBS) is monitoring a relevant object"
    CollisonWarningStatus_AEBS1_AEBS_AEB_SCAN: init-value=0, length=4, base-type=uint8, system-signal=CollisonWarningStatus_AEBS1_AEBS_AEB_SCAN  # To implement different HMI (human machine interface) concepts, e.g. visual only, visual/audible, different warning tones etc., the AEBS provides different levels of collision warning. between lowest warning level and highest warning level are increasing."
    AdvancedEmergBrakingSysState_AEBS1_AEBS_AEB_SCAN: init-value=0, length=4, base-type=uint8, system-signal=AdvancedEmergBrakingSysState_AEBS1_AEBS_AEB_SCAN  # Current operational state of advanced emergency braking system 1:due to boundary conditions necessary for operation / 3:no warning and no braking active 5:acoustic signal, cruise control turned off, torque limitation / 6:brake jerk or partial braking"
    LnDprtureIndicationEnableStatus_FLI2_LDW_FCW_SCAN: init-value=0, length=2, base-type=uint8, system-signal=LnDprtureIndicationEnableStatus_FLI2_LDW_FCW_SCAN  # Indicates whether lane departure indication is active."
    LaneTrackingStatusLeftSide_FLI2_LDW_FCW_SCAN: init-value=0, length=2, base-type=uint8, system-signal=LaneTrackingStatusLeftSide_FLI2_LDW_FCW_SCAN  # Indicates whether the left side is tracking lane."
    LaneTrackingStatusRightSide_FLI2_LDW_FCW_SCAN: init-value=0, length=2, base-type=uint8, system-signal=LaneTrackingStatusRightSide_FLI2_LDW_FCW_SCAN  # Indicates whether right side is tracking lane."
    MessageChecksum_TSC1_TSC1_E_ABS_EBS_PCAN: init-value=0, length=4, base-type=uint8, system-signal=MessageChecksum_TSC1_TSC1_E_ABS_EBS_PCAN  # The message checksum is used to verify the signal path from the transmitting device to the receiving device."
    MessageCounter_TSC1_E_ABS_EBS_PCAN: init-value=0, length=4, base-type=uint8, system-signal=MessageCounter_TSC1_E_ABS_EBS_PCAN  # The message counter is used to detect situations where the transmitting ECU malfunction repeats the same frame all theThe message counter is used to detect situations where the transmitting ECU malfunction repeats the same frame all theThe message counter is used to detect situations where the transmitting ECU malfunction repeats the same frame all theThe message counter is used to detect situations where the transmitting ECU malfunction repeats the same frame all theThe message counter is used to detect s"
    ControlPurpose_TSC1_E_ABS_EBS_PCAN: init-value=0, length=5, base-type=uint8, system-signal=ControlPurpose_TSC1_E_ABS_EBS_PCAN  # State signal which indicates which control mode the sending device is using to generate the TSC1 command."
    TransmissionRate_TSC1_E_ABS_EBS_PCAN: init-value=0, length=3, base-type=uint8, system-signal=TransmissionRate_TSC1_E_ABS_EBS_PCAN  # This parameter indicates the transmission rate at which the sending device will transmit the TSC1 message."
    EngRequstedTorqueLimit_ABS_E_TSC1_E_ABS_EBS_PCAN: init-value=0, length=8, base-type=uint8, system-signal=EngRequstedTorqueLimit_ABS_E_TSC1_E_ABS_EBS_PCAN  # Parameter provided to the engine or retarder in the torque/speed control message for controlling or limiting the output torque."
    EngRqedSpeed_SpeedLimit_TSC1_E_ABS_EBS_PCAN: init-value=0, length=16, base-type=uint16, system-signal=EngRqedSpeed_SpeedLimit_TSC1_E_ABS_EBS_PCAN  # Parameter provided to the engine from external sources in the torque/speed control message."
    OverrideCtrlModePriority_TSC1_E_ABS_EBS_PCAN: init-value=0, length=2, base-type=uint8, system-signal=OverrideCtrlModePriority_TSC1_E_ABS_EBS_PCAN
    EngRqedSpeedCtrlConditions_TSC1_E_ABS_EBS_PCAN: init-value=0, length=2, base-type=uint8, system-signal=EngRqedSpeedCtrlConditions_TSC1_E_ABS_EBS_PCAN  # This mode tells the engine control system the governor characteristics that are desired during speed control."
    EngOverrideCtrlMode_TSC1_E_ABS_EBS_PCAN: init-value=0, length=2, base-type=uint8, system-signal=EngOverrideCtrlMode_TSC1_E_ABS_EBS_PCAN
    EngineRequestedTorqueHiRes_TSC1_E_ABS_EBS_PCAN: init-value=0, length=4, base-type=uint8, system-signal=EngineRequestedTorqueHiRes_TSC1_E_ABS_EBS_PCAN  # This parameter displays an additional torque in percent of the reference engine torque."
    MessageChecksum_TSC1_TSC1_DR_ABS_EBS_PCAN: init-value=0, length=4, base-type=uint8, system-signal=MessageChecksum_TSC1_TSC1_DR_ABS_EBS_PCAN  # The message checksum is used to verify the signal path from the transmitting device to the receiving device."
    MessageCounter_TSC1_DR_ABS_EBS_PCAN: init-value=0, length=4, base-type=uint8, system-signal=MessageCounter_TSC1_DR_ABS_EBS_PCAN  # The message counter is used to detect situations where the transmitting ECU malfunction repeats the same frame all theThe message counter is used to detect situations where the transmitting ECU malfunction repeats the same frame all theThe message counter is used to detect situations where the transmitting ECU malfunction repeats the same frame all theThe message counter is used to detect situations where the transmitting ECU malfunction repeats the same frame all theThe message counter is used to detect s"
    ControlPurpose_TSC1_DR_ABS_EBS_PCAN: init-value=0, length=5, base-type=uint8, system-signal=ControlPurpose_TSC1_DR_ABS_EBS_PCAN  # State signal which indicates which control mode the sending device is using to generate the TSC1 command."
    TransmissionRate_TSC1_DR_ABS_EBS_PCAN: init-value=0, length=3, base-type=uint8, system-signal=TransmissionRate_TSC1_DR_ABS_EBS_PCAN  # This parameter indicates the transmission rate at which the sending device will transmit the TSC1 message."
    EngRequstedTorqueLimit_ABS_DR_TSC1_DR_ABS_EBS_PCAN: init-value=0, length=8, base-type=uint8, system-signal=EngRequstedTorqueLimit_ABS_DR_TSC1_DR_ABS_EBS_PCAN  # Parameter provided to the engine or retarder in the torque/speed control message for controlling or limiting the output torque."
    EngRqedSpeed_SpeedLimit_TSC1_DR_ABS_EBS_PCAN: init-value=0, length=16, base-type=uint16, system-signal=EngRqedSpeed_SpeedLimit_TSC1_DR_ABS_EBS_PCAN  # Parameter provided to the engine from external sources in the torque/speed control message."
    OverrideCtrlModePriority_TSC1_DR_ABS_EBS_PCAN: init-value=0, length=2, base-type=uint8, system-signal=OverrideCtrlModePriority_TSC1_DR_ABS_EBS_PCAN
    EngRqedSpeedCtrlConditions_TSC1_DR_ABS_EBS_PCAN: init-value=0, length=2, base-type=uint8, system-signal=EngRqedSpeedCtrlConditions_TSC1_DR_ABS_EBS_PCAN  # This mode tells the engine control system the governor characteristics that are desired during speed control."
    EngOverrideCtrlMode_TSC1_DR_ABS_EBS_PCAN: init-value=0, length=2, base-type=uint8, system-signal=EngOverrideCtrlMode_TSC1_DR_ABS_EBS_PCAN
    EngineRequestedTorqueHiRes_TSC1_DR_ABS_EBS_PCAN: init-value=0, length=4, base-type=uint8, system-signal=EngineRequestedTorqueHiRes_TSC1_DR_ABS_EBS_PCAN  # This parameter displays an additional torque in percent of the reference engine torque."
    DTC5_DM1_ABS_EBS_PCAN: init-value=0, length=32, base-type=uint32, system-signal=DTC5_DM1_ABS_EBS_PCAN  # Diagnostic Trouble Code"
    DTC4_DM1_ABS_EBS_PCAN: init-value=0, length=32, base-type=uint32, system-signal=DTC4_DM1_ABS_EBS_PCAN  # Diagnostic Trouble Code"
    DTC3_DM1_ABS_EBS_PCAN: init-value=0, length=32, base-type=uint32, system-signal=DTC3_DM1_ABS_EBS_PCAN  # Diagnostic Trouble Code"
    DTC2_DM1_ABS_EBS_PCAN: init-value=0, length=32, base-type=uint32, system-signal=DTC2_DM1_ABS_EBS_PCAN  # Diagnostic Trouble Code"
    DTC1_DM1_ABS_EBS_PCAN: init-value=0, length=32, base-type=uint32, system-signal=DTC1_DM1_ABS_EBS_PCAN  # Diagnostic Trouble Code"
    FlashRedStopLamp_DM1_ABS_EBS_PCAN: init-value=0, length=2, base-type=uint8, system-signal=FlashRedStopLamp_DM1_ABS_EBS_PCAN  # This parameter provides the capability to flash the RSL (SPN 3039)."
    FlashProtectLamp_DM1_ABS_EBS_PCAN: init-value=0, length=2, base-type=uint8, system-signal=FlashProtectLamp_DM1_ABS_EBS_PCAN  # This parameter provides the capability to flash the engine protect lamp (SPN 3041)."
    FlashMalfuncIndicatorLamp_DM1_ABS_EBS_PCAN: init-value=0, length=2, base-type=uint8, system-signal=FlashMalfuncIndicatorLamp_DM1_ABS_EBS_PCAN  # This parameter provides the capability to flash the MIL (SPN 3038)."
    FlashAmberWarningLamp_DM1_ABS_EBS_PCAN: init-value=0, length=2, base-type=uint8, system-signal=FlashAmberWarningLamp_DM1_ABS_EBS_PCAN  # This parameter provides the capability to flash the AWL (SPN 3040). "
    MalfunctionIndicatorLampStatus_DM1_ABS_EBS_PCAN: init-value=0, length=2, base-type=uint8, system-signal=MalfunctionIndicatorLampStatus_DM1_ABS_EBS_PCAN  # A lamp used to relay only emissions-related trouble code information."
    AmberWarningLampStatus_ABS_EBS_DM1_ABS_EBS_PCAN: init-value=0, length=2, base-type=uint8, system-signal=AmberWarningLampStatus_ABS_EBS_DM1_ABS_EBS_PCAN  # This lamp is used to relay trouble code information that is reporting a problem with the vehicle system but the vehicle need not be immediately stopped."
    RedStopLampState_DM1_ABS_EBS_PCAN: init-value=0, length=2, base-type=uint8, system-signal=RedStopLampState_DM1_ABS_EBS_PCAN  # This lamp is uesed to relay trouble code information that is of a severe enought condition that it warrants stopping the vehicle."
    ProtectLampStatus_DM1_ABS_EBS_PCAN: init-value=0, length=2, base-type=uint8, system-signal=ProtectLampStatus_DM1_ABS_EBS_PCAN  # This lamp is used to relay trouble code informatio that is reporting a problem with a vehicle system that is most probably not electronic subsystem related."
    DTC5_DM1_EHPS_PCAN: init-value=0, length=32, base-type=uint32, system-signal=DTC5_DM1_EHPS_PCAN  # Diagnostic Trouble Code"
    DTC4_DM1_EHPS_PCAN: init-value=0, length=32, base-type=uint32, system-signal=DTC4_DM1_EHPS_PCAN  # Diagnostic Trouble Code"
    DTC3_DM1_EHPS_PCAN: init-value=0, length=32, base-type=uint32, system-signal=DTC3_DM1_EHPS_PCAN  # Diagnostic Trouble Code"
    DTC2_DM1_EHPS_PCAN: init-value=0, length=32, base-type=uint32, system-signal=DTC2_DM1_EHPS_PCAN  # Diagnostic Trouble Code"
    DTC1_DM1_EHPS_PCAN: init-value=0, length=32, base-type=uint32, system-signal=DTC1_DM1_EHPS_PCAN  # Diagnostic Trouble Code"
    FlashRedStopLamp_DM1_EHPS_PCAN: init-value=0, length=2, base-type=uint8, system-signal=FlashRedStopLamp_DM1_EHPS_PCAN  # This parameter provides the capability to flash the RSL (SPN 3039)."
    FlashProtectLamp_DM1_EHPS_PCAN: init-value=0, length=2, base-type=uint8, system-signal=FlashProtectLamp_DM1_EHPS_PCAN  # This parameter provides the capability to flash the engine protect lamp (SPN 3041)."
    FlashMalfuncIndicatorLamp_DM1_EHPS_PCAN: init-value=0, length=2, base-type=uint8, system-signal=FlashMalfuncIndicatorLamp_DM1_EHPS_PCAN  # This parameter provides the capability to flash the MIL (SPN 3038)."
    FlashAmberWarningLamp_DM1_EHPS_PCAN: init-value=0, length=2, base-type=uint8, system-signal=FlashAmberWarningLamp_DM1_EHPS_PCAN  # This parameter provides the capability to flash the AWL (SPN 3040). "
    MalfunctionIndicatorLampStatus_DM1_EHPS_PCAN: init-value=0, length=2, base-type=uint8, system-signal=MalfunctionIndicatorLampStatus_DM1_EHPS_PCAN  # A lamp used to relay only emissions-related trouble code information."
    AmberWarningLampStatus_DM1_EHPS_PCAN: init-value=0, length=2, base-type=uint8, system-signal=AmberWarningLampStatus_DM1_EHPS_PCAN  # This lamp is used to relay trouble code information that is reporting a problem with the vehicle system but the vehicle need not be immediately stopped."
    RedStopLampState_DM1_EHPS_PCAN: init-value=0, length=2, base-type=uint8, system-signal=RedStopLampState_DM1_EHPS_PCAN  # This lamp is uesed to relay trouble code information that is of a severe enought condition that it warrants stopping the vehicle."
    ProtectLampStatus_DM1_EHPS_PCAN: init-value=0, length=2, base-type=uint8, system-signal=ProtectLampStatus_DM1_EHPS_PCAN  # This lamp is used to relay trouble code informatio that is reporting a problem with a vehicle system that is most probably not electronic subsystem related."
    OverallIntendedBrakeAcceleration_EBC5_CCM_PCAN: init-value=0, length=8, base-type=uint8, system-signal=OverallIntendedBrakeAcceleration_EBC5_CCM_PCAN
    DriverBrakeDemand_EBC5_CCM_PCAN: init-value=0, length=8, base-type=uint8, system-signal=DriverBrakeDemand_EBC5_CCM_PCAN
    XBRBrakeHoldMode_EBC5_CCM_PCAN: init-value=0, length=4, base-type=uint8, system-signal=XBRBrakeHoldMode_EBC5_CCM_PCAN
    RailroadMode_EBC5_CCM_PCAN: init-value=0, length=2, base-type=uint8, system-signal=RailroadMode_EBC5_CCM_PCAN
    EmergencyBrakingActive_EBC5_CCM_PCAN: init-value=0, length=2, base-type=uint8, system-signal=EmergencyBrakingActive_EBC5_CCM_PCAN
    BrakeTempWarning_EBC5_CCM_PCAN: init-value=0, length=2, base-type=uint8, system-signal=BrakeTempWarning_EBC5_CCM_PCAN  # This parameter indicates if the temperature in the service brakes exceeds a certain value.This parameter indicates if the temperature in the service brakes exceeds a certain value. It can be used for a warningThis parameter indicates if the temperature in the service brakes exceeds a certain value."
    XBRAccelerationLimit_EBC5_CCM_PCAN: init-value=125, length=8, base-type=uint8, system-signal=XBRAccelerationLimit_EBC5_CCM_PCAN  # The brake system may temporarily or generally limit the maximum brake performance available for external systems.The brake system may temporarily or generally limit the maximum brake performance available for external systems. AThe brake system may temporarily or generally limit the maximum brake performance available for external systems."
    XBRActiveCtrlMode_EBC5_CCM_PCAN: init-value=0, length=4, base-type=uint8, system-signal=XBRActiveCtrlMode_EBC5_CCM_PCAN  # This parameter indicates which XBR Control Mode is executed by the brake system.This parameter indicates which XBR Control Mode is executed by the brake system.This parameter indicates which XBR Control Mode is executed by the brake system."
    XBRSystemState_EBC5_CCM_PCAN: init-value=0, length=2, base-type=uint8, system-signal=XBRSystemState_EBC5_CCM_PCAN  # This parameter indicates which external brake control is allowed.This parameter indicates which external brake control is allowed.This parameter indicates which external brake control is allowed."
    FoundationBrakeUse_EBC5_CCM_PCAN: init-value=0, length=2, base-type=uint8, system-signal=FoundationBrakeUse_EBC5_CCM_PCAN  # This parameter indicates if the brake system presently uses the foundation brakes.This parameter indicates if the brake system presently uses the foundation brakes.This parameter indicates if the brake system presently uses the foundation brakes."
    HillHolderMode_EBC5_CCM_PCAN: init-value=0, length=3, base-type=uint8, system-signal=HillHolderMode_EBC5_CCM_PCAN  # Signal which indicates the current mode of the hill holder function.Signal which indicates the current mode of the hill holder function.Signal which indicates the current mode of the hill holder function."
    HaltBrakeMode_EBC5_CCM_PCAN: init-value=0, length=3, base-type=uint8, system-signal=HaltBrakeMode_EBC5_CCM_PCAN  # Signal which indicates the current mode of the halt brake function.Signal which indicates the current mode of the halt brake function.Signal which indicates the current mode of the halt brake function."
    PrkngBrakeActuatorFullyActivated_EBC5_CCM_PCAN: init-value=0, length=2, base-type=uint8, system-signal=PrkngBrakeActuatorFullyActivated_EBC5_CCM_PCAN  # Signal which indicates when the parking brake actuator is fully activated."
    KEY_IN_SW_OUTPUT_STATE_SMK1__SM2TB__SMK_PCAN: init-value=0, length=1, base-type=uint8, system-signal=KEY_IN_SW_OUTPUT_STATE_SMK1__SM2TB__SMK_PCAN
    IG2_OUTPUT_STATE_SMK1__SM2TB__SMK_PCAN: init-value=0, length=1, base-type=uint8, system-signal=IG2_OUTPUT_STATE_SMK1__SM2TB__SMK_PCAN
    IG1_OUTPUT_STATE_SMK1__SM2TB__SMK_PCAN: init-value=0, length=1, base-type=uint8, system-signal=IG1_OUTPUT_STATE_SMK1__SM2TB__SMK_PCAN
    START_OUTPUT_STATE_SMK1__SM2TB__SMK_PCAN: init-value=0, length=1, base-type=uint8, system-signal=START_OUTPUT_STATE_SMK1__SM2TB__SMK_PCAN
    ACC_OUTPUT_STATE_SMK1__SM2TB__SMK_PCAN: init-value=0, length=1, base-type=uint8, system-signal=ACC_OUTPUT_STATE_SMK1__SM2TB__SMK_PCAN
    Engine_Running_Stop_State_SMK1__SM2TB__SMK_PCAN: init-value=0, length=2, base-type=uint8, system-signal=Engine_Running_Stop_State_SMK1__SM2TB__SMK_PCAN  # Normal / Remote Engine Start Mode State 00b - Normal Engine Start Mode 01b - Remote Engine Start Mode 10b - Error 11b - Not Available"
    RemoteCryptoCertificationState_SMK1__SM2TB__SMK_PCAN: init-value=0, length=2, base-type=uint8, system-signal=RemoteCryptoCertificationState_SMK1__SM2TB__SMK_PCAN  # 00b - Crypto Code Invalid 01b - Crypto Code Valid 10b - Error 11b - Not Available"
    RKE_Arming_State_SMK1__SM2TB__SMK_PCAN: init-value=0, length=2, base-type=uint8, system-signal=RKE_Arming_State_SMK1__SM2TB__SMK_PCAN  # 00b - Disable arming mode 01b - Arming mode 10b - Re-arming standby mode 11b - Alarm mode"
    SSB_Key_State_SMK1__SM2TB__SMK_PCAN: init-value=0, length=3, base-type=uint8, system-signal=SSB_Key_State_SMK1__SM2TB__SMK_PCAN  # 000b-Offstatewithoutkey-in(WHITELEDOFF) 001b-Offstatewithkey-in(WHITELEDON) 010b-ACCstate(YELLOWLEDON) 011b-IGstatewithoutengine run(BLUELEDON) 100b-START(cranking)state(BLUELEDON) 101b-IGstatewithengine run(BLUELEDON) 110b-ERR 111b-NotAvailable"
    MessageChecksum_TSC1_TSC1_DrvR_ACC_ACC_PCAN: init-value=0, length=4, base-type=uint8, system-signal=MessageChecksum_TSC1_TSC1_DrvR_ACC_ACC_PCAN  # The message checksum is used to verify the signal path from the transmitting device to the receiving device."
    MessageCounter_TSC1_DrvR_ACC_ACC_PCAN: init-value=0, length=4, base-type=uint8, system-signal=MessageCounter_TSC1_DrvR_ACC_ACC_PCAN  # The message counter is used to detect situations where the transmitting ECU malfunction repeats the same frame all theThe message counter is used to detect situations where the transmitting ECU malfunction repeats the same frame all theThe message counter is used to detect situations where the transmitting ECU malfunction repeats the same frame all theThe message counter is used to detect situations where the transmitting ECU malfunction repeats the same frame all theThe message counter is used to detect s"
    ControlPurpose_TSC1_DrvR_ACC_ACC_PCAN: init-value=0, length=5, base-type=uint8, system-signal=ControlPurpose_TSC1_DrvR_ACC_ACC_PCAN  # State signal which indicates which control mode the sending device is using to generate the TSC1 command."
    TransmissionRate_TSC1_DrvR_ACC_ACC_PCAN: init-value=0, length=3, base-type=uint8, system-signal=TransmissionRate_TSC1_DrvR_ACC_ACC_PCAN  # This parameter indicates the transmission rate at which the sending device will transmit the TSC1 message."
    EngRequstedTorqueLimit_ACC_DR_TSC1_DrvR_ACC_ACC_PCAN: init-value=0, length=8, base-type=uint8, system-signal=EngRequstedTorqueLimit_ACC_DR_TSC1_DrvR_ACC_ACC_PCAN  # Parameter provided to the engine or retarder in the torque/speed control message for controlling or limiting the output torque."
    EngRqedSpeed_SpeedLimit_TSC1_DrvR_ACC_ACC_PCAN: init-value=0, length=16, base-type=uint16, system-signal=EngRqedSpeed_SpeedLimit_TSC1_DrvR_ACC_ACC_PCAN  # Parameter provided to the engine from external sources in the torque/speed control message."
    OverrideCtrlModePriority_TSC1_DrvR_ACC_ACC_PCAN: init-value=0, length=2, base-type=uint8, system-signal=OverrideCtrlModePriority_TSC1_DrvR_ACC_ACC_PCAN
    EngRqedSpeedCtrlConditions_TSC1_DrvR_ACC_ACC_PCAN: init-value=0, length=2, base-type=uint8, system-signal=EngRqedSpeedCtrlConditions_TSC1_DrvR_ACC_ACC_PCAN  # This mode tells the engine control system the governor characteristics that are desired during speed control."
    EngOverrideCtrlMode_TSC1_DrvR_ACC_ACC_PCAN: init-value=0, length=2, base-type=uint8, system-signal=EngOverrideCtrlMode_TSC1_DrvR_ACC_ACC_PCAN
